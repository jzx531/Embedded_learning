/dts-v1/;

// Exported from captured runtime data; phandles are numeric.
/memreserve/ 0x8300000 0x1d000;
/ {
	serial-number = "522550335edea2ab";
	compatible = "rockchip,rk3568-kickpi-k1a", "rockchip,rk3568";
	interrupt-parent = <0x1>;
	#address-cells = <0x2>;
	#size-cells = <0x2>;
	model = "Rockchip RK3568 KICKPI K1A Board";
	memory {
		reg = <0x0 0x200000 0x0 0x8200000 0x0 0x9400000 0x0 0xe6c00000 0x1 0xf0000000 0x0 0x10000000 0x0 0x0 0x0 0x0 0x0 0x0 0x0 0x0 0x0 0x0 0x0 0x0 0x0 0x0 0x0 0x0 0x0 0x0 0x0 0x0 0x0 0x0 0x0 0x0 0x0 0x0 0x0 0x0 0x0 0x0 0x0 0x0 0x0 0x0 0x0 0x0>;
		device_type = "memory";
	};
	ddr3-params {
		version = <0x100>;
		expanded_version = <0x0>;
		reserved = <0x0>;
		freq_0 = <0x420>;
		freq_1 = <0x144>;
		freq_2 = <0x210>;
		freq_3 = <0x30c>;
		freq_4 = <0x0>;
		freq_5 = <0x0>;
		pd_idle = <0xd>;
		sr_idle = <0x5d>;
		sr_mc_gate_idle = <0x0>;
		srpd_lite_idle = <0x0>;
		standby_idle = <0x0>;
		pd_dis_freq = <0x42a>;
		sr_dis_freq = <0x320>;
		dram_dll_dis_freq = <0x12c>;
		phy_dll_dis_freq = <0x0>;
		phy_dq_drv_odten = <0x21>;
		phy_ca_drv_odten = <0x21>;
		phy_clk_drv_odten = <0x21>;
		dram_dq_drv_odten = <0x22>;
		phy_dq_drv_odtoff = <0x21>;
		phy_ca_drv_odtoff = <0x21>;
		phy_clk_drv_odtoff = <0x21>;
		dram_dq_drv_odtoff = <0x22>;
		dram_odt = <0x78>;
		phy_odt = <0xa7>;
		phy_odt_puup_en = <0x1>;
		phy_odt_pudn_en = <0x1>;
		dram_dq_odt_en_freq = <0x14d>;
		phy_odt_en_freq = <0x14d>;
		phy_dq_sr_odten = <0xf>;
		phy_ca_sr_odten = <0x3>;
		phy_clk_sr_odten = <0x0>;
		phy_dq_sr_odtoff = <0xf>;
		phy_ca_sr_odtoff = <0x3>;
		phy_clk_sr_odtoff = <0x0>;
		ssmod_downspread = <0x0>;
		ssmod_div = <0x0>;
		ssmod_spread = <0x0>;
		mode_2t = <0x0>;
		speed_bin = <0x15>;
		dram_ext_temp = <0x0>;
		byte_map = <0xe4>;
		dq_map_cs0_dq_l = <0x0>;
		dq_map_cs0_dq_h = <0x0>;
		dq_map_cs1_dq_l = <0x0>;
		dq_map_cs1_dq_h = <0x0>;
		phandle = <0xb3>;
	};
	ddr4-params {
		version = <0x100>;
		expanded_version = <0x0>;
		reserved = <0x0>;
		freq_0 = <0x420>;
		freq_1 = <0x144>;
		freq_2 = <0x210>;
		freq_3 = <0x30c>;
		freq_4 = <0x0>;
		freq_5 = <0x0>;
		pd_idle = <0xd>;
		sr_idle = <0x5d>;
		sr_mc_gate_idle = <0x0>;
		srpd_lite_idle = <0x0>;
		standby_idle = <0x0>;
		pd_dis_freq = <0x42a>;
		sr_dis_freq = <0x320>;
		dram_dll_dis_freq = <0x271>;
		phy_dll_dis_freq = <0x0>;
		phy_dq_drv_odten = <0x25>;
		phy_ca_drv_odten = <0x25>;
		phy_clk_drv_odten = <0x25>;
		dram_dq_drv_odten = <0x22>;
		phy_dq_drv_odtoff = <0x25>;
		phy_ca_drv_odtoff = <0x25>;
		phy_clk_drv_odtoff = <0x25>;
		dram_dq_drv_odtoff = <0x22>;
		dram_odt = <0x78>;
		phy_odt = <0x8b>;
		phy_odt_puup_en = <0x1>;
		phy_odt_pudn_en = <0x1>;
		dram_dq_odt_en_freq = <0x1f4>;
		phy_odt_en_freq = <0x1f4>;
		phy_dq_sr_odten = <0xe>;
		phy_ca_sr_odten = <0x1>;
		phy_clk_sr_odten = <0x1>;
		phy_dq_sr_odtoff = <0xe>;
		phy_ca_sr_odtoff = <0x1>;
		phy_clk_sr_odtoff = <0x1>;
		ssmod_downspread = <0x0>;
		ssmod_div = <0x0>;
		ssmod_spread = <0x0>;
		mode_2t = <0x0>;
		speed_bin = <0xc>;
		dram_ext_temp = <0x0>;
		byte_map = <0xe4>;
		dq_map_cs0_dq_l = <0x22777788>;
		dq_map_cs0_dq_h = <0xd7888877>;
		dq_map_cs1_dq_l = <0x22777788>;
		dq_map_cs1_dq_h = <0xd7888877>;
		phandle = <0xb4>;
	};
	lpddr3-params {
		version = <0x100>;
		expanded_version = <0x0>;
		reserved = <0x0>;
		freq_0 = <0x420>;
		freq_1 = <0x144>;
		freq_2 = <0x210>;
		freq_3 = <0x30c>;
		freq_4 = <0x0>;
		freq_5 = <0x0>;
		pd_idle = <0xd>;
		sr_idle = <0x5d>;
		sr_mc_gate_idle = <0x0>;
		srpd_lite_idle = <0x0>;
		standby_idle = <0x0>;
		pd_dis_freq = <0x42a>;
		sr_dis_freq = <0x320>;
		dram_dll_dis_freq = <0x0>;
		phy_dll_dis_freq = <0x0>;
		phy_dq_drv_odten = <0x25>;
		phy_ca_drv_odten = <0x25>;
		phy_clk_drv_odten = <0x27>;
		dram_dq_drv_odten = <0x22>;
		phy_dq_drv_odtoff = <0x25>;
		phy_ca_drv_odtoff = <0x25>;
		phy_clk_drv_odtoff = <0x27>;
		dram_dq_drv_odtoff = <0x22>;
		dram_odt = <0x78>;
		phy_odt = <0x94>;
		phy_odt_puup_en = <0x1>;
		phy_odt_pudn_en = <0x1>;
		dram_dq_odt_en_freq = <0x14d>;
		phy_odt_en_freq = <0x14d>;
		phy_dq_sr_odten = <0xf>;
		phy_ca_sr_odten = <0x1>;
		phy_clk_sr_odten = <0xf>;
		phy_dq_sr_odtoff = <0xf>;
		phy_ca_sr_odtoff = <0x1>;
		phy_clk_sr_odtoff = <0xf>;
		ssmod_downspread = <0x0>;
		ssmod_div = <0x0>;
		ssmod_spread = <0x0>;
		mode_2t = <0x0>;
		speed_bin = <0x0>;
		dram_ext_temp = <0x0>;
		byte_map = <0x8d>;
		dq_map_cs0_dq_l = <0x0>;
		dq_map_cs0_dq_h = <0x0>;
		dq_map_cs1_dq_l = <0x0>;
		dq_map_cs1_dq_h = <0x0>;
		phandle = <0xb5>;
	};
	lpddr4-params {
		version = <0x100>;
		expanded_version = <0x0>;
		reserved = <0x0>;
		freq_0 = <0x618>;
		freq_1 = <0x144>;
		freq_2 = <0x210>;
		freq_3 = <0x30c>;
		freq_4 = <0x0>;
		freq_5 = <0x0>;
		pd_idle = <0xd>;
		sr_idle = <0x5d>;
		sr_mc_gate_idle = <0x0>;
		srpd_lite_idle = <0x0>;
		standby_idle = <0x0>;
		pd_dis_freq = <0x42a>;
		sr_dis_freq = <0x320>;
		dram_dll_dis_freq = <0x0>;
		phy_dll_dis_freq = <0x0>;
		phy_dq_drv_odten = <0x1e>;
		phy_ca_drv_odten = <0x26>;
		phy_clk_drv_odten = <0x26>;
		dram_dq_drv_odten = <0x28>;
		phy_dq_drv_odtoff = <0x1e>;
		phy_ca_drv_odtoff = <0x26>;
		phy_clk_drv_odtoff = <0x26>;
		dram_dq_drv_odtoff = <0x28>;
		dram_odt = <0x50>;
		phy_odt = <0x3c>;
		phy_odt_puup_en = <0x0>;
		phy_odt_pudn_en = <0x0>;
		dram_dq_odt_en_freq = <0x320>;
		phy_odt_en_freq = <0x320>;
		phy_dq_sr_odten = <0x0>;
		phy_ca_sr_odten = <0xf>;
		phy_clk_sr_odten = <0xf>;
		phy_dq_sr_odtoff = <0x0>;
		phy_ca_sr_odtoff = <0xf>;
		phy_clk_sr_odtoff = <0xf>;
		ssmod_downspread = <0x0>;
		ssmod_div = <0x0>;
		ssmod_spread = <0x0>;
		mode_2t = <0x0>;
		speed_bin = <0x0>;
		dram_ext_temp = <0x0>;
		byte_map = <0xe4>;
		dq_map_cs0_dq_l = <0x0>;
		dq_map_cs0_dq_h = <0x0>;
		dq_map_cs1_dq_l = <0x0>;
		dq_map_cs1_dq_h = <0x0>;
		lp4_ca_odt = <0x78>;
		lp4_drv_pu_cal_odten = <0x1>;
		lp4_drv_pu_cal_odtoff = <0x1>;
		phy_lp4_drv_pulldown_en_odten = <0x0>;
		phy_lp4_drv_pulldown_en_odtoff = <0x0>;
		lp4_ca_odt_en_freq = <0x320>;
		phy_lp4_cs_drv_odten = <0x0>;
		phy_lp4_cs_drv_odtoff = <0x0>;
		lp4_odte_ck_en = <0x1>;
		lp4_odte_cs_en = <0x1>;
		lp4_odtd_ca_en = <0x0>;
		phy_lp4_dq_vref_odten = <0xa6>;
		lp4_dq_vref_odten = <0x12c>;
		lp4_ca_vref_odten = <0x17c>;
		phy_lp4_dq_vref_odtoff = <0x1a4>;
		lp4_dq_vref_odtoff = <0x1a4>;
		lp4_ca_vref_odtoff = <0x1a4>;
		phandle = <0xb6>;
	};
	lpddr4x-params {
		version = <0x100>;
		expanded_version = <0x0>;
		reserved = <0x0>;
		freq_0 = <0x618>;
		freq_1 = <0x144>;
		freq_2 = <0x210>;
		freq_3 = <0x30c>;
		freq_4 = <0x0>;
		freq_5 = <0x0>;
		pd_idle = <0xd>;
		sr_idle = <0x5d>;
		sr_mc_gate_idle = <0x0>;
		srpd_lite_idle = <0x0>;
		standby_idle = <0x0>;
		pd_dis_freq = <0x42a>;
		sr_dis_freq = <0x320>;
		dram_dll_dis_freq = <0x0>;
		phy_dll_dis_freq = <0x0>;
		phy_dq_drv_odten = <0x1d>;
		phy_ca_drv_odten = <0x24>;
		phy_clk_drv_odten = <0x24>;
		dram_dq_drv_odten = <0x28>;
		phy_dq_drv_odtoff = <0x1d>;
		phy_ca_drv_odtoff = <0x24>;
		phy_clk_drv_odtoff = <0x24>;
		dram_dq_drv_odtoff = <0x28>;
		dram_odt = <0x50>;
		phy_odt = <0x3c>;
		phy_odt_puup_en = <0x0>;
		phy_odt_pudn_en = <0x0>;
		dram_dq_odt_en_freq = <0x320>;
		phy_odt_en_freq = <0x320>;
		phy_dq_sr_odten = <0x0>;
		phy_ca_sr_odten = <0x0>;
		phy_clk_sr_odten = <0x0>;
		phy_dq_sr_odtoff = <0x0>;
		phy_ca_sr_odtoff = <0x0>;
		phy_clk_sr_odtoff = <0x0>;
		ssmod_downspread = <0x0>;
		ssmod_div = <0x0>;
		ssmod_spread = <0x0>;
		mode_2t = <0x0>;
		speed_bin = <0x0>;
		dram_ext_temp = <0x0>;
		byte_map = <0xe4>;
		dq_map_cs0_dq_l = <0x0>;
		dq_map_cs0_dq_h = <0x0>;
		dq_map_cs1_dq_l = <0x0>;
		dq_map_cs1_dq_h = <0x0>;
		lp4_ca_odt = <0x78>;
		lp4_drv_pu_cal_odten = <0x0>;
		lp4_drv_pu_cal_odtoff = <0x0>;
		phy_lp4_drv_pulldown_en_odten = <0x0>;
		phy_lp4_drv_pulldown_en_odtoff = <0x0>;
		lp4_ca_odt_en_freq = <0x320>;
		phy_lp4_cs_drv_odten = <0x0>;
		phy_lp4_cs_drv_odtoff = <0x0>;
		lp4_odte_ck_en = <0x0>;
		lp4_odte_cs_en = <0x0>;
		lp4_odtd_ca_en = <0x0>;
		phy_lp4_dq_vref_odten = <0xa6>;
		lp4_dq_vref_odten = <0xe4>;
		lp4_ca_vref_odten = <0x157>;
		phy_lp4_dq_vref_odtoff = <0x1a4>;
		lp4_dq_vref_odtoff = <0x1a4>;
		lp4_ca_vref_odtoff = <0x157>;
		phandle = <0xb7>;
	};
	aliases {
		csi2dphy0 = "/csi2-dphy0";
		csi2dphy1 = "/csi2-dphy1";
		csi2dphy2 = "/csi2-dphy2";
		dsi0 = "/dsi@fe060000";
		dsi1 = "/dsi@fe070000";
		ethernet0 = "/ethernet@fe2a0000";
		ethernet1 = "/ethernet@fe010000";
		gpio0 = "/pinctrl/gpio0@fdd60000";
		gpio1 = "/pinctrl/gpio1@fe740000";
		gpio2 = "/pinctrl/gpio2@fe750000";
		gpio3 = "/pinctrl/gpio3@fe760000";
		gpio4 = "/pinctrl/gpio4@fe770000";
		i2c0 = "/i2c@fdd40000";
		i2c1 = "/i2c@fe5a0000";
		i2c2 = "/i2c@fe5b0000";
		i2c3 = "/i2c@fe5c0000";
		i2c4 = "/i2c@fe5d0000";
		i2c5 = "/i2c@fe5e0000";
		mmc0 = "/sdhci@fe310000";
		mmc1 = "/dwmmc@fe2b0000";
		mmc2 = "/dwmmc@fe2c0000";
		mmc3 = "/dwmmc@fe000000";
		serial0 = "/serial@fdd50000";
		serial1 = "/serial@fe650000";
		serial2 = "/serial@fe660000";
		serial3 = "/serial@fe670000";
		serial4 = "/serial@fe680000";
		serial5 = "/serial@fe690000";
		serial6 = "/serial@fe6a0000";
		serial7 = "/serial@fe6b0000";
		serial8 = "/serial@fe6c0000";
		serial9 = "/serial@fe6d0000";
		spi0 = "/spi@fe610000";
		spi1 = "/spi@fe620000";
		spi2 = "/spi@fe630000";
		spi3 = "/spi@fe640000";
		lvds0 = "/syscon@fdc60000/lvds";
		lvds1 = "/syscon@fdc60000/lvds1";
	};
	cpus {
		#address-cells = <0x2>;
		#size-cells = <0x0>;
		cpu@0 {
			device_type = "cpu";
			compatible = "arm,cortex-a55";
			reg = <0x0 0x0>;
			enable-method = "psci";
			clocks = <0x2 0x0>;
			operating-points-v2 = <0x3>;
			cpu-idle-states = <0x4>;
			#cooling-cells = <0x2>;
			dynamic-power-coefficient = <0xbb>;
			cpu-supply = <0x5>;
			phandle = <0xc>;
		};
		cpu@100 {
			device_type = "cpu";
			compatible = "arm,cortex-a55";
			reg = <0x0 0x100>;
			enable-method = "psci";
			clocks = <0x2 0x0>;
			operating-points-v2 = <0x3>;
			cpu-idle-states = <0x4>;
			phandle = <0xd>;
		};
		cpu@200 {
			device_type = "cpu";
			compatible = "arm,cortex-a55";
			reg = <0x0 0x200>;
			enable-method = "psci";
			clocks = <0x2 0x0>;
			operating-points-v2 = <0x3>;
			cpu-idle-states = <0x4>;
			phandle = <0xe>;
		};
		cpu@300 {
			device_type = "cpu";
			compatible = "arm,cortex-a55";
			reg = <0x0 0x300>;
			enable-method = "psci";
			clocks = <0x2 0x0>;
			operating-points-v2 = <0x3>;
			cpu-idle-states = <0x4>;
			phandle = <0xf>;
		};
		idle-states {
			entry-method = "psci";
			cpu-sleep {
				compatible = "arm,idle-state";
				local-timer-stop;
				arm,psci-suspend-param = <0x10000>;
				entry-latency-us = <0x64>;
				exit-latency-us = <0x78>;
				min-residency-us = <0x3e8>;
				phandle = <0x4>;
			};
		};
	};
	cpu0-opp-table {
		compatible = "operating-points-v2";
		opp-shared;
		mbist-vmin = <0xc96a8 0xdbba0 0xe7ef0>;
		nvmem-cells = <0x6 0x7 0x8 0x9 0xa 0xb>;
		nvmem-cell-names = "leakage", "pvtm", "mbist-vmin", "opp-info", "specification_serial_number", "remark_spec_serial_number";
		rockchip,supported-hw;
		rockchip,max-volt = <0x118c30>;
		rockchip,pvtm-voltage-sel = <0x0 0x14820 0x0 0x14821 0x153d8 0x1 0x153d9 0x16378 0x2 0x16379 0x186a0 0x3>;
		rockchip,pvtm-freq = <0x639c0>;
		rockchip,pvtm-volt = <0xdbba0>;
		rockchip,pvtm-ch = <0x0 0x5>;
		rockchip,pvtm-sample-time = <0x3e8>;
		rockchip,pvtm-number = <0xa>;
		rockchip,pvtm-error = <0x3e8>;
		rockchip,pvtm-ref-temp = <0x28>;
		rockchip,pvtm-temp-prop = <0x1a 0x1a>;
		rockchip,thermal-zone = "soc-thermal";
		rockchip,temp-hysteresis = <0x1388>;
		rockchip,low-temp = <0x0>;
		rockchip,low-temp-adjust-volt = <0x0 0x7c8 0x124f8>;
		phandle = <0x3>;
		opp-408000000 {
			opp-supported-hw = <0xfb 0xffff>;
			opp-hz = <0x0 0x18519600>;
			opp-microvolt = <0xcf850 0xcf850 0x118c30>;
			clock-latency-ns = <0x9c40>;
		};
		opp-600000000 {
			opp-supported-hw = <0xfb 0xffff>;
			opp-hz = <0x0 0x23c34600>;
			opp-microvolt = <0xcf850 0xcf850 0x118c30>;
			clock-latency-ns = <0x9c40>;
		};
		opp-816000000 {
			opp-supported-hw = <0xfb 0xffff>;
			opp-hz = <0x0 0x30a32c00>;
			opp-microvolt = <0xcf850 0xcf850 0x118c30>;
			clock-latency-ns = <0x9c40>;
			opp-suspend;
		};
		opp-1104000000 {
			opp-supported-hw = <0xfb 0xffff>;
			opp-hz = <0x0 0x41cdb400>;
			opp-microvolt = <0xdbba0 0xdbba0 0x118c30>;
			opp-microvolt-L0 = <0xdbba0 0xdbba0 0x118c30>;
			opp-microvolt-L1 = <0xcf850 0xcf850 0x118c30>;
			opp-microvolt-L2 = <0xcf850 0xcf850 0x118c30>;
			opp-microvolt-L3 = <0xcf850 0xcf850 0x118c30>;
			clock-latency-ns = <0x9c40>;
		};
		opp-1416000000 {
			opp-supported-hw = <0xfb 0xffff>;
			opp-hz = "", "", "", "", "Tfr";
			opp-microvolt = <0xfa3e8 0xfa3e8 0x118c30>;
			opp-microvolt-L0 = <0xfa3e8 0xfa3e8 0x118c30>;
			opp-microvolt-L1 = <0xee098 0xee098 0x118c30>;
			opp-microvolt-L2 = <0xe7ef0 0xe7ef0 0x118c30>;
			opp-microvolt-L3 = <0xe1d48 0xe1d48 0x118c30>;
			clock-latency-ns = <0x9c40>;
		};
		opp-1608000000 {
			opp-supported-hw = <0xf9 0xffff>;
			opp-hz = <0x0 0x5fd82200>;
			opp-microvolt = <0x10c8e0 0x10c8e0 0x118c30>;
			opp-microvolt-L0 = <0x10c8e0 0x10c8e0 0x118c30>;
			opp-microvolt-L1 = <0x100590 0x100590 0x118c30>;
			opp-microvolt-L2 = <0xfa3e8 0xfa3e8 0x118c30>;
			opp-microvolt-L3 = <0xf4240 0xf4240 0x118c30>;
			clock-latency-ns = <0x9c40>;
		};
		opp-1800000000 {
			opp-supported-hw = <0xf9 0xffff>;
			opp-hz = <0x0 0x6b49d200>;
			opp-microvolt = <0x118c30 0x118c30 0x118c30>;
			opp-microvolt-L0 = <0x118c30 0x118c30 0x118c30>;
			opp-microvolt-L1 = <0x10c8e0 0x10c8e0 0x118c30>;
			opp-microvolt-L2 = <0x106738 0x106738 0x118c30>;
			opp-microvolt-L3 = <0x100590 0x100590 0x118c30>;
			clock-latency-ns = <0x9c40>;
		};
		opp-1992000000 {
			opp-supported-hw = <0xf9 0xffff>;
			opp-hz = <0x0 0x76bb8200>;
			opp-microvolt = <0x118c30 0x118c30 0x118c30>;
			opp-microvolt-L0 = <0x118c30 0x118c30 0x118c30>;
			opp-microvolt-L1 = <0x118c30 0x118c30 0x118c30>;
			opp-microvolt-L2 = <0x112a88 0x112a88 0x118c30>;
			opp-microvolt-L3 = <0x10c8e0 0x10c8e0 0x118c30>;
			clock-latency-ns = <0x9c40>;
		};
		opp-j-1008000000 {
			opp-supported-hw = <0x4 0xffff>;
			opp-hz = <0x0 0x3c14dc00>;
			opp-microvolt = <0xcf850 0xcf850 0x118c30>;
			clock-latency-ns = <0x9c40>;
		};
		opp-j-1416000000 {
			opp-supported-hw = <0x4 0xffff>;
			opp-hz = "", "", "", "", "Tfr";
			opp-microvolt = <0xdbba0 0xdbba0 0x118c30>;
			clock-latency-ns = <0x9c40>;
		};
		opp-m-1608000000 {
			opp-supported-hw = <0x2 0xffff>;
			opp-hz = <0x0 0x5fd82200>;
			opp-microvolt = <0xf4240 0xf4240 0x118c30>;
			clock-latency-ns = <0x9c40>;
		};
	};
	arm-pmu {
		compatible = "arm,cortex-a55-pmu", "arm,armv8-pmuv3";
		interrupts = <0x0 0xe4 0x4 0x0 0xe5 0x4 0x0 0xe6 0x4 0x0 0xe7 0x4>;
		interrupt-affinity = <0xc 0xd 0xe 0xf>;
	};
	cpuinfo {
		compatible = "rockchip,cpuinfo";
		nvmem-cells = <0x10 0x11 0x12>;
		nvmem-cell-names = "id", "cpu-version", "cpu-code";
	};
	display-subsystem {
		compatible = "rockchip,display-subsystem";
		memory-region = <0x13 0x14>;
		memory-region-names = "drm-logo", "drm-cubic-lut";
		ports = <0x15>;
		devfreq = <0x16>;
		route {
			route-dsi0 {
				cubic_lut,offset = "", "", " ";
				overscan,bottom_margin = <0x64>;
				overscan,top_margin = <0x64>;
				overscan,right_margin = <0x64>;
				overscan,left_margin = <0x64>;
				video,aspect_ratio = <0x0>;
				video,flags = <0xa>;
				video,vrefresh = <0x3a>;
				video,crtc_vsync_end = <0x518>;
				video,crtc_hsync_end = <0x35c>;
				video,vdisplay = <0x500>;
				video,hdisplay = <0x320>;
				video,clock = <0x109a0>;
				logo,ymirror = <0x0>;
				logo,bpp = <0x10>;
				logo,height = <0x10e>;
				logo,width = <0x28e>;
				logo,offset = <0x61000>;
				status = "okay";
				logo,uboot = "logo.bmp";
				logo,kernel = "logo_kernel.bmp";
				logo,mode = "center";
				charge_logo,mode = "center";
				connect = <0x17>;
			};
			route-dsi1 {
				status = "disabled";
				logo,uboot = "logo.bmp";
				logo,kernel = "logo_kernel.bmp";
				logo,mode = "center";
				charge_logo,mode = "center";
				connect = <0x18>;
			};
			route-edp {
				status = "disabled";
				logo,uboot = "logo.bmp";
				logo,kernel = "logo_kernel.bmp";
				logo,mode = "center";
				charge_logo,mode = "center";
				connect = <0x19>;
			};
			route-hdmi {
				status = "okay";
				logo,uboot = "logo.bmp";
				logo,kernel = "logo_kernel.bmp";
				logo,mode = "center";
				charge_logo,mode = "center";
				connect = <0x1a>;
			};
			route-lvds {
				status = "disabled";
				logo,uboot = "logo.bmp";
				logo,kernel = "logo_kernel.bmp";
				logo,mode = "center";
				charge_logo,mode = "center";
				connect = <0x1b>;
			};
			route-lvds1 {
				status = "disabled";
				logo,uboot = "logo.bmp";
				logo,kernel = "logo_kernel.bmp";
				logo,mode = "center";
				charge_logo,mode = "center";
				connect = <0x1c>;
			};
			route-rgb {
				status = "disabled";
				logo,uboot = "logo.bmp";
				logo,kernel = "logo_kernel.bmp";
				logo,mode = "center";
				charge_logo,mode = "center";
				connect = <0x1d>;
			};
		};
	};
	edac {
		compatible = "rockchip,rk3568-edac";
		interrupts = <0x0 0xad 0x4 0x0 0xaf 0x4>;
		interrupt-names = "ce", "ue";
		status = "disabled";
	};
	firmware {
		scmi {
			compatible = "arm,scmi-smc";
			shmem = <0x1e>;
			arm,smc-id = <0x82000010>;
			#address-cells = <0x1>;
			#size-cells = <0x0>;
			protocol@14 {
				reg = <0x14>;
				#clock-cells = <0x1>;
				rockchip,clk-init = <0x41cdb400>;
				phandle = <0x2>;
			};
		};
		sdei {
			compatible = "arm,sdei-1.0";
			method = "smc";
		};
	};
	mipi-csi2 {
		compatible = "rockchip,rk3568-mipi-csi2";
		rockchip,hw = <0x1f>;
		status = "disabled";
	};
	mpp-srv {
		compatible = "rockchip,mpp-service";
		rockchip,taskqueue-count = <0x6>;
		rockchip,resetgroup-count = <0x6>;
		status = "okay";
		phandle = <0x74>;
	};
	psci {
		compatible = "arm,psci-1.0";
		method = "smc";
	};
	reserved-memory {
		#address-cells = <0x2>;
		#size-cells = <0x2>;
		ranges;
		drm-logo@00000000 {
			compatible = "rockchip,drm-logo";
			reg = <0x0 0xedf00000 0x0 0xb8000>;
			phandle = <0x13>;
		};
		drm-cubic-lut@00000000 {
			compatible = "rockchip,drm-cubic-lut";
			reg = <0x0 0xeff00000 0x0 0x8000>;
			phandle = <0x14>;
		};
		ramoops@110000 {
			compatible = "ramoops";
			reg = <0x0 0x110000 0x0 0xf0000>;
			record-size = <0x20000>;
			console-size = <0x80000>;
			ftrace-size = <0x0>;
			pmsg-size = <0x50000>;
		};
	};
	rockchip-suspend {
		compatible = "rockchip,pm-rk3568";
		status = "okay";
		rockchip,sleep-debug-en = <0x1>;
		rockchip,sleep-mode-config = <0x5ec>;
		rockchip,wakeup-config = <0x10>;
	};
	rockchip-system-monitor {
		compatible = "rockchip,system-monitor";
		rockchip,thermal-zone = "soc-thermal";
	};
	thermal-zones {
		soc-thermal {
			polling-delay-passive = <0x14>;
			polling-delay = <0x3e8>;
			sustainable-power = <0x389>;
			thermal-sensors = "", "", "", " ", "", "", "";
			trips {
				trip-point-0 {
					temperature = <0x124f8>;
					hysteresis = <0x7d0>;
					type = "passive";
				};
				trip-point-1 {
					temperature = <0x14c08>;
					hysteresis = <0x7d0>;
					type = "passive";
					phandle = <0x21>;
				};
				soc-crit {
					temperature = <0x1c138>;
					hysteresis = <0x7d0>;
					type = "critical";
				};
			};
			cooling-maps {
				map0 {
					trip = <0x21>;
					cooling-device = <0xc 0xffffffff 0xffffffff>;
					contribution = <0x400>;
				};
				map1 {
					trip = <0x21>;
					cooling-device = <0x22 0xffffffff 0xffffffff>;
					contribution = <0x400>;
				};
			};
		};
		gpu-thermal {
			polling-delay-passive = <0x14>;
			polling-delay = <0x3e8>;
			thermal-sensors = <0x20 0x1>;
		};
	};
	timer {
		compatible = "arm,armv8-timer";
		interrupts = <0x1 0xd 0xf04 0x1 0xe 0xf04 0x1 0xb 0xf04 0x1 0xa 0xf04>;
		arm,no-tick-in-suspend;
	};
	external-gmac0-clock {
		compatible = "fixed-clock";
		clock-frequency = <0x7735940>;
		clock-output-names = "gmac0_clkin";
		#clock-cells = <0x0>;
	};
	external-gmac1-clock {
		compatible = "fixed-clock";
		clock-frequency = <0x7735940>;
		clock-output-names = "gmac1_clkin";
		#clock-cells = <0x0>;
	};
	xpcs-gmac0-clock {
		compatible = "fixed-clock";
		clock-frequency = <0x7735940>;
		clock-output-names = "clk_gmac0_xpcs_mii";
		#clock-cells = <0x0>;
	};
	xpcs-gmac1-clock {
		compatible = "fixed-clock";
		clock-frequency = <0x7735940>;
		clock-output-names = "clk_gmac1_xpcs_mii";
		#clock-cells = <0x0>;
	};
	i2s1-mclkin-rx {
		compatible = "fixed-clock";
		#clock-cells = <0x0>;
		clock-frequency = <0xbb8000>;
		clock-output-names = "i2s1_mclkin_rx";
	};
	i2s1-mclkin-tx {
		compatible = "fixed-clock";
		#clock-cells = <0x0>;
		clock-frequency = <0xbb8000>;
		clock-output-names = "i2s1_mclkin_tx";
	};
	i2s2-mclkin {
		compatible = "fixed-clock";
		#clock-cells = <0x0>;
		clock-frequency = <0xbb8000>;
		clock-output-names = "i2s2_mclkin";
	};
	i2s3-mclkin {
		compatible = "fixed-clock";
		#clock-cells = <0x0>;
		clock-frequency = <0xbb8000>;
		clock-output-names = "i2s3_mclkin";
	};
	mpll {
		compatible = "fixed-clock";
		#clock-cells = <0x0>;
		clock-frequency = <0x2faf0800>;
		clock-output-names = "mpll";
	};
	xin24m {
		compatible = "fixed-clock";
		#clock-cells = <0x0>;
		clock-frequency = <0x16e3600>;
		clock-output-names = "xin24m";
	};
	xin32k {
		compatible = "fixed-clock";
		clock-frequency = <0x8000>;
		clock-output-names = "xin32k";
		#clock-cells = <0x0>;
		pinctrl-names = "default";
		pinctrl-0 = <0x23>;
	};
	scmi-shmem@10f000 {
		compatible = "arm,scmi-shmem";
		reg = <0x0 0x10f000 0x0 0x100>;
		phandle = <0x1e>;
	};
	sata@fc000000 {
		compatible = "snps,dwc-ahci";
		reg = <0x0 0xfc000000 0x0 0x1000>;
		clocks = <0x24 0x96 0x24 0x97 0x24 0x98>;
		clock-names = "sata", "pmalive", "rxoob";
		interrupts = <0x0 0x5e 0x4>;
		interrupt-names = "hostc";
		phys = <0x25 0x1>;
		phy-names = "sata-phy";
		ports-implemented = <0x1>;
		power-domains = <0x26 0xf>;
		status = "okay";
	};
	sata@fc400000 {
		compatible = "snps,dwc-ahci";
		reg = <0x0 0xfc400000 0x0 0x1000>;
		clocks = <0x24 0x9b 0x24 0x9c 0x24 0x9d>;
		clock-names = "sata", "pmalive", "rxoob";
		interrupts = <0x0 0x5f 0x4>;
		interrupt-names = "hostc";
		phys = <0x27 0x1>;
		phy-names = "sata-phy";
		ports-implemented = <0x1>;
		power-domains = <0x26 0xf>;
		status = "disabled";
	};
	sata@fc800000 {
		compatible = "snps,dwc-ahci";
		reg = <0x0 0xfc800000 0x0 0x1000>;
		clocks = <0x24 0xa0 0x24 0xa1 0x24 0xa2>;
		clock-names = "sata", "pmalive", "rxoob";
		interrupts = <0x0 0x60 0x4>;
		interrupt-names = "hostc";
		phys = <0x28 0x1>;
		phy-names = "sata-phy";
		ports-implemented = <0x1>;
		power-domains = <0x26 0xf>;
		status = "disabled";
	};
	usbdrd {
		compatible = "rockchip,rk3568-dwc3", "rockchip,rk3399-dwc3";
		clocks = <0x24 0xa6 0x24 0xa7 0x24 0xa5 0x24 0x7f>;
		clock-names = "ref_clk", "suspend_clk", "bus_clk", "pipe_clk";
		#address-cells = <0x2>;
		#size-cells = <0x2>;
		ranges;
		status = "okay";
		dwc3@fcc00000 {
			compatible = "snps,dwc3";
			reg = <0x0 0xfcc00000 0x0 0x400000>;
			interrupts = <0x0 0xa9 0x4>;
			dr_mode = "otg";
			phys = <0x29>;
			phy-names = "usb2-phy";
			phy_type = "utmi_wide";
			power-domains = <0x26 0xf>;
			resets = <0x24 0x94>;
			reset-names = "usb3-otg";
			snps,dis_enblslpm_quirk;
			snps,dis-u1-entry-quirk;
			snps,dis-u2-entry-quirk;
			snps,dis-u2-freeclk-exists-quirk;
			snps,dis-del-phy-power-chg-quirk;
			snps,dis-tx-ipgap-linecheck-quirk;
			snps,dis_rxdet_inp3_quirk;
			snps,xhci-trb-ent-quirk;
			snps,parkmode-disable-hs-quirk;
			snps,parkmode-disable-ss-quirk;
			quirk-skip-phy-init;
			status = "okay";
			extcon = <0x2a>;
			maximum-speed = "high-speed";
			snps,dis_u2_susphy_quirk;
		};
	};
	usbhost {
		compatible = "rockchip,rk3568-dwc3", "rockchip,rk3399-dwc3";
		clocks = <0x24 0xa9 0x24 0xaa 0x24 0xa8 0x24 0x7f>;
		clock-names = "ref_clk", "suspend_clk", "bus_clk", "pipe_clk";
		#address-cells = <0x2>;
		#size-cells = <0x2>;
		ranges;
		status = "okay";
		dwc3@fd000000 {
			compatible = "snps,dwc3";
			reg = <0x0 0xfd000000 0x0 0x400000>;
			interrupts = <0x0 0xaa 0x4>;
			dr_mode = "host";
			phys = <0x2b 0x27 0x4>;
			phy-names = "usb2-phy", "usb3-phy";
			phy_type = "utmi_wide";
			power-domains = <0x26 0xf>;
			resets = <0x24 0x95>;
			reset-names = "usb3-host";
			snps,dis_enblslpm_quirk;
			snps,dis-u2-freeclk-exists-quirk;
			snps,dis-del-phy-power-chg-quirk;
			snps,dis-tx-ipgap-linecheck-quirk;
			snps,dis_rxdet_inp3_quirk;
			snps,xhci-trb-ent-quirk;
			snps,parkmode-disable-hs-quirk;
			snps,parkmode-disable-ss-quirk;
			status = "okay";
		};
	};
	interrupt-controller@fd400000 {
		compatible = "arm,gic-v3";
		#interrupt-cells = <0x3>;
		#address-cells = <0x2>;
		#size-cells = <0x2>;
		ranges;
		interrupt-controller;
		reg = <0x0 0xfd400000 0x0 0x10000 0x0 0xfd460000 0x0 0xc0000>;
		interrupts = <0x1 0x9 0x4>;
		phandle = <0x1>;
		interrupt-controller@fd440000 {
			compatible = "arm,gic-v3-its";
			msi-controller;
			#msi-cells = <0x1>;
			reg = <0x0 0xfd440000 0x0 0x20000>;
			phandle = <0xba>;
		};
	};
	usb@fd800000 {
		compatible = "generic-ehci";
		reg = <0x0 0xfd800000 0x0 0x40000>;
		interrupts = <0x0 0x82 0x4>;
		clocks = <0x24 0xbd 0x24 0xbe 0x24 0xbc 0x2c>;
		clock-names = "usbhost", "arbiter", "pclk", "utmi";
		phys = <0x2d>;
		phy-names = "usb2-phy";
		status = "okay";
	};
	usb@fd840000 {
		compatible = "generic-ohci";
		reg = <0x0 0xfd840000 0x0 0x40000>;
		interrupts = <0x0 0x83 0x4>;
		clocks = <0x24 0xbd 0x24 0xbe 0x24 0xbc 0x2c>;
		clock-names = "usbhost", "arbiter", "pclk", "utmi";
		phys = <0x2d>;
		phy-names = "usb2-phy";
		status = "okay";
	};
	usb@fd880000 {
		compatible = "generic-ehci";
		reg = <0x0 0xfd880000 0x0 0x40000>;
		interrupts = <0x0 0x85 0x4>;
		clocks = <0x24 0xbf 0x24 0xc0 0x24 0xbc 0x2c>;
		clock-names = "usbhost", "arbiter", "pclk", "utmi";
		phys = <0x2e>;
		phy-names = "usb2-phy";
		status = "okay";
	};
	usb@fd8c0000 {
		compatible = "generic-ohci";
		reg = <0x0 0xfd8c0000 0x0 0x40000>;
		interrupts = <0x0 0x86 0x4>;
		clocks = <0x24 0xbf 0x24 0xc0 0x24 0xbc 0x2c>;
		clock-names = "usbhost", "arbiter", "pclk", "utmi";
		phys = <0x2e>;
		phy-names = "usb2-phy";
		status = "okay";
	};
	syscon@fda00000 {
		compatible = "rockchip,rk3568-xpcs", "syscon";
		reg = <0x0 0xfda00000 0x0 0x200000>;
		status = "disabled";
	};
	syscon@fdc20000 {
		compatible = "rockchip,rk3568-pmugrf", "syscon", "simple-mfd";
		reg = <0x0 0xfdc20000 0x0 0x10000>;
		phandle = <0x3b>;
		io-domains {
			compatible = "rockchip,rk3568-pmu-io-voltage-domain";
			status = "okay";
			pmuio2-supply = <0x2f>;
			vccio1-supply = <0x30>;
			vccio3-supply = <0x31>;
			vccio4-supply = <0x32>;
			vccio5-supply = <0x33>;
			vccio6-supply = <0x32>;
			vccio7-supply = <0x33>;
		};
		reboot-mode {
			compatible = "syscon-reboot-mode";
			offset = <0x200>;
			mode-bootloader = <0x5242c301>;
			mode-charge = <0x5242c30b>;
			mode-fastboot = <0x5242c309>;
			mode-loader = <0x5242c301>;
			mode-normal = <0x5242c300>;
			mode-recovery = <0x5242c303>;
			mode-ums = <0x5242c30c>;
			mode-panic = <0x5242c307>;
			mode-watchdog = <0x5242c308>;
		};
	};
	syscon@fdc50000 {
		compatible = "rockchip,rk3568-pipegrf", "syscon";
		reg = <0x0 0xfdc50000 0x0 0x1000>;
		phandle = <0x122>;
	};
	syscon@fdc60000 {
		compatible = "rockchip,rk3568-grf", "syscon", "simple-mfd";
		reg = <0x0 0xfdc60000 0x0 0x10000>;
		phandle = <0x3a>;
		io-domains {
			compatible = "rockchip,rk3568-io-voltage-domain";
			status = "disabled";
		};
		lvds {
			compatible = "rockchip,rk3568-lvds";
			phys = <0x34>;
			phy-names = "phy";
			status = "disabled";
			ports {
				#address-cells = <0x1>;
				#size-cells = <0x0>;
				port@0 {
					reg = <0x0>;
					#address-cells = <0x1>;
					#size-cells = <0x0>;
					endpoint@1 {
						reg = <0x1>;
						remote-endpoint = <0x1b>;
						status = "disabled";
						phandle = <0x9a>;
					};
					endpoint@2 {
						reg = <0x2>;
						remote-endpoint = <0x35>;
						status = "disabled";
						phandle = <0x9c>;
					};
				};
			};
		};
		lvds1 {
			compatible = "rockchip,rk3568-lvds";
			phys = <0x36>;
			phy-names = "phy";
			status = "disabled";
			ports {
				#address-cells = <0x1>;
				#size-cells = <0x0>;
				port@0 {
					reg = <0x0>;
					#address-cells = <0x1>;
					#size-cells = <0x0>;
					endpoint@0 {
						reg = <0x0>;
						remote-endpoint = <0x37>;
						phandle = <0x9b>;
					};
					endpoint@1 {
						reg = <0x1>;
						remote-endpoint = <0x1c>;
						phandle = <0x9e>;
					};
				};
			};
		};
		rgb {
			compatible = "rockchip,rk3568-rgb";
			pinctrl-names = "default";
			pinctrl-0 = <0x38>;
			status = "disabled";
			ports {
				#address-cells = <0x1>;
				#size-cells = <0x0>;
				port@0 {
					reg = <0x0>;
					#address-cells = <0x1>;
					#size-cells = <0x0>;
					endpoint@2 {
						reg = <0x2>;
						remote-endpoint = <0x1d>;
						status = "disabled";
						phandle = <0x9d>;
					};
				};
			};
		};
	};
	syscon@fdc70000 {
		compatible = "rockchip,pipe-phy-grf", "syscon";
		reg = <0x0 0xfdc70000 0x0 0x1000>;
		phandle = <0x123>;
	};
	syscon@fdc80000 {
		compatible = "rockchip,pipe-phy-grf", "syscon";
		reg = <0x0 0xfdc80000 0x0 0x1000>;
		phandle = <0x124>;
	};
	syscon@fdc90000 {
		compatible = "rockchip,pipe-phy-grf", "syscon";
		reg = <0x0 0xfdc90000 0x0 0x1000>;
		phandle = <0x125>;
	};
	syscon@fdca0000 {
		compatible = "rockchip,rk3568-usb2phy-grf", "syscon";
		reg = <0x0 0xfdca0000 0x0 0x8000>;
		phandle = <0x12a>;
	};
	syscon@fdca8000 {
		compatible = "rockchip,rk3568-usb2phy-grf", "syscon";
		reg = <0x0 0xfdca8000 0x0 0x8000>;
		phandle = <0x12d>;
	};
	syscon@fdcb0000 {
		compatible = "rockchip,rk3568-edp-phy-grf", "syscon", "simple-mfd";
		reg = <0x0 0xfdcb0000 0x0 0x100>;
		clocks = <0x24 0x192>;
		edp-phy {
			compatible = "rockchip,rk3568-edp-phy";
			clocks = <0x39 0x29>;
			clock-names = "refclk";
			#phy-cells = <0x0>;
			status = "disabled";
			phandle = <0xaa>;
		};
	};
	syscon@fdcb8000 {
		compatible = "rockchip,pcie30-phy-grf", "syscon";
		reg = <0x0 0xfdcb8000 0x0 0x10000>;
		phandle = <0x12e>;
	};
	sram@fdcc0000 {
		compatible = "mmio-sram";
		reg = <0x0 0xfdcc0000 0x0 0xb000>;
		#address-cells = <0x1>;
		#size-cells = <0x1>;
		ranges = <0x0 0x0 0xfdcc0000 0xb000>;
		rkvdec-sram@0 {
			reg = <0x0 0xb000>;
			phandle = <0x7d>;
		};
	};
	clock-controller@fdd00000 {
		compatible = "rockchip,rk3568-pmucru";
		reg = <0x0 0xfdd00000 0x0 0x1000>;
		rockchip,grf = <0x3a>;
		rockchip,pmugrf = <0x3b>;
		#clock-cells = <0x1>;
		#reset-cells = <0x1>;
		assigned-clocks = <0x39 0x32>;
		assigned-clock-parents = <0x39 0x5>;
		phandle = <0x39>;
	};
	clock-controller@fdd20000 {
		compatible = "rockchip,rk3568-cru";
		reg = <0x0 0xfdd20000 0x0 0x1000>;
		rockchip,grf = <0x3a>;
		#clock-cells = <0x1>;
		#reset-cells = <0x1>;
		assigned-clocks = <0x39 0x5 0x24 0x106 0x24 0x10b 0x39 0x1 0x39 0x2b 0x24 0x3 0x24 0x19b 0x24 0x9 0x24 0x19c 0x24 0x19d 0x24 0x1a1 0x24 0x19e 0x24 0x19f 0x24 0x1a0 0x24 0x4 0x24 0x10d 0x24 0x10e 0x24 0x173 0x24 0x174 0x24 0x175 0x24 0x176 0x24 0xc9 0x24 0xca 0x24 0x6 0x24 0x7e 0x24 0x7f 0x24 0x3d 0x24 0x41 0x24 0x45 0x24 0x49 0x24 0x4d 0x24 0x4d 0x24 0x55 0x24 0x51 0x24 0x5d 0x24 0xdd>;
		assigned-clock-rates = <0x8000 0x11e1a300 0x11e1a300 0xbebc200 0x5f5e100 0x3b9aca00 0x1dcd6500 0x13d92d40 0xee6b280 0x7735940 0x5f5e100 0x3b9aca0 0x2faf080 0x17d7840 0x46cf7100 0x8f0d180 0x5f5e100 0x1dcd6500 0x17d78400 0x8f0d180 0x5f5e100 0x11e1a300 0x8f0d180 0x47868c00 0x17d78400 0x5f5e100 0x46cf7100 0x46cf7100 0x46cf7100 0x46cf7100 0x46cf7100 0x46cf7100 0x46cf7100 0x46cf7100 0x46cf7100 0x1dcd6500>;
		assigned-clock-parents = <0x39 0x8 0x24 0x4 0x24 0x4>;
		phandle = <0x24>;
	};
	i2c@fdd40000 {
		compatible = "rockchip,rk3399-i2c";
		reg = <0x0 0xfdd40000 0x0 0x1000>;
		clocks = <0x39 0x7 0x39 0x2d>;
		clock-names = "i2c", "pclk";
		interrupts = <0x0 0x2e 0x4>;
		pinctrl-names = "default";
		pinctrl-0 = <0x3c>;
		#address-cells = <0x1>;
		#size-cells = <0x0>;
		status = "okay";
		tcs4525@1c {
			compatible = "tcs,tcs4525";
			reg = <0x1c>;
			vin-supply = <0x3d>;
			regulator-compatible = "fan53555-reg";
			regulator-name = "vdd_cpu";
			regulator-min-microvolt = <0xadf34>;
			regulator-max-microvolt = <0x1535b0>;
			regulator-init-microvolt = <0xdbba0>;
			regulator-ramp-delay = <0x8fc>;
			fcs,suspend-voltage-selector = <0x1>;
			regulator-boot-on;
			regulator-always-on;
			phandle = <0x5>;
			regulator-state-mem {
				regulator-off-in-suspend;
			};
		};
		pmic@20 {
			compatible = "rockchip,rk809";
			reg = <0x20>;
			interrupt-parent = <0x3e>;
			interrupts = <0x3 0x8>;
			pinctrl-names = "default", "pmic-sleep", "pmic-power-off", "pmic-reset";
			pinctrl-0 = <0x3f>;
			pinctrl-1 = <0x40 0x41>;
			pinctrl-2 = <0x42 0x43>;
			pinctrl-3 = <0x42 0x44>;
			rockchip,system-power-controller;
			wakeup-source;
			#clock-cells = <0x1>;
			clock-output-names = "rk808-clkout1", "rk808-clkout2";
			pmic-reset-func = <0x0>;
			not-save-power-en = <0x1>;
			vcc1-supply = <0x45>;
			vcc2-supply = <0x45>;
			vcc3-supply = <0x45>;
			vcc4-supply = <0x45>;
			vcc5-supply = <0x45>;
			vcc6-supply = <0x45>;
			vcc7-supply = <0x45>;
			vcc8-supply = <0x45>;
			vcc9-supply = <0x45>;
			phandle = <0x146>;
			pwrkey {
				status = "okay";
			};
			pinctrl_rk8xx {
				gpio-controller;
				#gpio-cells = <0x2>;
				rk817_slppin_null {
					pins = "gpio_slp";
					function = "pin_fun0";
				};
				rk817_slppin_slp {
					pins = "gpio_slp";
					function = "pin_fun1";
					phandle = <0x41>;
				};
				rk817_slppin_pwrdn {
					pins = "gpio_slp";
					function = "pin_fun2";
					phandle = <0x43>;
				};
				rk817_slppin_rst {
					pins = "gpio_slp";
					function = "pin_fun3";
					phandle = <0x44>;
				};
			};
			regulators {
				DCDC_REG1 {
					regulator-always-on;
					regulator-boot-on;
					regulator-min-microvolt = <0x7a120>;
					regulator-max-microvolt = <0x149970>;
					regulator-init-microvolt = <0xdbba0>;
					regulator-ramp-delay = <0x1771>;
					regulator-initial-mode = <0x2>;
					regulator-name = "vdd_logic";
					phandle = <0x6e>;
					regulator-state-mem {
						regulator-off-in-suspend;
					};
				};
				DCDC_REG2 {
					regulator-always-on;
					regulator-boot-on;
					regulator-min-microvolt = <0x7a120>;
					regulator-max-microvolt = <0x149970>;
					regulator-init-microvolt = <0xdbba0>;
					regulator-ramp-delay = <0x1771>;
					regulator-initial-mode = <0x2>;
					regulator-name = "vdd_gpu";
					phandle = <0x70>;
					regulator-state-mem {
						regulator-off-in-suspend;
					};
				};
				DCDC_REG3 {
					regulator-always-on;
					regulator-boot-on;
					regulator-initial-mode = <0x2>;
					regulator-name = "vcc_ddr";
					regulator-state-mem {
						regulator-on-in-suspend;
					};
				};
				DCDC_REG4 {
					regulator-always-on;
					regulator-boot-on;
					regulator-min-microvolt = <0x7a120>;
					regulator-max-microvolt = <0x149970>;
					regulator-init-microvolt = <0xdbba0>;
					regulator-ramp-delay = <0x1771>;
					regulator-initial-mode = <0x2>;
					regulator-name = "vdd_npu";
					phandle = <0x6a>;
					regulator-state-mem {
						regulator-off-in-suspend;
					};
				};
				LDO_REG1 {
					regulator-boot-on;
					regulator-always-on;
					regulator-min-microvolt = <0xdbba0>;
					regulator-max-microvolt = <0xdbba0>;
					regulator-name = "vdda0v9_image";
					regulator-state-mem {
						regulator-off-in-suspend;
					};
				};
				LDO_REG2 {
					regulator-always-on;
					regulator-boot-on;
					regulator-min-microvolt = <0xdbba0>;
					regulator-max-microvolt = <0xdbba0>;
					regulator-name = "vdda_0v9";
					regulator-state-mem {
						regulator-off-in-suspend;
					};
				};
				LDO_REG3 {
					regulator-always-on;
					regulator-boot-on;
					regulator-min-microvolt = <0xdbba0>;
					regulator-max-microvolt = <0xdbba0>;
					regulator-name = "vdda0v9_pmu";
					regulator-state-mem {
						regulator-on-in-suspend;
						regulator-suspend-microvolt = <0xdbba0>;
					};
				};
				LDO_REG4 {
					regulator-always-on;
					regulator-boot-on;
					regulator-min-microvolt = <0x2dc6c0>;
					regulator-max-microvolt = <0x2dc6c0>;
					regulator-name = "vccio_acodec";
					phandle = <0x30>;
					regulator-state-mem {
						regulator-off-in-suspend;
					};
				};
				LDO_REG5 {
					regulator-always-on;
					regulator-boot-on;
					regulator-min-microvolt = <0x1b7740>;
					regulator-max-microvolt = <0x325aa0>;
					regulator-name = "vccio_sd";
					phandle = <0x31>;
					regulator-state-mem {
						regulator-off-in-suspend;
					};
				};
				LDO_REG6 {
					regulator-always-on;
					regulator-boot-on;
					regulator-min-microvolt = <0x325aa0>;
					regulator-max-microvolt = <0x325aa0>;
					regulator-name = "vcc3v3_pmu";
					phandle = <0x2f>;
					regulator-state-mem {
						regulator-on-in-suspend;
						regulator-suspend-microvolt = <0x325aa0>;
					};
				};
				LDO_REG7 {
					regulator-always-on;
					regulator-boot-on;
					regulator-min-microvolt = <0x1b7740>;
					regulator-max-microvolt = <0x1b7740>;
					regulator-name = "vcca_1v8";
					phandle = <0x121>;
					regulator-state-mem {
						regulator-off-in-suspend;
					};
				};
				LDO_REG8 {
					regulator-always-on;
					regulator-boot-on;
					regulator-min-microvolt = <0x1b7740>;
					regulator-max-microvolt = <0x1b7740>;
					regulator-name = "vcca1v8_pmu";
					regulator-state-mem {
						regulator-on-in-suspend;
						regulator-suspend-microvolt = <0x1b7740>;
					};
				};
				LDO_REG9 {
					regulator-always-on;
					regulator-boot-on;
					regulator-min-microvolt = <0x1b7740>;
					regulator-max-microvolt = <0x1b7740>;
					regulator-name = "vcca1v8_image";
					regulator-state-mem {
						regulator-off-in-suspend;
					};
				};
				DCDC_REG5 {
					regulator-always-on;
					regulator-boot-on;
					regulator-min-microvolt = <0x1b7740>;
					regulator-max-microvolt = <0x1b7740>;
					regulator-name = "vcc_1v8";
					phandle = <0x32>;
					regulator-state-mem {
						regulator-off-in-suspend;
					};
				};
				SWITCH_REG1 {
					regulator-always-on;
					regulator-boot-on;
					regulator-name = "vcc_3v3";
					phandle = <0x33>;
					regulator-state-mem {
						regulator-off-in-suspend;
					};
				};
				SWITCH_REG2 {
					regulator-always-on;
					regulator-boot-on;
					regulator-name = "vcc3v3_sd";
					phandle = <0xcb>;
					regulator-state-mem {
						regulator-off-in-suspend;
					};
				};
			};
			codec {
				#sound-dai-cells = <0x1>;
				compatible = "rockchip,rk809-codec", "rockchip,rk817-codec";
				clocks = <0x24 0x1a3>;
				clock-names = "mclk";
				assigned-clocks = <0x24 0x1a3 0x24 0x1a6>;
				assigned-clock-rates = <0xbb8000>;
				assigned-clock-parents = <0x24 0x48 0x24 0x48>;
				pinctrl-names = "default";
				pinctrl-0 = <0x46>;
				hp-volume = <0x0>;
				spk-volume = <0x0>;
				mic-in-differential;
				status = "okay";
				rockchip,hp-analog-cfg = <0x16>;
				phandle = <0x140>;
			};
		};
	};
	serial@fdd50000 {
		compatible = "rockchip,rk3568-uart", "snps,dw-apb-uart";
		reg = <0x0 0xfdd50000 0x0 0x100>;
		interrupts = <0x0 0x74 0x4>;
		clocks = <0x39 0xb 0x39 0x2c>;
		clock-names = "baudclk", "apb_pclk";
		reg-shift = <0x2>;
		reg-io-width = <0x4>;
		dmas = <0x47 0x0 0x47 0x1>;
		pinctrl-names = "default";
		pinctrl-0 = <0x48>;
		status = "okay";
	};
	pwm@fdd70000 {
		compatible = "rockchip,rk3568-pwm", "rockchip,rk3328-pwm";
		reg = <0x0 0xfdd70000 0x0 0x10>;
		#pwm-cells = <0x3>;
		pinctrl-names = "active";
		pinctrl-0 = <0x49>;
		clocks = <0x39 0xd 0x39 0x30>;
		clock-names = "pwm", "pclk";
		status = "disabled";
	};
	pwm@fdd70010 {
		compatible = "rockchip,rk3568-pwm", "rockchip,rk3328-pwm";
		reg = <0x0 0xfdd70010 0x0 0x10>;
		#pwm-cells = <0x3>;
		pinctrl-names = "active";
		pinctrl-0 = <0x4a>;
		clocks = <0x39 0xd 0x39 0x30>;
		clock-names = "pwm", "pclk";
		status = "disabled";
	};
	pwm@fdd70020 {
		compatible = "rockchip,rk3568-pwm", "rockchip,rk3328-pwm";
		reg = <0x0 0xfdd70020 0x0 0x10>;
		#pwm-cells = <0x3>;
		pinctrl-names = "active";
		pinctrl-0 = <0x4b>;
		clocks = <0x39 0xd 0x39 0x30>;
		clock-names = "pwm", "pclk";
		status = "disabled";
	};
	pwm@fdd70030 {
		compatible = "rockchip,rk3568-pwm", "rockchip,rk3328-pwm";
		reg = <0x0 0xfdd70030 0x0 0x10>;
		interrupts = <0x0 0x52 0x4 0x0 0x56 0x4>;
		#pwm-cells = <0x3>;
		pinctrl-names = "active";
		pinctrl-0 = <0x4c>;
		clocks = <0x39 0xd 0x39 0x30>;
		clock-names = "pwm", "pclk";
		status = "okay";
	};
	power-management@fdd90000 {
		compatible = "rockchip,rk3568-pmu", "syscon", "simple-mfd";
		reg = <0x0 0xfdd90000 0x0 0x1000>;
		power-controller {
			compatible = "rockchip,rk3568-power-controller";
			#power-domain-cells = <0x1>;
			#address-cells = <0x1>;
			#size-cells = <0x0>;
			status = "okay";
			phandle = <0x26>;
			pd_npu@6 {
				reg = <0x6>;
				clocks = <0x24 0x27 0x24 0x25 0x24 0x26>;
				pm_qos = <0x4d>;
			};
			pd_gpu@7 {
				reg = <0x7>;
				clocks = <0x24 0x19 0x24 0x1a>;
				pm_qos = <0x4e>;
			};
			pd_vi@8 {
				reg = <0x8>;
				clocks = <0x24 0xcc 0x24 0xcd>;
				pm_qos = <0x4f 0x50 0x51>;
			};
			pd_vo@9 {
				reg = <0x9>;
				clocks = <0x24 0xda 0x24 0xdb 0x24 0xdc>;
				pm_qos = <0x52 0x53 0x54>;
			};
			pd_rga@10 {
				reg = <0xa>;
				clocks = <0x24 0xf1 0x24 0xf2>;
				pm_qos = <0x55 0x56 0x57 0x58 0x59 0x5a>;
			};
			pd_vpu@11 {
				reg = <0xb>;
				clocks = <0x24 0xed>;
				pm_qos = <0x5b>;
			};
			pd_rkvdec@13 {
				clocks = <0x24 0x107>;
				reg = <0xd>;
				pm_qos = <0x5c>;
			};
			pd_rkvenc@14 {
				reg = <0xe>;
				clocks = <0x24 0x102>;
				pm_qos = <0x5d 0x5e 0x5f>;
			};
			pd_pipe@15 {
				reg = <0xf>;
				clocks = <0x24 0x7f>;
				pm_qos = <0x60 0x61 0x62 0x63 0x64 0x65 0x66 0x67>;
			};
		};
	};
	pvtm@fde00000 {
		compatible = "rockchip,rk3568-core-pvtm";
		reg = <0x0 0xfde00000 0x0 0x100>;
		#address-cells = <0x1>;
		#size-cells = <0x0>;
		pvtm@0 {
			reg = <0x0>;
			clocks = <0x24 0x13 0x24 0x1c2>;
			clock-names = "clk", "pclk";
			resets = <0x24 0x1a 0x24 0x19>;
			reset-names = "rts", "rst-p";
			thermal-zone = "soc-thermal";
		};
	};
	npu@fde40000 {
		compatible = "rockchip,rk3568-rknpu", "rockchip,rknpu";
		reg = <0x0 0xfde40000 0x0 0x10000>;
		interrupts = <0x0 0x97 0x4>;
		clocks = <0x2 0x2 0x24 0x23 0x24 0x28 0x24 0x29>;
		clock-names = "scmi_clk", "clk", "aclk", "hclk";
		assigned-clocks = <0x24 0x23>;
		assigned-clock-rates = <0x23c34600>;
		resets = <0x24 0x2b 0x24 0x2c>;
		reset-names = "srst_a", "srst_h";
		power-domains = <0x26 0x6>;
		operating-points-v2 = <0x68>;
		iommus = <0x69>;
		status = "okay";
		rknpu-supply = <0x6a>;
	};
	npu-opp-table {
		compatible = "operating-points-v2";
		mbist-vmin = <0xc96a8 0xdbba0 0xe7ef0>;
		nvmem-cells = <0x6b 0x7 0x8 0x6c 0xa 0xb>;
		nvmem-cell-names = "leakage", "pvtm", "mbist-vmin", "opp-info", "specification_serial_number", "remark_spec_serial_number";
		rockchip,supported-hw;
		rockchip,max-volt = <0xf4240>;
		rockchip,temp-hysteresis = <0x1388>;
		rockchip,low-temp = <0x0>;
		rockchip,low-temp-adjust-volt = <0x0 0x3e8 0xc350>;
		rockchip,pvtm-voltage-sel = <0x0 0x14820 0x0 0x14821 0x153d8 0x1 0x153d9 0x16378 0x2 0x16379 0x186a0 0x3>;
		rockchip,pvtm-ch = <0x0 0x5>;
		phandle = <0x68>;
		opp-200000000 {
			opp-supported-hw = <0xfb 0xffff>;
			opp-hz = <0x0 0xbebc200>;
			opp-microvolt = <0xcf850 0xcf850 0xf4240>;
		};
		opp-300000000 {
			opp-supported-hw = <0xfb 0xffff>;
			opp-hz = <0x0 0x11b3dc40>;
			opp-microvolt = <0xcf850 0xcf850 0xf4240>;
		};
		opp-400000000 {
			opp-supported-hw = <0xfb 0xffff>;
			opp-hz = <0x0 0x17d78400>;
			opp-microvolt = <0xcf850 0xcf850 0xf4240>;
		};
		opp-600000000 {
			opp-supported-hw = <0xfb 0xffff>;
			opp-hz = <0x0 0x23c34600>;
			opp-microvolt = <0xcf850 0xcf850 0xf4240>;
		};
		opp-700000000 {
			opp-supported-hw = <0xfb 0xffff>;
			opp-hz = <0x0 0x29b92700>;
			opp-microvolt = <0xd59f8 0xd59f8 0xf4240>;
			opp-microvolt-L0 = <0xd59f8 0xd59f8 0xf4240>;
			opp-microvolt-L1 = <0xcf850 0xcf850 0xf4240>;
			opp-microvolt-L2 = <0xcf850 0xcf850 0xf4240>;
			opp-microvolt-L3 = <0xcf850 0xcf850 0xf4240>;
		};
		opp-800000000 {
			opp-supported-hw = <0xfb 0xffff>;
			opp-hz = <0x0 0x2faf0800>;
			opp-microvolt = <0xe1d48 0xe1d48 0xf4240>;
			opp-microvolt-L0 = <0xe1d48 0xe1d48 0xf4240>;
			opp-microvolt-L1 = <0xdbba0 0xdbba0 0xf4240>;
			opp-microvolt-L2 = <0xd59f8 0xd59f8 0xf4240>;
			opp-microvolt-L3 = <0xd59f8 0xd59f8 0xf4240>;
		};
		opp-900000000 {
			opp-supported-hw = <0xf9 0xffff>;
			opp-hz = <0x0 0x35a4e900>;
			opp-microvolt = <0xee098 0xee098 0xf4240>;
			opp-microvolt-L0 = <0xee098 0xee098 0xf4240>;
			opp-microvolt-L1 = <0xe7ef0 0xe7ef0 0xf4240>;
			opp-microvolt-L2 = <0xe1d48 0xe1d48 0xf4240>;
			opp-microvolt-L3 = <0xdbba0 0xdbba0 0xf4240>;
		};
		opp-1000000000 {
			opp-supported-hw = <0xf9 0xffff>;
			opp-hz = <0x0 0x3b9aca00>;
			opp-microvolt = <0xf4240 0xf4240 0xf4240>;
			opp-microvolt-L0 = <0xf4240 0xf4240 0xf4240>;
			opp-microvolt-L1 = <0xee098 0xee098 0xf4240>;
			opp-microvolt-L2 = <0xe7ef0 0xe7ef0 0xf4240>;
			opp-microvolt-L3 = <0xe1d48 0xe1d48 0xf4240>;
			status = "disabled";
		};
		opp-j-600000000 {
			opp-supported-hw = <0x4 0xffff>;
			opp-hz = <0x0 0x23c34600>;
			opp-microvolt = <0xdbba0 0xdbba0 0xf4240>;
		};
		opp-m-900000000 {
			opp-supported-hw = <0x2 0xffff>;
			opp-hz = <0x0 0x35a4e900>;
			opp-microvolt = <0xe1d48 0xe1d48 0xf4240>;
		};
	};
	bus-npu {
		compatible = "rockchip,rk3568-bus";
		rockchip,busfreq-policy = "clkfreq";
		clocks = <0x2 0x2>;
		clock-names = "bus";
		operating-points-v2 = <0x6d>;
		status = "okay";
		bus-supply = <0x6e>;
		pvtm-supply = <0x5>;
	};
	bus-npu-opp-table {
		compatible = "operating-points-v2";
		opp-shared;
		nvmem-cells = <0x7>;
		nvmem-cell-names = "pvtm";
		rockchip,pvtm-voltage-sel = <0x0 0x14820 0x0 0x14821 0x16378 0x1 0x16379 0x186a0 0x2>;
		rockchip,pvtm-ch = <0x0 0x5>;
		phandle = <0x6d>;
		opp-700000000 {
			opp-hz = <0x0 0x29b92700>;
			opp-microvolt = <0xdbba0>;
			opp-microvolt-L0 = <0xdbba0>;
			opp-microvolt-L1 = <0xd59f8>;
			opp-microvolt-L2 = <0xd59f8>;
		};
		opp-900000000 {
			opp-hz = <0x0 0x35a4e900>;
			opp-microvolt = <0xdbba0>;
		};
		opp-1000000000 {
			opp-hz = <0x0 0x3b9aca00>;
			opp-microvolt = <0xe7ef0>;
			opp-microvolt-L0 = <0xe7ef0>;
			opp-microvolt-L1 = <0xe1d48>;
			opp-microvolt-L2 = <0xdbba0>;
		};
	};
	iommu@fde4b000 {
		compatible = "rockchip,iommu-v2";
		reg = <0x0 0xfde4b000 0x0 0x40>;
		interrupts = <0x0 0x97 0x4>;
		interrupt-names = "rknpu_mmu";
		clocks = <0x24 0x28 0x24 0x29>;
		clock-names = "aclk", "iface";
		power-domains = <0x26 0x6>;
		#iommu-cells = <0x0>;
		status = "okay";
		phandle = <0x69>;
	};
	gpu@fde60000 {
		compatible = "arm,mali-bifrost";
		reg = <0x0 0xfde60000 0x0 0x4000>;
		interrupts = <0x0 0x27 0x4 0x0 0x29 0x4 0x0 0x28 0x4>;
		interrupt-names = "GPU", "MMU", "JOB";
		upthreshold = <0x28>;
		downdifferential = <0xa>;
		clocks = <0x2 0x1 0x24 0x1b>;
		clock-names = "clk_mali", "clk_gpu";
		power-domains = <0x26 0x7>;
		#cooling-cells = <0x2>;
		operating-points-v2 = <0x6f>;
		status = "okay";
		mali-supply = <0x70>;
		phandle = <0x22>;
		power-model {
			compatible = "simple-power-model";
			leakage-range = <0x5 0xf>;
			ls = <0xffffa23e 0x5927 0x0>;
			static-coefficient = <0x186a0>;
			dynamic-coefficient = <0x3b9>;
			ts = <0xfffe56a6 0xf87a 0xfffffab5 0x14>;
			thermal-zone = "gpu-thermal";
		};
	};
	opp-table2 {
		compatible = "operating-points-v2";
		mbist-vmin = <0xc96a8 0xdbba0 0xe7ef0>;
		nvmem-cells = <0x71 0x7 0x8 0x72 0xa 0xb>;
		nvmem-cell-names = "leakage", "pvtm", "mbist-vmin", "opp-info", "specification_serial_number", "remark_spec_serial_number";
		rockchip,supported-hw;
		rockchip,max-volt = <0xf4240>;
		rockchip,temp-hysteresis = <0x1388>;
		rockchip,low-temp = <0x0>;
		rockchip,low-temp-adjust-volt = <0x0 0x320 0xc350>;
		rockchip,pvtm-voltage-sel = <0x0 0x14820 0x0 0x14821 0x153d8 0x1 0x153d9 0x16378 0x2 0x16379 0x186a0 0x3>;
		rockchip,pvtm-ch = <0x0 0x5>;
		phandle = <0x6f>;
		opp-200000000 {
			opp-supported-hw = <0xfb 0xffff>;
			opp-hz = <0x0 0xbebc200>;
			opp-microvolt = <0xcf850 0xcf850 0xf4240>;
		};
		opp-300000000 {
			opp-supported-hw = <0xfb 0xffff>;
			opp-hz = <0x0 0x11e1a300>;
			opp-microvolt = <0xcf850 0xcf850 0xf4240>;
		};
		opp-400000000 {
			opp-supported-hw = <0xfb 0xffff>;
			opp-hz = <0x0 0x17d78400>;
			opp-microvolt = <0xcf850 0xcf850 0xf4240>;
		};
		opp-600000000 {
			opp-supported-hw = <0xfb 0xffff>;
			opp-hz = <0x0 0x23c34600>;
			opp-microvolt = <0xdbba0 0xdbba0 0xf4240>;
			opp-microvolt-L0 = <0xdbba0 0xdbba0 0xf4240>;
			opp-microvolt-L1 = <0xd59f8 0xd59f8 0xf4240>;
			opp-microvolt-L2 = <0xcf850 0xcf850 0xf4240>;
			opp-microvolt-L3 = <0xcf850 0xcf850 0xf4240>;
		};
		opp-700000000 {
			opp-supported-hw = <0xfb 0xffff>;
			opp-hz = <0x0 0x29b92700>;
			opp-microvolt = <0xe7ef0 0xe7ef0 0xf4240>;
			opp-microvolt-L0 = <0xe7ef0 0xe7ef0 0xf4240>;
			opp-microvolt-L1 = <0xe1d48 0xe1d48 0xf4240>;
			opp-microvolt-L2 = <0xdbba0 0xdbba0 0xf4240>;
			opp-microvolt-L3 = <0xd59f8 0xd59f8 0xf4240>;
		};
		opp-800000000 {
			opp-supported-hw = <0xf9 0xffff>;
			opp-hz = <0x0 0x2faf0800>;
			opp-microvolt = <0xf4240 0xf4240 0xf4240>;
			opp-microvolt-L0 = <0xf4240 0xf4240 0xf4240>;
			opp-microvolt-L1 = <0xee098 0xee098 0xf4240>;
			opp-microvolt-L2 = <0xe7ef0 0xe7ef0 0xf4240>;
			opp-microvolt-L3 = <0xe1d48 0xe1d48 0xf4240>;
		};
		opp-j-600000000 {
			opp-supported-hw = <0x4 0xffff>;
			opp-hz = <0x0 0x23c34600>;
			opp-microvolt = <0xdbba0 0xdbba0 0xf4240>;
		};
		opp-m-800000000 {
			opp-supported-hw = <0x2 0xffff>;
			opp-hz = <0x0 0x2faf0800>;
			opp-microvolt = <0xe7ef0 0xe7ef0 0xf4240>;
		};
	};
	pvtm@fde80000 {
		compatible = "rockchip,rk3568-gpu-pvtm";
		reg = <0x0 0xfde80000 0x0 0x100>;
		#address-cells = <0x1>;
		#size-cells = <0x0>;
		pvtm@1 {
			reg = <0x1>;
			clocks = <0x24 0x1e 0x24 0x1d>;
			clock-names = "clk", "pclk";
			resets = <0x24 0x24 0x24 0x23>;
			reset-names = "rts", "rst-p";
			thermal-zone = "gpu-thermal";
		};
	};
	pvtm@fde90000 {
		compatible = "rockchip,rk3568-npu-pvtm";
		reg = <0x0 0xfde90000 0x0 0x100>;
		#address-cells = <0x1>;
		#size-cells = <0x0>;
		pvtm@2 {
			reg = <0x2>;
			clocks = <0x24 0x2b 0x24 0x2a 0x24 0x25>;
			clock-names = "clk", "pclk", "hclk";
			resets = <0x24 0x2e 0x24 0x2d>;
			reset-names = "rts", "rst-p";
			thermal-zone = "soc-thermal";
		};
	};
	vdpu@fdea0400 {
		compatible = "rockchip,vpu-decoder-v2";
		reg = <0x0 0xfdea0400 0x0 0x400>;
		interrupts = <0x0 0x8b 0x4>;
		interrupt-names = "irq_dec";
		clocks = <0x24 0xee 0x24 0xef>;
		clock-names = "aclk_vcodec", "hclk_vcodec";
		resets = <0x24 0x11a 0x24 0x11b>;
		reset-names = "video_a", "video_h";
		iommus = <0x73>;
		power-domains = <0x26 0xb>;
		rockchip,srv = <0x74>;
		rockchip,taskqueue-node = <0x0>;
		rockchip,resetgroup-node = <0x0>;
		status = "okay";
	};
	iommu@fdea0800 {
		compatible = "rockchip,iommu-v2";
		reg = <0x0 0xfdea0800 0x0 0x40>;
		interrupts = <0x0 0x8a 0x4>;
		interrupt-names = "vdpu_mmu";
		clock-names = "aclk", "iface";
		clocks = <0x24 0xee 0x24 0xef>;
		power-domains = <0x26 0xb>;
		#iommu-cells = <0x0>;
		status = "okay";
		phandle = <0x73>;
	};
	rk_rga@fdeb0000 {
		compatible = "rockchip,rga2";
		reg = <0x0 0xfdeb0000 0x0 0x1000>;
		interrupts = <0x0 0x5a 0x4>;
		clocks = <0x24 0xf3 0x24 0xf4 0x24 0xf5>;
		clock-names = "aclk_rga", "hclk_rga", "clk_rga";
		power-domains = <0x26 0xa>;
		status = "okay";
	};
	ebc@fdec0000 {
		compatible = "rockchip,rk3568-ebc-tcon";
		reg = <0x0 0xfdec0000 0x0 0x5000>;
		interrupts = <0x0 0x11 0x4>;
		clocks = <0x24 0xf9 0x24 0xfa>;
		clock-names = "hclk", "dclk";
		power-domains = <0x26 0xa>;
		rockchip,grf = <0x3a>;
		pinctrl-names = "default";
		pinctrl-0 = <0x75>;
		status = "disabled";
	};
	jpegd@fded0000 {
		compatible = "rockchip,rkv-jpeg-decoder-v1";
		reg = <0x0 0xfded0000 0x0 0x400>;
		interrupts = <0x0 0x3e 0x4>;
		clocks = <0x24 0xfb 0x24 0xfc>;
		clock-names = "aclk_vcodec", "hclk_vcodec";
		rockchip,disable-auto-freq;
		resets = <0x24 0x12c 0x24 0x12d>;
		reset-names = "video_a", "video_h";
		iommus = <0x76>;
		rockchip,srv = <0x74>;
		rockchip,taskqueue-node = <0x1>;
		rockchip,resetgroup-node = <0x1>;
		power-domains = <0x26 0xa>;
		status = "okay";
	};
	iommu@fded0480 {
		compatible = "rockchip,iommu-v2";
		reg = <0x0 0xfded0480 0x0 0x40>;
		interrupts = <0x0 0x3d 0x4>;
		interrupt-names = "jpegd_mmu";
		clock-names = "aclk", "iface";
		clocks = <0x24 0xfb 0x24 0xfc>;
		power-domains = <0x26 0xa>;
		#iommu-cells = <0x0>;
		status = "okay";
		phandle = <0x76>;
	};
	vepu@fdee0000 {
		compatible = "rockchip,vpu-encoder-v2";
		reg = <0x0 0xfdee0000 0x0 0x400>;
		interrupts = <0x0 0x40 0x4>;
		clocks = <0x24 0xfd 0x24 0xfe>;
		clock-names = "aclk_vcodec", "hclk_vcodec";
		rockchip,disable-auto-freq;
		resets = <0x24 0x12e 0x24 0x12f>;
		reset-names = "video_a", "video_h";
		iommus = <0x77>;
		rockchip,srv = <0x74>;
		rockchip,taskqueue-node = <0x2>;
		rockchip,resetgroup-node = <0x2>;
		power-domains = <0x26 0xa>;
		status = "okay";
	};
	iommu@fdee0800 {
		compatible = "rockchip,iommu-v2";
		reg = <0x0 0xfdee0800 0x0 0x40>;
		interrupts = <0x0 0x3f 0x4>;
		interrupt-names = "vepu_mmu";
		clock-names = "aclk", "iface";
		clocks = <0x24 0xfd 0x24 0xfe>;
		power-domains = <0x26 0xa>;
		#iommu-cells = <0x0>;
		status = "okay";
		phandle = <0x77>;
	};
	iep@fdef0000 {
		compatible = "rockchip,iep-v2";
		reg = <0x0 0xfdef0000 0x0 0x500>;
		interrupts = <0x0 0x38 0x4>;
		clocks = <0x24 0xf6 0x24 0xf7 0x24 0xf8>;
		clock-names = "aclk", "hclk", "sclk";
		resets = <0x24 0x127 0x24 0x128 0x24 0x129>;
		reset-names = "rst_a", "rst_h", "rst_s";
		power-domains = <0x26 0xa>;
		rockchip,srv = <0x74>;
		rockchip,taskqueue-node = <0x5>;
		rockchip,resetgroup-node = <0x5>;
		iommus = <0x78>;
		status = "okay";
	};
	iommu@fdef0800 {
		compatible = "rockchip,iommu-v2";
		reg = <0x0 0xfdef0800 0x0 0x100>;
		interrupts = <0x0 0x38 0x4>;
		interrupt-names = "iep_mmu";
		clocks = <0x24 0xf6 0x24 0xf7>;
		clock-names = "aclk", "iface";
		#iommu-cells = <0x0>;
		power-domains = <0x26 0xa>;
		status = "okay";
		phandle = <0x78>;
	};
	eink@fdf00000 {
		compatible = "rockchip,rk3568-eink-tcon";
		reg = <0x0 0xfdf00000 0x0 0x74>;
		interrupts = <0x0 0xb2 0x4>;
		clocks = <0x24 0xff 0x24 0x100>;
		clock-names = "pclk", "hclk";
		status = "disabled";
	};
	rkvenc@fdf40000 {
		compatible = "rockchip,rkv-encoder-v1";
		reg = <0x0 0xfdf40000 0x0 0x400>;
		interrupts = <0x0 0x8c 0x4>;
		interrupt-names = "irq_enc";
		clocks = <0x24 0x103 0x24 0x104 0x24 0x105>;
		clock-names = "aclk_vcodec", "hclk_vcodec", "clk_core";
		rockchip,normal-rates = <0x11b3dc40 0x0 0x11b3dc40>;
		resets = <0x24 0x133 0x24 0x134 0x24 0x135>;
		reset-names = "video_a", "video_h", "video_core";
		assigned-clocks = <0x24 0x103 0x24 0x105>;
		assigned-clock-rates = <0x11b3dc40 0x11b3dc40>;
		iommus = <0x79>;
		node-name = "rkvenc";
		rockchip,srv = <0x74>;
		rockchip,taskqueue-node = <0x3>;
		rockchip,resetgroup-node = <0x3>;
		power-domains = <0x26 0xe>;
		operating-points-v2 = <0x7a>;
		status = "okay";
		venc-supply = <0x6e>;
	};
	rkvenc-opp-table {
		compatible = "operating-points-v2";
		nvmem-cells = <0x7>;
		nvmem-cell-names = "pvtm";
		rockchip,pvtm-voltage-sel = <0x0 0x14820 0x0 0x14821 0x16378 0x1 0x16379 0x186a0 0x2>;
		rockchip,pvtm-ch = <0x0 0x5>;
		phandle = <0x7a>;
		opp-297000000 {
			opp-hz = <0x0 0x11b3dc40>;
			opp-microvolt = <0xdbba0>;
			opp-microvolt-L0 = <0xdbba0>;
			opp-microvolt-L1 = <0xd59f8>;
			opp-microvolt-L2 = <0xd59f8>;
		};
		opp-400000000 {
			opp-hz = <0x0 0x17d78400>;
			opp-microvolt = <0xe7ef0>;
			opp-microvolt-L0 = <0xe7ef0>;
			opp-microvolt-L1 = <0xe1d48>;
			opp-microvolt-L2 = <0xdbba0>;
		};
	};
	iommu@fdf40f00 {
		compatible = "rockchip,iommu-v2";
		reg = <0x0 0xfdf40f00 0x0 0x40 0x0 0xfdf40f40 0x0 0x40>;
		interrupts = <0x0 0x8d 0x4 0x0 0x8e 0x4>;
		interrupt-names = "rkvenc_mmu0", "rkvenc_mmu1";
		clocks = <0x24 0x103 0x24 0x104>;
		clock-names = "aclk", "iface";
		rockchip,disable-mmu-reset;
		rockchip,enable-cmd-retry;
		#iommu-cells = <0x0>;
		power-domains = <0x26 0xe>;
		status = "okay";
		phandle = <0x79>;
	};
	rkvdec@fdf80200 {
		compatible = "rockchip,rkv-decoder-rk3568", "rockchip,rkv-decoder-v2";
		reg = <0x0 0xfdf80200 0x0 0x400 0x0 0xfdf80100 0x0 0x100>;
		reg-names = "regs", "link";
		interrupts = <0x0 0x5b 0x4>;
		interrupt-names = "irq_dec";
		clocks = <0x24 0x108 0x24 0x109 0x24 0x10a 0x24 0x10b 0x24 0x10c>;
		clock-names = "aclk_vcodec", "hclk_vcodec", "clk_cabac", "clk_core", "clk_hevc_cabac";
		rockchip,normal-rates = <0x11b3dc40 0x0 0x11b3dc40 0x11b3dc40 0x23c34600>;
		rockchip,advanced-rates = <0x179a7b00 0x0 0x179a7b00 0x179a7b00 0x23c34600>;
		rockchip,default-max-load = <0x1fe000>;
		resets = <0x24 0x142 0x24 0x143 0x24 0x144 0x24 0x145 0x24 0x146>;
		assigned-clocks = <0x24 0x108 0x24 0x10a 0x24 0x10b 0x24 0x10c>;
		assigned-clock-rates = <0x11b3dc40 0x11b3dc40 0x11b3dc40 0x11b3dc40>;
		reset-names = "video_a", "video_h", "video_cabac", "video_core", "video_hevc_cabac";
		power-domains = <0x26 0xd>;
		operating-points-v2 = <0x7b>;
		vdec-supply = <0x6e>;
		iommus = <0x7c>;
		rockchip,srv = <0x74>;
		rockchip,taskqueue-node = <0x4>;
		rockchip,resetgroup-node = <0x4>;
		rockchip,sram = <0x7d>;
		rockchip,rcb-iova = <0x10000000 0x10000>;
		rockchip,rcb-min-width = <0x200>;
		rockchip,task-capacity = <0x10>;
		status = "okay";
	};
	rkvdec-opp-table {
		compatible = "operating-points-v2";
		nvmem-cells = <0x7e 0x7>;
		nvmem-cell-names = "leakage", "pvtm";
		rockchip,leakage-voltage-sel = <0x1 0x50 0x0 0x51 0xfe 0x1>;
		rockchip,pvtm-voltage-sel = <0x0 0x14820 0x0 0x14821 0x186a0 0x1>;
		rockchip,pvtm-ch = <0x0 0x5>;
		phandle = <0x7b>;
		opp-297000000 {
			opp-hz = <0x0 0x11b3dc40>;
			opp-microvolt = <0xdbba0>;
			opp-microvolt-L0 = <0xdbba0>;
			opp-microvolt-L1 = <0xd59f8>;
		};
		opp-400000000 {
			opp-hz = <0x0 0x17d78400>;
			opp-microvolt = <0xdbba0>;
		};
	};
	iommu@fdf80800 {
		compatible = "rockchip,iommu-v2";
		reg = <0x0 0xfdf80800 0x0 0x40 0x0 0xfdf80840 0x0 0x40>;
		interrupts = <0x0 0x5c 0x4>;
		interrupt-names = "rkvdec_mmu";
		clocks = <0x24 0x108 0x24 0x109>;
		clock-names = "aclk", "iface";
		power-domains = <0x26 0xd>;
		#iommu-cells = <0x0>;
		status = "okay";
		phandle = <0x7c>;
	};
	mipi-csi2-hw@fdfb0000 {
		compatible = "rockchip,rk3568-mipi-csi2-hw";
		reg = <0x0 0xfdfb0000 0x0 0x10000>;
		reg-names = "csihost_regs";
		interrupts = <0x0 0x8 0x4 0x0 0x9 0x4>;
		interrupt-names = "csi-intr1", "csi-intr2";
		clocks = <0x24 0xd5>;
		clock-names = "pclk_csi2host";
		resets = <0x24 0xff>;
		reset-names = "srst_csihost_p";
		status = "okay";
		phandle = <0x1f>;
	};
	rkcif@fdfe0000 {
		compatible = "rockchip,rk3568-cif";
		reg = <0x0 0xfdfe0000 0x0 0x8000>;
		reg-names = "cif_regs";
		interrupts = <0x0 0x92 0x4>;
		interrupt-names = "cif-intr";
		clocks = <0x24 0xce 0x24 0xcf 0x24 0xd0 0x24 0xd1>;
		clock-names = "aclk_cif", "hclk_cif", "dclk_cif", "iclk_cif_g";
		resets = <0x24 0xf7 0x24 0xf8 0x24 0xf9 0x24 0xfb 0x24 0xfa>;
		reset-names = "rst_cif_a", "rst_cif_h", "rst_cif_d", "rst_cif_p", "rst_cif_i";
		assigned-clocks = <0x24 0xd0>;
		assigned-clock-rates = <0x11e1a300>;
		power-domains = <0x26 0x8>;
		rockchip,grf = <0x3a>;
		iommus = <0x7f>;
		status = "disabled";
		phandle = <0x80>;
	};
	iommu@fdfe0800 {
		compatible = "rockchip,iommu-v2";
		reg = <0x0 0xfdfe0800 0x0 0x100>;
		interrupts = <0x0 0x92 0x4>;
		interrupt-names = "cif_mmu";
		clocks = <0x24 0xce 0x24 0xcf>;
		clock-names = "aclk", "iface";
		power-domains = <0x26 0x8>;
		rockchip,disable-mmu-reset;
		#iommu-cells = <0x0>;
		status = "disabled";
		phandle = <0x7f>;
	};
	rkcif_dvp {
		compatible = "rockchip,rkcif-dvp";
		rockchip,hw = <0x80>;
		status = "disabled";
		phandle = <0x81>;
	};
	rkcif_dvp_sditf {
		compatible = "rockchip,rkcif-sditf";
		rockchip,cif = <0x81>;
		status = "disabled";
	};
	rkcif_mipi_lvds {
		compatible = "rockchip,rkcif-mipi-lvds";
		rockchip,hw = <0x80>;
		status = "disabled";
		phandle = <0x82>;
	};
	rkcif_mipi_lvds_sditf {
		compatible = "rockchip,rkcif-sditf";
		rockchip,cif = <0x82>;
		status = "disabled";
	};
	rkisp@fdff0000 {
		compatible = "rockchip,rk3568-rkisp";
		reg = <0x0 0xfdff0000 0x0 0x10000>;
		interrupts = <0x0 0x39 0x4 0x0 0x3a 0x4 0x0 0x3c 0x4>;
		interrupt-names = "mipi_irq", "mi_irq", "isp_irq";
		clocks = <0x24 0xd2 0x24 0xd3 0x24 0xd4>;
		clock-names = "aclk_isp", "hclk_isp", "clk_isp";
		resets = <0x24 0xfd 0x24 0xfc>;
		reset-names = "isp", "isp-h";
		rockchip,grf = <0x3a>;
		power-domains = <0x26 0x8>;
		iommus = <0x83>;
		rockchip,iq-feature = <0x1bfb 0xfffe67ff>;
		status = "okay";
		phandle = <0x84>;
	};
	iommu@fdff1a00 {
		compatible = "rockchip,iommu-v2";
		reg = <0x0 0xfdff1a00 0x0 0x100>;
		interrupts = <0x0 0x3b 0x4>;
		interrupt-names = "isp_mmu";
		clocks = <0x24 0xd2 0x24 0xd3>;
		clock-names = "aclk", "iface";
		power-domains = <0x26 0x8>;
		#iommu-cells = <0x0>;
		rockchip,disable-mmu-reset;
		status = "okay";
		phandle = <0x83>;
	};
	rkisp-vir0 {
		compatible = "rockchip,rkisp-vir";
		rockchip,hw = <0x84>;
		status = "okay";
		port {
			#address-cells = <0x1>;
			#size-cells = <0x0>;
			endpoint@0 {
				reg = <0x0>;
				remote-endpoint = <0x85>;
				phandle = <0x129>;
			};
		};
	};
	rkisp-vir1 {
		compatible = "rockchip,rkisp-vir";
		rockchip,hw = <0x84>;
		status = "disabled";
	};
	uio@fe010000 {
		compatible = "rockchip,uio-gmac";
		reg = <0x0 0xfe010000 0x0 0x10000>;
		rockchip,ethernet = <0x86>;
		status = "disabled";
	};
	ethernet@fe010000 {
		local-mac-address = [1e 3a b9 6d ab f5];
		compatible = "rockchip,rk3568-gmac", "snps,dwmac-4.20a";
		reg = <0x0 0xfe010000 0x0 0x10000>;
		interrupts = <0x0 0x20 0x4 0x0 0x1d 0x4>;
		interrupt-names = "macirq", "eth_wake_irq";
		rockchip,grf = <0x3a>;
		clocks = <0x24 0x186 0x24 0x189 0x24 0x189 0x24 0xc7 0x24 0xc3 0x24 0xc4 0x24 0x189 0x24 0xc8 0x24 0xac 0x24 0xab>;
		clock-names = "stmmaceth", "mac_clk_rx", "mac_clk_tx", "clk_mac_refout", "aclk_mac", "pclk_mac", "clk_mac_speed", "ptp_ref", "pclk_xpcs", "clk_xpcs_eee";
		resets = <0x24 0xec>;
		reset-names = "stmmaceth";
		snps,mixed-burst;
		snps,tso;
		snps,axi-config = <0x87>;
		snps,mtl-rx-config = <0x88>;
		snps,mtl-tx-config = <0x89>;
		status = "okay";
		phy-mode = "rgmii";
		clock_in_out = "output";
		snps,reset-gpio = <0x8a 0x7 0x1>;
		snps,reset-active-low;
		snps,reset-delays-us = <0x0 0x4e20 0x186a0>;
		assigned-clocks = <0x24 0x189 0x24 0x186>;
		assigned-clock-parents = <0x24 0x187 0x24 0xc5>;
		assigned-clock-rates = <0x0 0x7735940>;
		pinctrl-names = "default";
		pinctrl-0 = <0x8b 0x8c 0x8d 0x8e 0x8f>;
		tx_delay = <0x2f>;
		rx_delay = <0x39>;
		phy-handle = <0x90>;
		phandle = <0x86>;
		mdio {
			compatible = "snps,dwmac-mdio";
			#address-cells = <0x1>;
			#size-cells = <0x0>;
			phy@0 {
				compatible = "ethernet-phy-ieee802.3-c22";
				reg = <0x0>;
				phandle = <0x90>;
			};
		};
		stmmac-axi-config {
			snps,wr_osr_lmt = <0x4>;
			snps,rd_osr_lmt = <0x8>;
			snps,blen = <0x0 0x0 0x0 0x0 0x10 0x8 0x4>;
			phandle = <0x87>;
		};
		rx-queues-config {
			snps,rx-queues-to-use = <0x1>;
			phandle = <0x88>;
			queue0 {
			};
		};
		tx-queues-config {
			snps,tx-queues-to-use = <0x1>;
			phandle = <0x89>;
			queue0 {
			};
		};
	};
	vop@fe040000 {
		compatible = "rockchip,rk3568-vop";
		reg = <0x0 0xfe040000 0x0 0x3000 0x0 0xfe044000 0x0 0x1000>;
		reg-names = "regs", "gamma_lut";
		rockchip,grf = <0x3a>;
		interrupts = <0x0 0x94 0x4>;
		clocks = <0x24 0xdd 0x24 0xde 0x24 0xdf 0x24 0xe0 0x24 0xe1>;
		clock-names = "aclk_vop", "hclk_vop", "dclk_vp0", "dclk_vp1", "dclk_vp2";
		iommus = <0x91>;
		power-domains = <0x26 0x9>;
		status = "okay";
		assigned-clocks = <0x24 0xdf 0x24 0xe0 0x24 0xe1>;
		assigned-clock-parents = <0x39 0x2 0x24 0x5 0x24 0x4>;
		disable-win-move;
		ports {
			#address-cells = <0x1>;
			#size-cells = <0x0>;
			phandle = <0x15>;
			port@0 {
				rockchip,primary-plane = <0x5>;
				rockchip,plane-mask = <0x22>;
				#address-cells = <0x1>;
				#size-cells = <0x0>;
				reg = <0x0>;
				endpoint@0 {
					reg = <0x0>;
					remote-endpoint = <0x92>;
					phandle = <0x9f>;
				};
				endpoint@1 {
					reg = <0x1>;
					remote-endpoint = <0x93>;
					phandle = <0x18>;
				};
				endpoint@2 {
					reg = <0x2>;
					remote-endpoint = <0x94>;
					phandle = <0x19>;
				};
				endpoint@3 {
					reg = <0x3>;
					remote-endpoint = <0x95>;
					phandle = <0x1a>;
				};
			};
			port@1 {
				rockchip,primary-plane = <0x4>;
				rockchip,plane-mask = <0x15>;
				#address-cells = <0x1>;
				#size-cells = <0x0>;
				reg = <0x1>;
				endpoint@0 {
					reg = <0x0>;
					remote-endpoint = <0x96>;
					phandle = <0x17>;
				};
				endpoint@1 {
					reg = <0x1>;
					remote-endpoint = <0x97>;
					phandle = <0xa5>;
				};
				endpoint@2 {
					reg = <0x2>;
					remote-endpoint = <0x98>;
					phandle = <0xab>;
				};
				endpoint@3 {
					reg = <0x3>;
					remote-endpoint = <0x99>;
					phandle = <0xa9>;
				};
				endpoint@4 {
					reg = <0x4>;
					remote-endpoint = <0x9a>;
					phandle = <0x1b>;
				};
				endpoint@5 {
					reg = <0x5>;
					remote-endpoint = <0x9b>;
					phandle = <0x37>;
				};
			};
			port@2 {
				rockchip,primary-plane = <0x3>;
				rockchip,plane-mask = <0x8>;
				#address-cells = <0x1>;
				#size-cells = <0x0>;
				reg = <0x2>;
				endpoint@0 {
					reg = <0x0>;
					remote-endpoint = <0x9c>;
					phandle = <0x35>;
				};
				endpoint@1 {
					reg = <0x1>;
					remote-endpoint = <0x9d>;
					phandle = <0x1d>;
				};
				endpoint@2 {
					reg = <0x2>;
					remote-endpoint = <0x9e>;
					phandle = <0x1c>;
				};
			};
		};
	};
	iommu@fe043e00 {
		compatible = "rockchip,iommu-v2";
		reg = <0x0 0xfe043e00 0x0 0x100 0x0 0xfe043f00 0x0 0x100>;
		interrupts = <0x0 0x94 0x4>;
		interrupt-names = "vop_mmu";
		clocks = <0x24 0xdd 0x24 0xde>;
		clock-names = "aclk", "iface";
		#iommu-cells = <0x0>;
		rockchip,disable-device-link-resume;
		status = "okay";
		phandle = <0x91>;
	};
	dsi@fe060000 {
		compatible = "rockchip,rk3568-mipi-dsi";
		reg = <0x0 0xfe060000 0x0 0x10000>;
		interrupts = <0x0 0x44 0x4>;
		clocks = <0x24 0xe8 0x24 0xda>;
		clock-names = "pclk", "hclk";
		resets = <0x24 0x110>;
		reset-names = "apb";
		phys = <0x34>;
		phy-names = "dphy";
		power-domains = <0x26 0x9>;
		rockchip,grf = <0x3a>;
		#address-cells = <0x1>;
		#size-cells = <0x0>;
		status = "okay";
		ports {
			#address-cells = <0x1>;
			#size-cells = <0x0>;
			port@0 {
				reg = <0x0>;
				#address-cells = <0x1>;
				#size-cells = <0x0>;
				endpoint@0 {
					reg = <0x0>;
					remote-endpoint = <0x9f>;
					status = "disabled";
					phandle = <0x92>;
				};
				endpoint@1 {
					reg = <0x1>;
					remote-endpoint = <0x17>;
					status = "okay";
					phandle = <0x96>;
				};
			};
			port@1 {
				reg = <0x1>;
				endpoint {
					remote-endpoint = <0xa0>;
					phandle = <0xa4>;
				};
			};
		};
		panel@0 {
			status = "okay";
			compatible = "simple-panel-dsi";
			reg = <0x0>;
			backlight = <0xa1>;
			power-supply = <0xa2>;
			reset-gpios = <0x8a 0x4 0x1>;
			reset-delay-ms = <0x78>;
			enable-delay-ms = <0x78>;
			prepare-delay-ms = <0x78>;
			init-delay-ms = <0x78>;
			unprepare-delay-ms = <0x3c>;
			disable-delay-ms = <0x3c>;
			dsi,flags = <0xa03>;
			dsi,format = <0x0>;
			dsi,lanes = <0x4>;
			panel-init-sequence = [15 00 02 e0 00 15 00 02 e1 93 15 00 02 e2 65 15 00 02 e3 f8 15 00 02 80 03 15 00 02 e0 01 15 00 02 00 00 15 00 02 01 3b 15 00 02 0c 74 15 00 02 17 00 15 00 02 18 af 15 00 02 19 00 15 00 02 1a 00 15 00 02 1b af 15 00 02 1c 00 15 00 02 35 26 15 00 02 37 09 15 00 02 38 04 15 00 02 39 00 15 00 02 3a 01 15 00 02 3c 78 15 00 02 3d ff 15 00 02 3e ff 15 00 02 3f 7f 15 00 02 40 06 15 00 02 41 a0 15 00 02 42 81 15 00 02 43 14 15 00 02 44 23 15 00 02 45 28 15 00 02 55 02 15 00 02 57 69 15 00 02 59 0a 15 00 02 5a 2a 15 00 02 5b 17 15 00 02 5d 7f 15 00 02 5e 6b 15 00 02 5f 5c 15 00 02 60 4f 15 00 02 61 4d 15 00 02 62 3f 15 00 02 63 42 15 00 02 64 2b 15 00 02 65 44 15 00 02 66 43 15 00 02 67 43 15 00 02 68 63 15 00 02 69 52 15 00 02 6a 5a 15 00 02 6b 4f 15 00 02 6c 4e 15 00 02 6d 20 15 00 02 6e 0f 15 00 02 6f 00 15 00 02 70 7f 15 00 02 71 6b 15 00 02 72 5c 15 00 02 73 4f 15 00 02 74 4d 15 00 02 75 3f 15 00 02 76 42 15 00 02 77 2b 15 00 02 78 44 15 00 02 79 43 15 00 02 7a 43 15 00 02 7b 63 15 00 02 7c 52 15 00 02 7d 5a 15 00 02 7e 4f 15 00 02 7f 4e 15 00 02 80 20 15 00 02 81 0f 15 00 02 82 00 15 00 02 e0 02 15 00 02 00 02 15 00 02 01 02 15 00 02 02 00 15 00 02 03 00 15 00 02 04 1e 15 00 02 05 1e 15 00 02 06 1f 15 00 02 07 1f 15 00 02 08 1f 15 00 02 09 17 15 00 02 0a 17 15 00 02 0b 37 15 00 02 0c 37 15 00 02 0d 47 15 00 02 0e 47 15 00 02 0f 45 15 00 02 10 45 15 00 02 11 4b 15 00 02 12 4b 15 00 02 13 49 15 00 02 14 49 15 00 02 15 1f 15 00 02 16 01 15 00 02 17 01 15 00 02 18 00 15 00 02 19 00 15 00 02 1a 1e 15 00 02 1b 1e 15 00 02 1c 1f 15 00 02 1d 1f 15 00 02 1e 1f 15 00 02 1f 17 15 00 02 20 17 15 00 02 21 37 15 00 02 22 37 15 00 02 23 46 15 00 02 24 46 15 00 02 25 44 15 00 02 26 44 15 00 02 27 4a 15 00 02 28 4a 15 00 02 29 48 15 00 02 2a 48 15 00 02 2b 1f 15 00 02 2c 01 15 00 02 2d 01 15 00 02 2e 00 15 00 02 2f 00 15 00 02 30 1f 15 00 02 31 1f 15 00 02 32 1e 15 00 02 33 1e 15 00 02 34 1f 15 00 02 35 17 15 00 02 36 17 15 00 02 37 37 15 00 02 38 37 15 00 02 39 08 15 00 02 3a 08 15 00 02 3b 0a 15 00 02 3c 0a 15 00 02 3d 04 15 00 02 3e 04 15 00 02 3f 06 15 00 02 40 06 15 00 02 41 1f 15 00 02 42 02 15 00 02 43 02 15 00 02 44 00 15 00 02 45 00 15 00 02 46 1f 15 00 02 47 1f 15 00 02 48 1e 15 00 02 49 1e 15 00 02 4a 1f 15 00 02 4b 17 15 00 02 4c 17 15 00 02 4d 37 15 00 02 4e 37 15 00 02 4f 09 15 00 02 50 09 15 00 02 51 0b 15 00 02 52 0b 15 00 02 53 05 15 00 02 54 05 15 00 02 55 07 15 00 02 56 07 15 00 02 57 1f 15 00 02 58 40 15 00 02 5b 30 15 00 02 5c 16 15 00 02 5d 34 15 00 02 5e 05 15 00 02 5f 02 15 00 02 63 00 15 00 02 64 6a 15 00 02 67 73 15 00 02 68 1d 15 00 02 69 08 15 00 02 6a 6a 15 00 02 6b 08 15 00 02 6c 00 15 00 02 6d 00 15 00 02 6e 00 15 00 02 6f 88 15 00 02 75 ff 15 00 02 77 dd 15 00 02 78 3f 15 00 02 79 15 15 00 02 7a 17 15 00 02 7d 14 15 00 02 7e 82 15 00 02 e0 04 15 00 02 00 0e 15 00 02 02 b3 15 00 02 09 61 15 00 02 0e 48 15 00 02 e0 00 15 00 02 e6 02 15 00 02 e7 0c 05 78 01 11 05 05 01 29 15 00 02 35 00];
			panel-exit-sequence = <0x5000128 0x5000110>;
			display-timings {
				native-mode = <0xa3>;
				timing0 {
					clock-frequency = <0x40d9900>;
					hactive = <0x320>;
					vactive = <0x500>;
					hback-porch = <0x14>;
					hfront-porch = <0x28>;
					vback-porch = <0x14>;
					vfront-porch = <0x14>;
					hsync-len = <0x14>;
					vsync-len = <0x4>;
					hsync-active = <0x0>;
					vsync-active = <0x0>;
					de-active = <0x0>;
					pixelclk-active = <0x0>;
					phandle = <0xa3>;
				};
			};
			ports {
				#address-cells = <0x1>;
				#size-cells = <0x0>;
				port@0 {
					reg = <0x0>;
					endpoint {
						remote-endpoint = <0xa4>;
						phandle = <0xa0>;
					};
				};
			};
		};
	};
	dsi@fe070000 {
		compatible = "rockchip,rk3568-mipi-dsi";
		reg = <0x0 0xfe070000 0x0 0x10000>;
		interrupts = <0x0 0x45 0x4>;
		clocks = <0x24 0xe9 0x24 0xda>;
		clock-names = "pclk", "hclk";
		resets = <0x24 0x111>;
		reset-names = "apb";
		phys = <0x36>;
		phy-names = "dphy";
		power-domains = <0x26 0x9>;
		rockchip,grf = <0x3a>;
		#address-cells = <0x1>;
		#size-cells = <0x0>;
		status = "disabled";
		ports {
			#address-cells = <0x1>;
			#size-cells = <0x0>;
			port@0 {
				reg = <0x0>;
				#address-cells = <0x1>;
				#size-cells = <0x0>;
				endpoint@0 {
					reg = <0x0>;
					remote-endpoint = <0x18>;
					status = "disabled";
					phandle = <0x93>;
				};
				endpoint@1 {
					reg = <0x1>;
					remote-endpoint = <0xa5>;
					status = "disabled";
					phandle = <0x97>;
				};
			};
		};
	};
	hdmi@fe0a0000 {
		compatible = "rockchip,rk3568-dw-hdmi";
		reg = <0x0 0xfe0a0000 0x0 0x20000>;
		interrupts = <0x0 0x2d 0x4>;
		clocks = <0x24 0xe6 0x24 0xe7 0x24 0x193 0x39 0x2 0x24 0xde>;
		clock-names = "iahb", "isfr", "cec", "ref", "hclk";
		power-domains = <0x26 0x9>;
		reg-io-width = <0x4>;
		rockchip,grf = <0x3a>;
		#sound-dai-cells = <0x0>;
		pinctrl-names = "default";
		pinctrl-0 = <0xa6 0xa7 0xa8>;
		status = "okay";
		rockchip,phy-table = <0x58834d4 0x8009 0x0 0x270 0x9d5b340 0x800b 0x0 0x26d 0xb1069a8 0x800b 0x0 0x1ed 0x11b3dc40 0x800b 0x0 0x1ad 0x2367b880 0x8029 0x0 0x88 0x0 0x0 0x0 0x0>;
		phandle = <0x145>;
		ports {
			#address-cells = <0x1>;
			#size-cells = <0x0>;
			port@0 {
				reg = <0x0>;
				#address-cells = <0x1>;
				#size-cells = <0x0>;
				endpoint@0 {
					reg = <0x0>;
					remote-endpoint = <0x1a>;
					status = "okay";
					phandle = <0x95>;
				};
				endpoint@1 {
					reg = <0x1>;
					remote-endpoint = <0xa9>;
					status = "disabled";
					phandle = <0x99>;
				};
			};
		};
	};
	edp@fe0c0000 {
		compatible = "rockchip,rk3568-edp";
		reg = <0x0 0xfe0c0000 0x0 0x10000>;
		interrupts = <0x0 0x12 0x4>;
		clocks = <0x39 0x29 0x24 0xea 0x24 0xeb 0x24 0xda>;
		clock-names = "dp", "pclk", "spdif", "hclk";
		resets = <0x24 0x113 0x24 0x112>;
		reset-names = "dp", "apb";
		phys = <0xaa>;
		phy-names = "dp";
		power-domains = <0x26 0x9>;
		status = "disabled";
		ports {
			#address-cells = <0x1>;
			#size-cells = <0x0>;
			port@0 {
				reg = <0x0>;
				#address-cells = <0x1>;
				#size-cells = <0x0>;
				endpoint@0 {
					reg = <0x0>;
					remote-endpoint = <0x19>;
					status = "disabled";
					phandle = <0x94>;
				};
				endpoint@1 {
					reg = <0x1>;
					remote-endpoint = <0xab>;
					status = "disabled";
					phandle = <0x98>;
				};
			};
		};
	};
	nocp-cpu@fe102000 {
		compatible = "rockchip,rk3568-nocp";
		reg = <0x0 0xfe102000 0x0 0x400>;
		phandle = <0xb1>;
	};
	nocp-gpu-vpu-rga-venc@fe102400 {
		compatible = "rockchip,rk3568-nocp";
		reg = <0x0 0xfe102400 0x0 0x400>;
	};
	nocp-vdec@fe102800 {
		compatible = "rockchip,rk3568-nocp";
		reg = <0x0 0xfe102800 0x0 0x400>;
	};
	nocp-vi-usb-peri-pipe@fe102c00 {
		compatible = "rockchip,rk3568-nocp";
		reg = <0x0 0xfe102c00 0x0 0x400>;
	};
	nocp-vo@fe103000 {
		compatible = "rockchip,rk3568-nocp";
		reg = <0x0 0xfe103000 0x0 0x400>;
	};
	qos@fe128000 {
		compatible = "syscon";
		reg = <0x0 0xfe128000 0x0 0x20>;
		phandle = <0x4e>;
	};
	qos@fe138080 {
		compatible = "syscon";
		reg = <0x0 0xfe138080 0x0 0x20>;
		phandle = <0x5d>;
	};
	qos@fe138100 {
		compatible = "syscon";
		reg = <0x0 0xfe138100 0x0 0x20>;
		phandle = <0x5e>;
	};
	qos@fe138180 {
		compatible = "syscon";
		reg = <0x0 0xfe138180 0x0 0x20>;
		phandle = <0x5f>;
	};
	qos@fe148000 {
		compatible = "syscon";
		reg = <0x0 0xfe148000 0x0 0x20>;
		phandle = <0x4f>;
	};
	qos@fe148080 {
		compatible = "syscon";
		reg = <0x0 0xfe148080 0x0 0x20>;
		phandle = <0x50>;
	};
	qos@fe148100 {
		compatible = "syscon";
		reg = <0x0 0xfe148100 0x0 0x20>;
		phandle = <0x51>;
	};
	qos@fe150000 {
		compatible = "syscon";
		reg = <0x0 0xfe150000 0x0 0x20>;
		phandle = <0x5b>;
	};
	qos@fe158000 {
		compatible = "syscon";
		reg = <0x0 0xfe158000 0x0 0x20>;
		phandle = <0x55>;
	};
	qos@fe158100 {
		compatible = "syscon";
		reg = <0x0 0xfe158100 0x0 0x20>;
		phandle = <0x56>;
	};
	qos@fe158180 {
		compatible = "syscon";
		reg = <0x0 0xfe158180 0x0 0x20>;
		phandle = <0x57>;
	};
	qos@fe158200 {
		compatible = "syscon";
		reg = <0x0 0xfe158200 0x0 0x20>;
		phandle = <0x58>;
	};
	qos@fe158280 {
		compatible = "syscon";
		reg = <0x0 0xfe158280 0x0 0x20>;
		phandle = <0x59>;
	};
	qos@fe158300 {
		compatible = "syscon";
		reg = <0x0 0xfe158300 0x0 0x20>;
		phandle = <0x5a>;
	};
	qos@fe180000 {
		compatible = "syscon";
		reg = <0x0 0xfe180000 0x0 0x20>;
		phandle = <0x4d>;
	};
	qos@fe190000 {
		compatible = "syscon";
		reg = <0x0 0xfe190000 0x0 0x20>;
		phandle = <0x60>;
	};
	qos@fe190080 {
		compatible = "syscon";
		reg = <0x0 0xfe190080 0x0 0x20>;
		phandle = <0x61>;
	};
	qos@fe190100 {
		compatible = "syscon";
		reg = <0x0 0xfe190100 0x0 0x20>;
		phandle = <0x62>;
	};
	qos@fe190200 {
		compatible = "syscon";
		reg = <0x0 0xfe190200 0x0 0x20>;
		phandle = <0x63>;
	};
	qos@fe190280 {
		compatible = "syscon";
		reg = <0x0 0xfe190280 0x0 0x20>;
		phandle = <0x64>;
	};
	qos@fe190300 {
		compatible = "syscon";
		reg = <0x0 0xfe190300 0x0 0x20>;
		phandle = <0x65>;
	};
	qos@fe190380 {
		compatible = "syscon";
		reg = <0x0 0xfe190380 0x0 0x20>;
		phandle = <0x66>;
	};
	qos@fe190400 {
		compatible = "syscon";
		reg = <0x0 0xfe190400 0x0 0x20>;
		phandle = <0x67>;
	};
	qos@fe198000 {
		compatible = "syscon";
		reg = <0x0 0xfe198000 0x0 0x20>;
		phandle = <0x5c>;
	};
	qos@fe1a8000 {
		compatible = "syscon";
		reg = <0x0 0xfe1a8000 0x0 0x20>;
		phandle = <0x52>;
	};
	qos@fe1a8080 {
		compatible = "syscon";
		reg = <0x0 0xfe1a8080 0x0 0x20>;
		phandle = <0x53>;
	};
	qos@fe1a8100 {
		compatible = "syscon";
		reg = <0x0 0xfe1a8100 0x0 0x20>;
		phandle = <0x54>;
	};
	dwmmc@fe000000 {
		compatible = "rockchip,rk3568-dw-mshc", "rockchip,rk3288-dw-mshc";
		reg = <0x0 0xfe000000 0x0 0x4000>;
		interrupts = <0x0 0x64 0x4>;
		max-frequency = <0xbebc200>;
		clocks = <0x24 0xc1 0x24 0xc2 0x24 0x18e 0x24 0x18f>;
		clock-names = "biu", "ciu", "ciu-drive", "ciu-sample";
		fifo-depth = <0x100>;
		resets = <0x24 0xeb>;
		reset-names = "reset";
		status = "okay";
		no-sd;
		no-mmc;
		bus-width = <0x4>;
		disable-wp;
		cap-sd-highspeed;
		cap-sdio-irq;
		keep-power-in-suspend;
		mmc-pwrseq = <0xac>;
		non-removable;
		pinctrl-names = "default";
		pinctrl-0 = <0xad 0xae 0xaf>;
		sd-uhs-sdr104;
	};
	dfi@fe230000 {
		reg = <0x0 0xfe230000 0x0 0x400>;
		compatible = "rockchip,rk3568-dfi";
		rockchip,pmugrf = <0x3b>;
		status = "okay";
		phandle = <0xb0>;
	};
	dmc {
		compatible = "rockchip,rk3568-dmc";
		interrupts = <0x0 0xa 0x4>;
		interrupt-names = "complete";
		devfreq-events = <0xb0 0xb1>;
		clocks = <0x2 0x3>;
		clock-names = "dmc_clk";
		operating-points-v2 = <0xb2>;
		vop-bw-dmc-freq = <0x0 0x11e 0x4f1a0 0x11f 0x1869f 0x80e80>;
		vop-frame-bw-dmc-freq = <0x0 0x26c 0x4f1a0 0x26d 0x1869f 0xbe6e0>;
		cpu-bw-dmc-freq = <0x0 0x15e 0x4f1a0 0x15f 0x190 0x80e80 0x191 0x1869f 0xbe6e0>;
		upthreshold = <0x28>;
		downdifferential = <0x14>;
		system-status-level = <0x1 0x4 0x8 0x8 0x2 0x1 0x10 0x4 0x10000 0x4 0x1000 0x8 0x4000 0x8 0x2000 0x8 0xc00 0x8>;
		auto-min-freq = <0x4f1a0>;
		auto-freq-en = <0x1>;
		#cooling-cells = <0x2>;
		status = "okay";
		center-supply = <0x6e>;
		phandle = <0x16>;
	};
	dmc-fsp {
		compatible = "rockchip,rk3568-dmc-fsp";
		debug_print_level = <0x0>;
		ddr3_params = <0xb3>;
		ddr4_params = <0xb4>;
		lpddr3_params = <0xb5>;
		lpddr4_params = <0xb6>;
		lpddr4x_params = <0xb7>;
		status = "okay";
	};
	dmc-opp-table {
		compatible = "operating-points-v2";
		mbist-vmin = <0xc96a8 0xdbba0 0xe7ef0>;
		nvmem-cells = <0x7e 0x7 0x8 0xb8 0xa 0xb>;
		nvmem-cell-names = "leakage", "pvtm", "mbist-vmin", "opp-info", "specification_serial_number", "remark_spec_serial_number";
		rockchip,supported-hw;
		rockchip,max-volt = <0xf4240>;
		rockchip,temp-hysteresis = <0x1388>;
		rockchip,low-temp = <0x0>;
		rockchip,low-temp-adjust-volt = <0x0 0x618 0x124f8>;
		rockchip,leakage-voltage-sel = <0x1 0x50 0x0 0x51 0xfe 0x1>;
		rockchip,pvtm-voltage-sel = <0x0 0x14820 0x0 0x14821 0x186a0 0x1>;
		rockchip,pvtm-ch = <0x0 0x5>;
		phandle = <0xb2>;
		opp-1560000000 {
			opp-supported-hw = <0xf9 0xffff>;
			opp-hz = <0x0 0x5cfbb600>;
			opp-microvolt = <0xdbba0 0xdbba0 0xf4240>;
			opp-microvolt-L0 = <0xdbba0 0xdbba0 0xf4240>;
			opp-microvolt-L1 = <0xd59f8 0xd59f8 0xf4240>;
		};
		opp-j-m-1560000000 {
			opp-supported-hw = <0x6 0xffff>;
			opp-hz = <0x0 0x5cfbb600>;
			opp-microvolt = <0xd59f8 0xd59f8 0xf4240>;
		};
	};
	pcie@fe260000 {
		compatible = "rockchip,rk3568-pcie", "snps,dw-pcie";
		#address-cells = <0x3>;
		#size-cells = <0x2>;
		bus-range = <0x0 0xf>;
		clocks = <0x24 0x81 0x24 0x82 0x24 0x83 0x24 0x84 0x24 0x85>;
		clock-names = "aclk_mst", "aclk_slv", "aclk_dbi", "pclk", "aux";
		device_type = "pci";
		interrupts = <0x0 0x4b 0x4 0x0 0x4a 0x4 0x0 0x49 0x4 0x0 0x48 0x4 0x0 0x47 0x4>;
		interrupt-names = "sys", "pmc", "msg", "legacy", "err";
		#interrupt-cells = <0x1>;
		interrupt-map-mask = <0x0 0x0 0x0 0x7>;
		interrupt-map = <0x0 0x0 0x0 0x1 0xb9 0x0 0x0 0x0 0x0 0x2 0xb9 0x1 0x0 0x0 0x0 0x3 0xb9 0x2 0x0 0x0 0x0 0x4 0xb9 0x3>;
		linux,pci-domain = <0x0>;
		num-ib-windows = <0x6>;
		num-viewport = <0x8>;
		num-ob-windows = <0x2>;
		max-link-speed = <0x2>;
		msi-map = <0x0 0xba 0x0 0x1000>;
		num-lanes = <0x1>;
		phys = <0x28 0x2>;
		phy-names = "pcie-phy";
		power-domains = <0x26 0xf>;
		ranges = <0x800 0x0 0xf4000000 0x0 0xf4000000 0x0 0x100000 0x81000000 0x0 0xf4100000 0x0 0xf4100000 0x0 0x100000 0x82000000 0x0 0xf4200000 0x0 0xf4200000 0x0 0x1e00000 0xc3000000 0x3 0x0 0x3 0x0 0x0 0x40000000>;
		reg = <0x3 0xc0000000 0x0 0x400000 0x0 0xfe260000 0x0 0x10000>;
		reg-names = "pcie-dbi", "pcie-apb";
		resets = <0x24 0xa1>;
		reset-names = "pipe";
		status = "okay";
		reset-gpios = <0x8a 0x11 0x0>;
		disable-gpios = <0x8a 0x12 0x0>;
		vpcie3v3-supply = <0xbb>;
		legacy-interrupt-controller {
			interrupt-controller;
			#address-cells = <0x0>;
			#interrupt-cells = <0x1>;
			interrupt-parent = <0x1>;
			interrupts = <0x0 0x48 0x1>;
			phandle = <0xb9>;
		};
	};
	pcie@fe270000 {
		compatible = "rockchip,rk3568-pcie", "snps,dw-pcie";
		#address-cells = <0x3>;
		#size-cells = <0x2>;
		bus-range = <0x10 0x1f>;
		clocks = <0x24 0x88 0x24 0x89 0x24 0x8a 0x24 0x8b 0x24 0x8c>;
		clock-names = "aclk_mst", "aclk_slv", "aclk_dbi", "pclk", "aux";
		device_type = "pci";
		interrupts = <0x0 0xa0 0x4 0x0 0x9f 0x4 0x0 0x9e 0x4 0x0 0x9d 0x4 0x0 0x9c 0x4>;
		interrupt-names = "sys", "pmc", "msg", "legacy", "err";
		#interrupt-cells = <0x1>;
		interrupt-map-mask = <0x0 0x0 0x0 0x7>;
		interrupt-map = <0x0 0x0 0x0 0x1 0xbc 0x0 0x0 0x0 0x0 0x2 0xbc 0x1 0x0 0x0 0x0 0x3 0xbc 0x2 0x0 0x0 0x0 0x4 0xbc 0x3>;
		linux,pci-domain = <0x1>;
		num-ib-windows = <0x6>;
		num-ob-windows = <0x2>;
		num-viewport = <0x8>;
		max-link-speed = <0x3>;
		msi-map = <0x1000 0xba 0x1000 0x1000>;
		num-lanes = <0x1>;
		phys = <0xbd>;
		phy-names = "pcie-phy";
		power-domains = <0x26 0xf>;
		ranges = <0x800 0x0 0xf2000000 0x0 0xf2000000 0x0 0x100000 0x81000000 0x0 0xf2100000 0x0 0xf2100000 0x0 0x100000 0x82000000 0x0 0xf2200000 0x0 0xf2200000 0x0 0x1e00000 0xc3000000 0x3 0x40000000 0x3 0x40000000 0x0 0x40000000>;
		reg = <0x3 0xc0400000 0x0 0x400000 0x0 0xfe270000 0x0 0x10000>;
		reg-names = "pcie-dbi", "pcie-apb";
		resets = <0x24 0xb1>;
		reset-names = "pipe";
		status = "disabled";
		legacy-interrupt-controller {
			interrupt-controller;
			#address-cells = <0x0>;
			#interrupt-cells = <0x1>;
			interrupt-parent = <0x1>;
			interrupts = <0x0 0x9d 0x1>;
			phandle = <0xbc>;
		};
	};
	pcie@fe280000 {
		compatible = "rockchip,rk3568-pcie", "snps,dw-pcie";
		#address-cells = <0x3>;
		#size-cells = <0x2>;
		bus-range = <0x20 0x2f>;
		clocks = <0x24 0x8f 0x24 0x90 0x24 0x91 0x24 0x92 0x24 0x93>;
		clock-names = "aclk_mst", "aclk_slv", "aclk_dbi", "pclk", "aux";
		device_type = "pci";
		interrupts = <0x0 0xa5 0x4 0x0 0xa4 0x4 0x0 0xa3 0x4 0x0 0xa2 0x4 0x0 0xa1 0x4>;
		interrupt-names = "sys", "pmc", "msg", "legacy", "err";
		#interrupt-cells = <0x1>;
		interrupt-map-mask = <0x0 0x0 0x0 0x7>;
		interrupt-map = <0x0 0x0 0x0 0x1 0xbe 0x0 0x0 0x0 0x0 0x2 0xbe 0x1 0x0 0x0 0x0 0x3 0xbe 0x2 0x0 0x0 0x0 0x4 0xbe 0x3>;
		linux,pci-domain = <0x2>;
		num-ib-windows = <0x6>;
		num-viewport = <0x8>;
		num-ob-windows = <0x2>;
		max-link-speed = <0x3>;
		msi-map = <0x2000 0xba 0x2000 0x1000>;
		num-lanes = <0x2>;
		phys = <0xbd>;
		phy-names = "pcie-phy";
		power-domains = <0x26 0xf>;
		ranges = <0x800 0x0 0xf0000000 0x0 0xf0000000 0x0 0x100000 0x81000000 0x0 0xf0100000 0x0 0xf0100000 0x0 0x100000 0x82000000 0x0 0xf0200000 0x0 0xf0200000 0x0 0x1e00000 0xc3000000 0x3 0x80000000 0x3 0x80000000 0x0 0x40000000>;
		reg = <0x3 0xc0800000 0x0 0x400000 0x0 0xfe280000 0x0 0x10000>;
		reg-names = "pcie-dbi", "pcie-apb";
		resets = <0x24 0xc1>;
		reset-names = "pipe";
		status = "okay";
		reset-gpios = <0xbf 0x1e 0x0>;
		vpcie3v3-supply = <0xc0>;
		legacy-interrupt-controller {
			interrupt-controller;
			#address-cells = <0x0>;
			#interrupt-cells = <0x1>;
			interrupt-parent = <0x1>;
			interrupts = <0x0 0xa2 0x1>;
			phandle = <0xbe>;
		};
	};
	uio@fe2a0000 {
		compatible = "rockchip,uio-gmac";
		reg = <0x0 0xfe2a0000 0x0 0x10000>;
		rockchip,ethernet = <0xc1>;
		status = "disabled";
	};
	ethernet@fe2a0000 {
		local-mac-address = [1a 3a b9 6d ab f5];
		compatible = "rockchip,rk3568-gmac", "snps,dwmac-4.20a";
		reg = <0x0 0xfe2a0000 0x0 0x10000>;
		interrupts = <0x0 0x1b 0x4 0x0 0x18 0x4>;
		interrupt-names = "macirq", "eth_wake_irq";
		rockchip,grf = <0x3a>;
		clocks = <0x24 0x182 0x24 0x185 0x24 0x185 0x24 0xb8 0x24 0xb4 0x24 0xb5 0x24 0x185 0x24 0xb9 0x24 0xac 0x24 0xab>;
		clock-names = "stmmaceth", "mac_clk_rx", "mac_clk_tx", "clk_mac_refout", "aclk_mac", "pclk_mac", "clk_mac_speed", "ptp_ref", "pclk_xpcs", "clk_xpcs_eee";
		resets = <0x24 0xd7>;
		reset-names = "stmmaceth";
		snps,mixed-burst;
		snps,tso;
		snps,axi-config = <0xc2>;
		snps,mtl-rx-config = <0xc3>;
		snps,mtl-tx-config = <0xc4>;
		status = "okay";
		phy-mode = "rgmii";
		clock_in_out = "output";
		snps,reset-gpio = <0xbf 0x1b 0x1>;
		snps,reset-active-low;
		snps,reset-delays-us = <0x0 0x4e20 0x186a0>;
		assigned-clocks = <0x24 0x185 0x24 0x182>;
		assigned-clock-parents = <0x24 0x183 0x24 0xb6>;
		assigned-clock-rates = <0x0 0x7735940>;
		pinctrl-names = "default";
		pinctrl-0 = <0xc5 0xc6 0xc7 0xc8 0xc9>;
		tx_delay = <0x21>;
		rx_delay = <0x3c>;
		phy-handle = <0xca>;
		phandle = <0xc1>;
		mdio {
			compatible = "snps,dwmac-mdio";
			#address-cells = <0x1>;
			#size-cells = <0x0>;
			phy@0 {
				compatible = "ethernet-phy-ieee802.3-c22";
				reg = <0x0>;
				phandle = <0xca>;
			};
		};
		stmmac-axi-config {
			snps,wr_osr_lmt = <0x4>;
			snps,rd_osr_lmt = <0x8>;
			snps,blen = <0x0 0x0 0x0 0x0 0x10 0x8 0x4>;
			phandle = <0xc2>;
		};
		rx-queues-config {
			snps,rx-queues-to-use = <0x1>;
			phandle = <0xc3>;
			queue0 {
			};
		};
		tx-queues-config {
			snps,tx-queues-to-use = <0x1>;
			phandle = <0xc4>;
			queue0 {
			};
		};
	};
	dwmmc@fe2b0000 {
		compatible = "rockchip,rk3568-dw-mshc", "rockchip,rk3288-dw-mshc";
		reg = <0x0 0xfe2b0000 0x0 0x4000>;
		interrupts = <0x0 0x62 0x4>;
		max-frequency = <0x8f0d180>;
		clocks = <0x24 0xb0 0x24 0xb1 0x24 0x18a 0x24 0x18b>;
		clock-names = "biu", "ciu", "ciu-drive", "ciu-sample";
		fifo-depth = <0x100>;
		resets = <0x24 0xd4>;
		reset-names = "reset";
		status = "okay";
		no-sdio;
		no-mmc;
		bus-width = <0x4>;
		cap-mmc-highspeed;
		cap-sd-highspeed;
		disable-wp;
		sd-uhs-sdr104;
		vmmc-supply = <0xcb>;
		vqmmc-supply = <0x31>;
		pinctrl-names = "default";
		pinctrl-0 = <0xcc 0xcd 0xce 0xcf>;
	};
	dwmmc@fe2c0000 {
		compatible = "rockchip,rk3568-dw-mshc", "rockchip,rk3288-dw-mshc";
		reg = <0x0 0xfe2c0000 0x0 0x4000>;
		interrupts = <0x0 0x63 0x4>;
		max-frequency = <0x8f0d180>;
		clocks = <0x24 0xb2 0x24 0xb3 0x24 0x18c 0x24 0x18d>;
		clock-names = "biu", "ciu", "ciu-drive", "ciu-sample";
		fifo-depth = <0x100>;
		resets = <0x24 0xd6>;
		reset-names = "reset";
		status = "disabled";
	};
	spi@fe300000 {
		compatible = "rockchip,sfc";
		reg = <0x0 0xfe300000 0x0 0x4000>;
		interrupts = <0x0 0x65 0x4>;
		clocks = <0x24 0x78 0x24 0x76>;
		clock-names = "clk_sfc", "hclk_sfc";
		assigned-clocks = <0x24 0x78>;
		assigned-clock-rates = <0x5f5e100>;
		#address-cells = <0x1>;
		#size-cells = <0x0>;
		status = "disabled";
	};
	sdhci@fe310000 {
		compatible = "rockchip,rk3568-dwcmshc", "rockchip,dwcmshc-sdhci";
		reg = <0x0 0xfe310000 0x0 0x10000>;
		interrupts = <0x0 0x13 0x4>;
		assigned-clocks = <0x24 0x7b 0x24 0x7d 0x24 0x7c>;
		assigned-clock-rates = <0xbebc200 0x16e3600 0xbebc200>;
		clocks = <0x24 0x7c 0x24 0x7a 0x24 0x79 0x24 0x7b 0x24 0x7d>;
		clock-names = "core", "bus", "axi", "block", "timer";
		resets = <0x24 0x78 0x24 0x76 0x24 0x75 0x24 0x77 0x24 0x79>;
		reset-names = "core", "bus", "axi", "block", "timer";
		status = "okay";
		bus-width = <0x8>;
		no-sdio;
		no-sd;
		non-removable;
		max-frequency = <0xbebc200>;
	};
	nandc@fe330000 {
		compatible = "rockchip,rk-nandc-v9";
		reg = <0x0 0xfe330000 0x0 0x4000>;
		interrupts = <0x0 0x46 0x4>;
		nandc_id = <0x0>;
		clocks = <0x24 0x75 0x24 0x74>;
		clock-names = "clk_nandc", "hclk_nandc";
		status = "okay";
		#address-cells = <0x1>;
		#size-cells = <0x0>;
		nand@0 {
			reg = <0x0>;
			nand-bus-width = <0x8>;
			nand-ecc-mode = "hw";
			nand-ecc-strength = <0x10>;
			nand-ecc-step-size = <0x400>;
		};
	};
	crypto@fe380000 {
		compatible = "rockchip,rk3568-crypto";
		reg = <0x0 0xfe380000 0x0 0x4000>;
		interrupts = <0x0 0x4 0x4>;
		clocks = <0x24 0x6a 0x24 0x6b 0x24 0x6c 0x24 0x6d>;
		clock-names = "aclk", "hclk", "sclk", "apb_pclk";
		assigned-clocks = <0x24 0x6c>;
		assigned-clock-rates = <0xbebc200>;
		resets = <0x24 0x69>;
		reset-names = "crypto-rst";
		status = "disabled";
	};
	rng@fe388000 {
		compatible = "rockchip,cryptov2-rng";
		reg = <0x0 0xfe388000 0x0 0x2000>;
		clocks = <0x24 0x70 0x24 0x6f>;
		clock-names = "clk_trng", "hclk_trng";
		resets = <0x24 0x6d>;
		reset-names = "reset";
		status = "okay";
	};
	otp@fe38c000 {
		compatible = "rockchip,rk3568-otp";
		reg = <0x0 0xfe38c000 0x0 0x4000>;
		#address-cells = <0x1>;
		#size-cells = <0x1>;
		clocks = <0x24 0x73 0x24 0x72 0x24 0x71 0x24 0x181>;
		clock-names = "usr", "sbpi", "apb", "phy";
		resets = <0x24 0x1cf>;
		reset-names = "otp_phy";
		cpu-code@2 {
			reg = <0x2 0x2>;
			phandle = <0x12>;
		};
		specification-serial-number@7 {
			reg = <0x7 0x1>;
			bits = <0x0 0x5>;
			phandle = <0xa>;
		};
		cpu-version@8 {
			reg = <0x8 0x1>;
			bits = <0x3 0x3>;
			phandle = <0x11>;
		};
		mbist-vmin@9 {
			reg = <0x9 0x1>;
			bits = <0x0 0x4>;
			phandle = <0x8>;
		};
		id@a {
			reg = <0xa 0x10>;
			phandle = <0x10>;
		};
		cpu-leakage@1a {
			reg = <0x1a 0x1>;
			phandle = <0x6>;
		};
		log-leakage@1b {
			reg = <0x1b 0x1>;
			phandle = <0x7e>;
		};
		npu-leakage@1c {
			reg = <0x1c 0x1>;
			phandle = <0x6b>;
		};
		gpu-leakage@1d {
			reg = <0x1d 0x1>;
			phandle = <0x71>;
		};
		core-pvtm@2a {
			reg = <0x2a 0x2>;
			phandle = <0x7>;
		};
		cpu-tsadc-trim-l@2e {
			reg = <0x2e 0x1>;
			phandle = <0x11d>;
		};
		cpu-tsadc-trim-h@2f {
			reg = <0x2f 0x1>;
			bits = <0x0 0x4>;
			phandle = <0x11e>;
		};
		npu-tsadc-trim-l@30 {
			reg = <0x30 0x1>;
			phandle = <0x11f>;
		};
		npu-tsadc-trim-h@31 {
			reg = <0x31 0x1>;
			bits = <0x0 0x4>;
			phandle = <0x120>;
		};
		tsadc-trim-base-frac@31 {
			reg = <0x31 0x1>;
			bits = <0x4 0x4>;
			phandle = <0x11a>;
		};
		tsadc-trim-base@32 {
			reg = <0x32 0x1>;
			phandle = <0x119>;
		};
		cpu-opp-info@36 {
			reg = <0x36 0x6>;
			phandle = <0x9>;
		};
		gpu-opp-info@3c {
			reg = <0x3c 0x6>;
			phandle = <0x72>;
		};
		npu-opp-info@42 {
			reg = <0x42 0x6>;
			phandle = <0x6c>;
		};
		dmc-opp-info@48 {
			reg = <0x48 0x6>;
			phandle = <0xb8>;
		};
		remark-spec-serial-number@56 {
			reg = <0x56 0x1>;
			bits = <0x0 0x5>;
			phandle = <0xb>;
		};
	};
	i2s@fe400000 {
		compatible = "rockchip,rk3568-i2s-tdm";
		reg = <0x0 0xfe400000 0x0 0x1000>;
		interrupts = <0x0 0x34 0x4>;
		clocks = <0x24 0x3f 0x24 0x43 0x24 0x39>;
		clock-names = "mclk_tx", "mclk_rx", "hclk";
		dmas = <0xd0 0x0>;
		dma-names = "tx";
		resets = <0x24 0x50 0x24 0x51>;
		reset-names = "tx-m", "rx-m";
		rockchip,cru = <0x24>;
		rockchip,grf = <0x3a>;
		rockchip,playback-only;
		#sound-dai-cells = <0x0>;
		status = "okay";
		phandle = <0x144>;
	};
	i2s@fe410000 {
		compatible = "rockchip,rk3568-i2s-tdm";
		reg = <0x0 0xfe410000 0x0 0x1000>;
		interrupts = <0x0 0x35 0x4>;
		clocks = <0x24 0x47 0x24 0x4b 0x24 0x3a>;
		clock-names = "mclk_tx", "mclk_rx", "hclk";
		dmas = <0xd0 0x2 0xd0 0x3>;
		dma-names = "tx", "rx";
		resets = <0x24 0x52 0x24 0x53>;
		reset-names = "tx-m", "rx-m";
		rockchip,cru = <0x24>;
		rockchip,grf = <0x3a>;
		#sound-dai-cells = <0x0>;
		pinctrl-names = "default";
		pinctrl-0 = <0xd1 0xd2 0xd3 0xd4>;
		status = "okay";
		rockchip,clk-trcm = <0x1>;
		phandle = <0xe3>;
	};
	i2s@fe420000 {
		compatible = "rockchip,rk3568-i2s-tdm";
		reg = <0x0 0xfe420000 0x0 0x1000>;
		interrupts = <0x0 0x36 0x4>;
		clocks = <0x24 0x4f 0x24 0x4f 0x24 0x3b>;
		clock-names = "mclk_tx", "mclk_rx", "hclk";
		dmas = <0xd0 0x4 0xd0 0x5>;
		dma-names = "tx", "rx";
		rockchip,cru = <0x24>;
		rockchip,grf = <0x3a>;
		rockchip,clk-trcm = <0x1>;
		#sound-dai-cells = <0x0>;
		pinctrl-names = "default";
		pinctrl-0 = <0xd5 0xd6 0xd7 0xd8>;
		status = "disabled";
	};
	i2s@fe430000 {
		compatible = "rockchip,rk3568-i2s-tdm";
		reg = <0x0 0xfe430000 0x0 0x1000>;
		interrupts = <0x0 0x37 0x4>;
		clocks = <0x24 0x53 0x24 0x57 0x24 0x3c>;
		clock-names = "mclk_tx", "mclk_rx", "hclk";
		dmas = <0xd0 0x6 0xd0 0x7>;
		dma-names = "tx", "rx";
		resets = <0x24 0x55 0x24 0x56>;
		reset-names = "tx-m", "rx-m";
		rockchip,cru = <0x24>;
		rockchip,grf = <0x3a>;
		rockchip,clk-trcm = <0x1>;
		#sound-dai-cells = <0x0>;
		pinctrl-names = "default";
		pinctrl-0 = <0xd9 0xda 0xdb 0xdc>;
		status = "disabled";
		phandle = <0x13b>;
	};
	pdm@fe440000 {
		compatible = "rockchip,rk3568-pdm", "rockchip,pdm";
		reg = <0x0 0xfe440000 0x0 0x1000>;
		clocks = <0x24 0x5a 0x24 0x59>;
		clock-names = "pdm_clk", "pdm_hclk";
		dmas = <0xd0 0x9>;
		dma-names = "rx";
		pinctrl-names = "default";
		pinctrl-0 = <0xdd 0xde 0xdf 0xe0 0xe1 0xe2>;
		#sound-dai-cells = <0x0>;
		status = "disabled";
		phandle = <0x13e>;
	};
	vad@fe450000 {
		compatible = "rockchip,rk3568-vad";
		reg = <0x0 0xfe450000 0x0 0x10000>;
		reg-names = "vad";
		clocks = <0x24 0x5b>;
		clock-names = "hclk";
		interrupts = <0x0 0x89 0x4>;
		rockchip,audio-src = <0xe3>;
		rockchip,det-channel = <0x0>;
		rockchip,mode = <0x0>;
		#sound-dai-cells = <0x0>;
		status = "disabled";
		rockchip,buffer-time-ms = <0x80>;
		phandle = <0x142>;
	};
	spdif@fe460000 {
		compatible = "rockchip,rk3568-spdif";
		reg = <0x0 0xfe460000 0x0 0x1000>;
		interrupts = <0x0 0x66 0x4>;
		dmas = <0xd0 0x1>;
		dma-names = "tx";
		clock-names = "mclk", "hclk";
		clocks = <0x24 0x5f 0x24 0x5c>;
		#sound-dai-cells = <0x0>;
		pinctrl-names = "default";
		pinctrl-0 = <0xe4>;
		status = "disabled";
	};
	audpwm@fe470000 {
		compatible = "rockchip,rk3568-audio-pwm", "rockchip,audio-pwm-v1";
		reg = <0x0 0xfe470000 0x0 0x1000>;
		clocks = <0x24 0x63 0x24 0x60>;
		clock-names = "clk", "hclk";
		dmas = <0xd0 0x8>;
		dma-names = "tx";
		#sound-dai-cells = <0x0>;
		rockchip,sample-width-bits = <0xb>;
		rockchip,interpolat-points = <0x1>;
		status = "disabled";
	};
	codec-digital@fe478000 {
		compatible = "rockchip,rk3568-codec-digital", "rockchip,codec-digital-v1";
		reg = <0x0 0xfe478000 0x0 0x1000>;
		clocks = <0x24 0x67 0x24 0x66 0x24 0x65 0x24 0x64>;
		clock-names = "adc", "dac", "i2c", "pclk";
		pinctrl-names = "default";
		pinctrl-0 = <0xe5>;
		resets = <0x24 0x5f>;
		reset-names = "reset";
		rockchip,grf = <0x3a>;
		#sound-dai-cells = <0x0>;
		status = "disabled";
		phandle = <0x13c>;
	};
	dmac@fe530000 {
		compatible = "arm,pl330", "arm,primecell";
		reg = <0x0 0xfe530000 0x0 0x4000>;
		interrupts = <0x0 0xe 0x4 0x0 0xd 0x4>;
		clocks = <0x24 0x10d>;
		clock-names = "apb_pclk";
		#dma-cells = <0x1>;
		arm,pl330-periph-burst;
		phandle = <0x47>;
	};
	dmac@fe550000 {
		compatible = "arm,pl330", "arm,primecell";
		reg = <0x0 0xfe550000 0x0 0x4000>;
		interrupts = <0x0 0x10 0x4 0x0 0xf 0x4>;
		clocks = <0x24 0x10d>;
		clock-names = "apb_pclk";
		#dma-cells = <0x1>;
		arm,pl330-periph-burst;
		phandle = <0xd0>;
	};
	rkscr@fe560000 {
		compatible = "rockchip-scr";
		reg = <0x0 0xfe560000 0x0 0x10000>;
		interrupts = <0x0 0x61 0x4>;
		pinctrl-names = "default";
		pinctrl-0 = <0xe6>;
		clocks = <0x24 0x114>;
		clock-names = "g_pclk_sim_card";
		status = "disabled";
	};
	can@fe570000 {
		compatible = "rockchip,rk3568-can-2.0";
		reg = <0x0 0xfe570000 0x0 0x1000>;
		interrupts = <0x0 0x1 0x4>;
		clocks = <0x24 0x141 0x24 0x140>;
		clock-names = "baudclk", "apb_pclk";
		resets = <0x24 0x155 0x24 0x154>;
		reset-names = "can", "can-apb";
		tx-fifo-depth = <0x1>;
		rx-fifo-depth = <0x6>;
		status = "disabled";
		assigned-clocks = <0x24 0x141>;
		assigned-clock-rates = <0x8f0d180>;
		pinctrl-names = "default";
		pinctrl-0 = <0xe7>;
	};
	can@fe580000 {
		compatible = "rockchip,rk3568-can-2.0";
		reg = <0x0 0xfe580000 0x0 0x1000>;
		interrupts = <0x0 0x2 0x4>;
		clocks = <0x24 0x143 0x24 0x142>;
		clock-names = "baudclk", "apb_pclk";
		resets = <0x24 0x157 0x24 0x156>;
		reset-names = "can", "can-apb";
		tx-fifo-depth = <0x1>;
		rx-fifo-depth = <0x6>;
		status = "disabled";
		assigned-clocks = <0x24 0x143>;
		assigned-clock-rates = <0x8f0d180>;
		pinctrl-names = "default";
		pinctrl-0 = <0xe8>;
	};
	can@fe590000 {
		compatible = "rockchip,rk3568-can-2.0";
		reg = <0x0 0xfe590000 0x0 0x1000>;
		interrupts = <0x0 0x3 0x4>;
		clocks = <0x24 0x145 0x24 0x144>;
		clock-names = "baudclk", "apb_pclk";
		resets = <0x24 0x159 0x24 0x158>;
		reset-names = "can", "can-apb";
		tx-fifo-depth = <0x1>;
		rx-fifo-depth = <0x6>;
		status = "disabled";
		assigned-clocks = <0x24 0x145>;
		assigned-clock-rates = <0x8f0d180>;
		pinctrl-names = "default";
		pinctrl-0 = <0xe9>;
	};
	i2c@fe5a0000 {
		compatible = "rockchip,rk3399-i2c";
		reg = <0x0 0xfe5a0000 0x0 0x1000>;
		clocks = <0x24 0x148 0x24 0x147>;
		clock-names = "i2c", "pclk";
		interrupts = <0x0 0x2f 0x4>;
		pinctrl-names = "default";
		pinctrl-0 = <0xea>;
		#address-cells = <0x1>;
		#size-cells = <0x0>;
		status = "okay";
		gt9xx@5d {
			compatible = "goodix,gt9xx";
			status = "okay";
			reg = <0x5d>;
			gtp_resolution_x = <0x320>;
			gtp_resolution_y = <0x500>;
			gtp_int_tarigger = <0x1>;
			gtp_change_x2y = <0x0>;
			gtp_overturn_x = <0x0>;
			gtp_overturn_y = <0x0>;
			gtp_send_cfg = <0x1>;
			gtp_touch_wakeup = <0x1>;
			goodix_rst_gpio = <0x3e 0xe 0x0>;
			goodix_irq_gpio = <0x8a 0x3 0x8>;
			pinctrl-names = "default";
			pinctrl-0 = <0xeb>;
			goodix,cfg-group0 = [70 20 03 00 05 05 35 00 01 0a 28 0f 5a 3c 03 05 00 00 00 00 00 00 06 18 1a 1e 14 8c 2e 0e b0 b2 b2 04 00 00 00 98 02 1c 00 01 00 00 00 03 64 32 00 00 00 a0 f5 94 d5 02 07 00 00 04 83 a7 00 7e b5 00 78 c6 00 73 d7 00 6f ea 00 6f 00 00 00 00 00 00 00 00 00 00 00 00 00 00 00 00 00 00 00 00 00 00 00 00 00 00 00 00 00 00 00 00 00 00 00 00 1c 1a 18 16 14 12 10 0e 0c 0a 08 06 04 02 ff ff ff ff ff ff ff ff ff ff ff ff ff ff ff ff 00 02 04 06 08 0a 0c 0f 10 12 13 14 16 2a 29 28 26 24 22 21 20 1f 1e 1d 1c 18 ff ff ff ff ff ff ff ff ff ff ff ff ff ff ff ff fc 01];
		};
	};
	i2c@fe5b0000 {
		compatible = "rockchip,rk3399-i2c";
		reg = <0x0 0xfe5b0000 0x0 0x1000>;
		clocks = <0x24 0x14a 0x24 0x149>;
		clock-names = "i2c", "pclk";
		interrupts = <0x0 0x30 0x4>;
		pinctrl-names = "default";
		pinctrl-0 = <0xec>;
		#address-cells = <0x1>;
		#size-cells = <0x0>;
		status = "okay";
	};
	i2c@fe5c0000 {
		compatible = "rockchip,rk3399-i2c";
		reg = <0x0 0xfe5c0000 0x0 0x1000>;
		clocks = <0x24 0x14c 0x24 0x14b>;
		clock-names = "i2c", "pclk";
		interrupts = <0x0 0x31 0x4>;
		pinctrl-names = "default";
		pinctrl-0 = <0xed>;
		#address-cells = <0x1>;
		#size-cells = <0x0>;
		status = "okay";
	};
	i2c@fe5d0000 {
		compatible = "rockchip,rk3399-i2c";
		reg = <0x0 0xfe5d0000 0x0 0x1000>;
		clocks = <0x24 0x14e 0x24 0x14d>;
		clock-names = "i2c", "pclk";
		interrupts = <0x0 0x32 0x4>;
		pinctrl-names = "default";
		pinctrl-0 = <0xee>;
		#address-cells = <0x1>;
		#size-cells = <0x0>;
		status = "okay";
		ov5647@36 {
			compatible = "ovti,ov5647";
			status = "okay";
			reg = <0x36>;
			clocks = <0xef>;
			clock-names = "xvclk";
			rockchip,camera-module-index = <0x0>;
			rockchip,camera-module-facing = "back";
			rockchip,camera-module-name = "default";
			rockchip,camera-module-lens-name = "default";
			port {
				endpoint {
					remote-endpoint = <0xf0>;
					data-lanes = <0x1 0x2>;
					phandle = <0x128>;
				};
			};
		};
		gc5035@37 {
			compatible = "galaxycore,gc5035";
			status = "disabled";
			reg = <0x37>;
			clocks = <0x24 0xd6>;
			clock-names = "xvclk";
			power-domains = <0x26 0x8>;
			pinctrl-names = "default";
			pinctrl-0 = <0xf1>;
			reset-gpios = <0x3e 0xf 0x0>;
			pwdn-gpios = <0xf2 0x19 0x0>;
			rockchip,camera-module-index = <0x0>;
			rockchip,camera-module-facing = "front";
			rockchip,camera-module-name = "default";
			rockchip,camera-module-lens-name = "PC5322-M5";
			port {
				endpoint {
					remote-endpoint = <0xf3>;
					data-lanes = <0x1 0x2>;
					phandle = <0x127>;
				};
			};
		};
	};
	i2c@fe5e0000 {
		compatible = "rockchip,rk3399-i2c";
		reg = <0x0 0xfe5e0000 0x0 0x1000>;
		clocks = <0x24 0x150 0x24 0x14f>;
		clock-names = "i2c", "pclk";
		interrupts = <0x0 0x33 0x4>;
		pinctrl-names = "default";
		pinctrl-0 = <0xf4>;
		#address-cells = <0x1>;
		#size-cells = <0x0>;
		status = "okay";
		hym8563@51 {
			compatible = "haoyu,hym8563";
			reg = <0x51>;
			#clock-cells = <0x0>;
			clock-frequency = <0x8000>;
			clock-output-names = "hym8563";
			rtc-irq-gpio = <0x3e 0x1b 0x2>;
		};
	};
	timer@fe5f0000 {
		compatible = "rockchip,rk3568-timer", "rockchip,rk3288-timer";
		reg = <0x0 0xfe5f0000 0x0 0x1000>;
		interrupts = <0x0 0x6d 0x4>;
		clocks = <0x24 0x16c 0x24 0x16d>;
		clock-names = "pclk", "timer";
	};
	watchdog@fe600000 {
		compatible = "snps,dw-wdt";
		reg = <0x0 0xfe600000 0x0 0x100>;
		clocks = <0x24 0x116 0x24 0x115>;
		clock-names = "tclk", "pclk";
		interrupts = <0x0 0x95 0x4>;
		status = "okay";
	};
	spi@fe610000 {
		compatible = "rockchip,rk3066-spi";
		reg = <0x0 0xfe610000 0x0 0x1000>;
		interrupts = <0x0 0x67 0x4>;
		#address-cells = <0x1>;
		#size-cells = <0x0>;
		clocks = <0x24 0x152 0x24 0x151>;
		clock-names = "spiclk", "apb_pclk";
		dmas = <0x47 0x14 0x47 0x15>;
		dma-names = "tx", "rx";
		pinctrl-names = "default", "high_speed";
		pinctrl-0 = <0xf5 0xf6 0xf7>;
		pinctrl-1 = <0xf5 0xf6 0xf8>;
		num-cs = <0x2>;
		status = "disabled";
	};
	spi@fe620000 {
		compatible = "rockchip,rk3066-spi";
		reg = <0x0 0xfe620000 0x0 0x1000>;
		interrupts = <0x0 0x68 0x4>;
		#address-cells = <0x1>;
		#size-cells = <0x0>;
		clocks = <0x24 0x154 0x24 0x153>;
		clock-names = "spiclk", "apb_pclk";
		dmas = <0x47 0x16 0x47 0x17>;
		dma-names = "tx", "rx";
		pinctrl-names = "default", "high_speed";
		pinctrl-0 = <0xf9 0xfa 0xfb>;
		pinctrl-1 = <0xf9 0xfa 0xfc>;
		num-cs = <0x2>;
		status = "disabled";
	};
	spi@fe630000 {
		compatible = "rockchip,rk3066-spi";
		reg = <0x0 0xfe630000 0x0 0x1000>;
		interrupts = <0x0 0x69 0x4>;
		#address-cells = <0x1>;
		#size-cells = <0x0>;
		clocks = <0x24 0x156 0x24 0x155>;
		clock-names = "spiclk", "apb_pclk";
		dmas = <0x47 0x18 0x47 0x19>;
		dma-names = "tx", "rx";
		pinctrl-names = "default", "high_speed";
		pinctrl-0 = <0xfd 0xfe 0xff>;
		pinctrl-1 = <0xfd 0xfe 0x100>;
		num-cs = <0x2>;
		status = "disabled";
	};
	spi@fe640000 {
		compatible = "rockchip,rk3066-spi";
		reg = <0x0 0xfe640000 0x0 0x1000>;
		interrupts = <0x0 0x6a 0x4>;
		#address-cells = <0x1>;
		#size-cells = <0x0>;
		clocks = <0x24 0x158 0x24 0x157>;
		clock-names = "spiclk", "apb_pclk";
		dmas = <0x47 0x1a 0x47 0x1b>;
		dma-names = "tx", "rx";
		pinctrl-names = "default", "high_speed";
		pinctrl-0 = <0x101>;
		pinctrl-1 = <0x102>;
		num-cs = <0x2>;
		status = "okay";
		spi_test@0 {
			compatible = "rockchip,spidev";
			reg = <0x0>;
			spi-max-frequency = <0x16e3600>;
		};
	};
	serial@fe650000 {
		compatible = "rockchip,rk3568-uart", "snps,dw-apb-uart";
		reg = <0x0 0xfe650000 0x0 0x100>;
		interrupts = <0x0 0x75 0x4>;
		clocks = <0x24 0x11f 0x24 0x11c>;
		clock-names = "baudclk", "apb_pclk";
		reg-shift = <0x2>;
		reg-io-width = <0x4>;
		dmas = <0x47 0x2 0x47 0x3>;
		pinctrl-names = "default";
		pinctrl-0 = <0x103>;
		status = "disabled";
	};
	serial@fe660000 {
		compatible = "rockchip,rk3568-uart", "snps,dw-apb-uart";
		reg = <0x0 0xfe660000 0x0 0x100>;
		interrupts = <0x0 0x76 0x4>;
		clocks = <0x24 0x123 0x24 0x120>;
		clock-names = "baudclk", "apb_pclk";
		reg-shift = <0x2>;
		reg-io-width = <0x4>;
		dmas = <0x47 0x4 0x47 0x5>;
		pinctrl-names = "default";
		pinctrl-0 = <0x104>;
		status = "disabled";
	};
	serial@fe670000 {
		compatible = "rockchip,rk3568-uart", "snps,dw-apb-uart";
		reg = <0x0 0xfe670000 0x0 0x100>;
		interrupts = <0x0 0x77 0x4>;
		clocks = <0x24 0x127 0x24 0x124>;
		clock-names = "baudclk", "apb_pclk";
		reg-shift = <0x2>;
		reg-io-width = <0x4>;
		dmas = <0x47 0x6 0x47 0x7>;
		pinctrl-names = "default";
		pinctrl-0 = <0x105>;
		status = "okay";
	};
	serial@fe680000 {
		compatible = "rockchip,rk3568-uart", "snps,dw-apb-uart";
		reg = <0x0 0xfe680000 0x0 0x100>;
		interrupts = <0x0 0x78 0x4>;
		clocks = <0x24 0x12b 0x24 0x128>;
		clock-names = "baudclk", "apb_pclk";
		reg-shift = <0x2>;
		reg-io-width = <0x4>;
		dmas = <0x47 0x8 0x47 0x9>;
		pinctrl-names = "default";
		pinctrl-0 = <0x106>;
		status = "okay";
	};
	serial@fe690000 {
		compatible = "rockchip,rk3568-uart", "snps,dw-apb-uart";
		reg = <0x0 0xfe690000 0x0 0x100>;
		interrupts = <0x0 0x79 0x4>;
		clocks = <0x24 0x12f 0x24 0x12c>;
		clock-names = "baudclk", "apb_pclk";
		reg-shift = <0x2>;
		reg-io-width = <0x4>;
		dmas = <0x47 0xa 0x47 0xb>;
		pinctrl-names = "default";
		pinctrl-0 = <0x107>;
		status = "disabled";
	};
	serial@fe6a0000 {
		compatible = "rockchip,rk3568-uart", "snps,dw-apb-uart";
		reg = <0x0 0xfe6a0000 0x0 0x100>;
		interrupts = <0x0 0x7a 0x4>;
		clocks = <0x24 0x133 0x24 0x130>;
		clock-names = "baudclk", "apb_pclk";
		reg-shift = <0x2>;
		reg-io-width = <0x4>;
		dmas = <0x47 0xc 0x47 0xd>;
		pinctrl-names = "default";
		pinctrl-0 = <0x108>;
		status = "disabled";
	};
	serial@fe6b0000 {
		compatible = "rockchip,rk3568-uart", "snps,dw-apb-uart";
		reg = <0x0 0xfe6b0000 0x0 0x100>;
		interrupts = <0x0 0x7b 0x4>;
		clocks = <0x24 0x137 0x24 0x134>;
		clock-names = "baudclk", "apb_pclk";
		reg-shift = <0x2>;
		reg-io-width = <0x4>;
		dmas = <0x47 0xe 0x47 0xf>;
		pinctrl-names = "default";
		pinctrl-0 = <0x109>;
		status = "okay";
	};
	serial@fe6c0000 {
		compatible = "rockchip,rk3568-uart", "snps,dw-apb-uart";
		reg = <0x0 0xfe6c0000 0x0 0x100>;
		interrupts = <0x0 0x7c 0x4>;
		clocks = <0x24 0x13b 0x24 0x138>;
		clock-names = "baudclk", "apb_pclk";
		reg-shift = <0x2>;
		reg-io-width = <0x4>;
		dmas = <0x47 0x10 0x47 0x11>;
		pinctrl-names = "default";
		pinctrl-0 = <0x10a 0x10b>;
		status = "okay";
	};
	serial@fe6d0000 {
		compatible = "rockchip,rk3568-uart", "snps,dw-apb-uart";
		reg = <0x0 0xfe6d0000 0x0 0x100>;
		interrupts = <0x0 0x7d 0x4>;
		clocks = <0x24 0x13f 0x24 0x13c>;
		clock-names = "baudclk", "apb_pclk";
		reg-shift = <0x2>;
		reg-io-width = <0x4>;
		dmas = <0x47 0x12 0x47 0x13>;
		pinctrl-names = "default";
		pinctrl-0 = <0x10c>;
		status = "disabled";
	};
	pwm@fe6e0000 {
		compatible = "rockchip,rk3568-pwm", "rockchip,rk3328-pwm";
		reg = <0x0 0xfe6e0000 0x0 0x10>;
		#pwm-cells = <0x3>;
		pinctrl-names = "active";
		pinctrl-0 = <0x10d>;
		clocks = <0x24 0x15a 0x24 0x159>;
		clock-names = "pwm", "pclk";
		status = "okay";
		phandle = <0x150>;
	};
	pwm@fe6e0010 {
		compatible = "rockchip,rk3568-pwm", "rockchip,rk3328-pwm";
		reg = <0x0 0xfe6e0010 0x0 0x10>;
		#pwm-cells = <0x3>;
		pinctrl-names = "active";
		pinctrl-0 = <0x10e>;
		clocks = <0x24 0x15a 0x24 0x159>;
		clock-names = "pwm", "pclk";
		status = "disabled";
	};
	pwm@fe6e0020 {
		compatible = "rockchip,rk3568-pwm", "rockchip,rk3328-pwm";
		reg = <0x0 0xfe6e0020 0x0 0x10>;
		#pwm-cells = <0x3>;
		pinctrl-names = "active";
		pinctrl-0 = <0x10f>;
		clocks = <0x24 0x15a 0x24 0x159>;
		clock-names = "pwm", "pclk";
		status = "disabled";
	};
	pwm@fe6e0030 {
		compatible = "rockchip,remotectl-pwm";
		reg = <0x0 0xfe6e0030 0x0 0x10>;
		interrupts = <0x0 0x53 0x4 0x0 0x57 0x4>;
		#pwm-cells = <0x3>;
		pinctrl-names = "default";
		pinctrl-0 = <0x110>;
		clocks = <0x24 0x15a 0x24 0x159>;
		clock-names = "pwm", "pclk";
		status = "okay";
		remote_pwm_id = <0x3>;
		handle_cpu_id = <0x1>;
		remote_support_psci = <0x0>;
		ir_key1 {
			rockchip,usercode = <0x4040>;
			rockchip,key_table = <0xf2 0xe8 0xbd 0x9e 0xf4 0x67 0xf1 0x6c 0xef 0x69 0xee 0x6a 0xe5 0x66 0xe7 0x73 0xe8 0x72 0xb2 0x74 0xbc 0x71 0xba 0x8b 0xfe 0x2 0xfd 0x3 0xfc 0x4 0xfb 0x5 0xfa 0x6 0xf9 0x7 0xf8 0x8 0xf7 0x9 0xf6 0xa 0xff 0xb 0xb8 0x184 0xa4 0x2c1 0xa8 0x2c2 0xab 0x2c3 0xe0 0xa5 0xac 0xa4 0xe1 0xa3 0xf3 0xe 0xbb 0x34 0x54 0x8d>;
		};
		ir_key2 {
			rockchip,usercode = <0xfe01>;
			rockchip,key_table = <0xec 0xe8 0xe6 0x9e 0xe9 0x67 0xe5 0x6c 0xae 0x69 0xaf 0x6a 0xe7 0x73 0xee 0x66 0xb3 0x8b 0xbf 0x74 0xbe 0x71 0xef 0x72 0xff 0x184 0xb1 0x2 0xf2 0x3 0xf3 0x4 0xb5 0x5 0xf6 0x6 0xf7 0x7 0xb9 0x8 0xfa 0x9 0xfb 0xa 0xfe 0xb 0xbd 0xe 0xbc 0x8d 0xf0 0x2c3>;
		};
		ir_key3 {
			rockchip,usercode = <0xdf00>;
			rockchip,key_table = <0xf9 0xe8 0xf5 0x9e 0xe5 0x67 0xb7 0x6c 0xb8 0x69 0xf8 0x6a 0xb4 0x73 0xb0 0x72 0xe3 0x74 0xe7 0x8b 0xfc 0x66 0xab 0x2 0xe9 0x3 0xea 0x4 0xaf 0x5 0xed 0x6 0xee 0x7 0xb3 0x8 0xf1 0x9 0xf2 0xa 0xf3 0xb 0xfe 0x3c 0xa0 0x3d 0xa4 0x3e 0xbe 0x8d 0xf7 0x58 0xef 0xe 0xbd 0x184>;
		};
		ir_key4 {
			rockchip,usercode = <0xff>;
			rockchip,key_table = <0xf8 0xe8 0xa3 0x9e 0xfc 0x67 0xfd 0x6c 0xf1 0x69 0xe5 0x6a 0xf4 0x73 0xa7 0x72 0xeb 0x74 0xec 0x8b 0xb7 0x66 0xef 0x3c 0xf2 0x3d 0x7d 0x8d>;
		};
		ir_key5 {
			rockchip,usercode = <0xf708>;
			rockchip,key_table = <0x9a 0xe8 0x9c 0x9e 0x9d 0x67 0x97 0x6c 0x9b 0x69 0x99 0x6a 0x7e 0x73 0x7d 0x72 0x7f 0x74 0x98 0x8b 0x9f 0x66 0x9f 0x66 0x86 0x71 0x87 0x42 0x8d 0x184 0xa 0x3f 0xba 0x40>;
		};
		ir_key6 {
			rockchip,usercode = <0x1608>;
			rockchip,key_table = <0xb0 0x66 0x74 0x9e 0x75 0x8b 0x4d 0x1c 0x7b 0x67 0x72 0x6c 0x44 0x69 0x71 0x6a 0x4a 0x72 0x76 0x73 0xa4 0x71 0x78 0x74 0x23 0x3e 0xa 0x3f 0xba 0x40 0x99 0x41>;
		};
		ir_key7 {
			rockchip,usercode = <0x7f80>;
			rockchip,key_table = <0xf2 0xe8 0xe4 0x9e 0xd9 0x67 0xd7 0x6c 0xda 0x69 0xd8 0x6a 0xac 0x66 0xb1 0x73 0xa9 0x72 0xae 0x74 0xb2 0x71 0xb6 0x8b 0xad 0x184 0xce 0x2 0xcd 0x3 0xcc 0x4 0xcb 0x5 0xca 0x6 0xc9 0x7 0xc8 0x8 0xc7 0x9 0xc6 0xa 0xcf 0xb 0x42 0xa3 0x44 0xa5 0xbb 0xe 0xa7 0x34 0xee 0x188 0xab 0x96 0xf6 0x189 0xb0 0x244>;
		};
		ir_key8 {
			rockchip,usercode = <0x4040>;
			rockchip,key_table = <0xf2 0xe8 0xbd 0x9e 0xf4 0x67 0xf1 0x6c 0xef 0x69 0xee 0x6a 0xe5 0x66 0xe7 0x73 0xe8 0x72 0xb2 0x74 0xbc 0x71 0xba 0x8b 0xfe 0x2 0xfd 0x3 0xfc 0x4 0xfb 0x5 0xfa 0x6 0xf9 0x7 0xf8 0x8 0xf7 0x9 0xf6 0xa 0xff 0xb 0xb8 0x184 0xa4 0x2c1 0xa8 0x2c2 0xab 0x2c3 0xe0 0xa5 0xac 0xa4 0xe1 0xa3 0xf3 0xe 0xbb 0x34 0x54 0x8d>;
		};
		ir_key9 {
			rockchip,usercode = <0x1dcc>;
			rockchip,key_table = <0xee 0xe8 0xf0 0x9e 0xf8 0x67 0xbb 0x6c 0xef 0x69 0xed 0x6a 0xfc 0x66 0xf1 0x73 0xfd 0x72 0xb7 0xd9 0xff 0x74 0xf3 0x71 0xbf 0x8b 0xf9 0x191 0xf5 0x192 0xb3 0x184 0xbe 0x2 0xba 0x3 0xb2 0x4 0xbd 0x5 0xf9 0x6 0xb1 0x7 0xfc 0x8 0xf8 0x9 0xb0 0xa 0xb6 0xb 0xb5 0xe>;
		};
	};
	pwm@fe6f0000 {
		compatible = "rockchip,rk3568-pwm", "rockchip,rk3328-pwm";
		reg = <0x0 0xfe6f0000 0x0 0x10>;
		#pwm-cells = <0x3>;
		pinctrl-names = "active";
		pinctrl-0 = <0x111>;
		clocks = <0x24 0x15d 0x24 0x15c>;
		clock-names = "pwm", "pclk";
		status = "disabled";
	};
	pwm@fe6f0010 {
		compatible = "rockchip,rk3568-pwm", "rockchip,rk3328-pwm";
		reg = <0x0 0xfe6f0010 0x0 0x10>;
		#pwm-cells = <0x3>;
		pinctrl-names = "active";
		pinctrl-0 = <0x112>;
		clocks = <0x24 0x15d 0x24 0x15c>;
		clock-names = "pwm", "pclk";
		status = "disabled";
	};
	pwm@fe6f0020 {
		compatible = "rockchip,rk3568-pwm", "rockchip,rk3328-pwm";
		reg = <0x0 0xfe6f0020 0x0 0x10>;
		#pwm-cells = <0x3>;
		pinctrl-names = "active";
		pinctrl-0 = <0x113>;
		clocks = <0x24 0x15d 0x24 0x15c>;
		clock-names = "pwm", "pclk";
		status = "disabled";
	};
	pwm@fe6f0030 {
		compatible = "rockchip,rk3568-pwm", "rockchip,rk3328-pwm";
		reg = <0x0 0xfe6f0030 0x0 0x10>;
		interrupts = <0x0 0x54 0x4 0x0 0x58 0x4>;
		#pwm-cells = <0x3>;
		pinctrl-names = "active";
		pinctrl-0 = <0x114>;
		clocks = <0x24 0x15d 0x24 0x15c>;
		clock-names = "pwm", "pclk";
		status = "disabled";
	};
	pwm@fe700000 {
		compatible = "rockchip,rk3568-pwm", "rockchip,rk3328-pwm";
		reg = <0x0 0xfe700000 0x0 0x10>;
		#pwm-cells = <0x3>;
		pinctrl-names = "active";
		pinctrl-0 = <0x115>;
		clocks = <0x24 0x160 0x24 0x15f>;
		clock-names = "pwm", "pclk";
		status = "disabled";
	};
	pwm@fe700010 {
		compatible = "rockchip,rk3568-pwm", "rockchip,rk3328-pwm";
		reg = <0x0 0xfe700010 0x0 0x10>;
		#pwm-cells = <0x3>;
		pinctrl-names = "active";
		pinctrl-0 = <0x116>;
		clocks = <0x24 0x160 0x24 0x15f>;
		clock-names = "pwm", "pclk";
		status = "disabled";
	};
	pwm@fe700020 {
		compatible = "rockchip,rk3568-pwm", "rockchip,rk3328-pwm";
		reg = <0x0 0xfe700020 0x0 0x10>;
		#pwm-cells = <0x3>;
		pinctrl-names = "active";
		pinctrl-0 = <0x117>;
		clocks = <0x24 0x160 0x24 0x15f>;
		clock-names = "pwm", "pclk";
		status = "disabled";
	};
	pwm@fe700030 {
		compatible = "rockchip,rk3568-pwm", "rockchip,rk3328-pwm";
		reg = <0x0 0xfe700030 0x0 0x10>;
		interrupts = <0x0 0x55 0x4 0x0 0x59 0x4>;
		#pwm-cells = <0x3>;
		pinctrl-names = "active";
		pinctrl-0 = <0x118>;
		clocks = <0x24 0x160 0x24 0x15f>;
		clock-names = "pwm", "pclk";
		status = "disabled";
	};
	tsadc@fe710000 {
		compatible = "rockchip,rk3568-tsadc";
		reg = <0x0 0xfe710000 0x0 0x100>;
		interrupts = <0x0 0x73 0x4>;
		rockchip,grf = <0x3a>;
		clocks = <0x24 0x111 0x24 0x10f>;
		clock-names = "tsadc", "apb_pclk";
		assigned-clocks = <0x24 0x110 0x24 0x111>;
		assigned-clock-rates = <0x1036640 0xaae60>;
		resets = <0x24 0x182 0x24 0x181 0x24 0x1d7>;
		reset-names = "tsadc", "tsadc-apb", "tsadc-phy";
		#thermal-sensor-cells = <0x1>;
		nvmem-cells = <0x119 0x11a>;
		nvmem-cell-names = "trim_base", "trim_base_frac";
		rockchip,hw-tshut-temp = <0x1d4c0>;
		rockchip,hw-tshut-mode = <0x0>;
		rockchip,hw-tshut-polarity = <0x0>;
		pinctrl-names = "gpio", "otpout";
		pinctrl-0 = <0x11b>;
		pinctrl-1 = <0x11c>;
		#address-cells = <0x1>;
		#size-cells = <0x0>;
		status = "okay";
		phandle = <0x20>;
		tsadc@0 {
			reg = <0x0>;
			nvmem-cells = <0x11d 0x11e>;
			nvmem-cell-names = "trim_l", "trim_h";
		};
		tsadc@1 {
			reg = <0x1>;
			nvmem-cells = <0x11f 0x120>;
			nvmem-cell-names = "trim_l", "trim_h";
		};
	};
	saradc@fe720000 {
		compatible = "rockchip,rk3568-saradc", "rockchip,rk3399-saradc";
		reg = <0x0 0xfe720000 0x0 0x100>;
		interrupts = <0x0 0x5d 0x4>;
		#io-channel-cells = <0x1>;
		clocks = <0x24 0x113 0x24 0x112>;
		clock-names = "saradc", "apb_pclk";
		resets = <0x24 0x180>;
		reset-names = "saradc-apb";
		status = "okay";
		vref-supply = <0x121>;
		phandle = <0x139>;
	};
	mailbox@fe780000 {
		compatible = "rockchip,rk3568-mailbox", "rockchip,rk3368-mailbox";
		reg = <0x0 0xfe780000 0x0 0x1000>;
		interrupts = <0x0 0xb7 0x4 0x0 0xb8 0x4 0x0 0xb9 0x4 0x0 0xba 0x4>;
		clocks = <0x24 0x11b>;
		clock-names = "pclk_mailbox";
		#mbox-cells = <0x1>;
		status = "disabled";
	};
	phy@fe820000 {
		compatible = "rockchip,rk3568-naneng-combphy";
		reg = <0x0 0xfe820000 0x0 0x100>;
		#phy-cells = <0x1>;
		clocks = <0x39 0x1f 0x24 0x17c 0x24 0x7f>;
		clock-names = "refclk", "apbclk", "pipe_clk";
		assigned-clocks = <0x39 0x1f>;
		assigned-clock-rates = <0x5f5e100>;
		resets = <0x24 0x1c4 0x24 0x1c5>;
		reset-names = "combphy-apb", "combphy";
		rockchip,pipe-grf = <0x122>;
		rockchip,pipe-phy-grf = <0x123>;
		status = "okay";
		phandle = <0x25>;
	};
	phy@fe830000 {
		compatible = "rockchip,rk3568-naneng-combphy";
		reg = <0x0 0xfe830000 0x0 0x100>;
		#phy-cells = <0x1>;
		clocks = <0x39 0x22 0x24 0x17d 0x24 0x7f>;
		clock-names = "refclk", "apbclk", "pipe_clk";
		assigned-clocks = <0x39 0x22>;
		assigned-clock-rates = <0x5f5e100>;
		resets = <0x24 0x1c6 0x24 0x1c7>;
		reset-names = "combphy-apb", "combphy";
		rockchip,pipe-grf = <0x122>;
		rockchip,pipe-phy-grf = <0x124>;
		status = "okay";
		phandle = <0x27>;
	};
	phy@fe840000 {
		compatible = "rockchip,rk3568-naneng-combphy";
		reg = <0x0 0xfe840000 0x0 0x100>;
		#phy-cells = <0x1>;
		clocks = <0x39 0x25 0x24 0x17e 0x24 0x7f>;
		clock-names = "refclk", "apbclk", "pipe_clk";
		assigned-clocks = <0x39 0x25>;
		assigned-clock-rates = <0x5f5e100>;
		resets = <0x24 0x1c8 0x24 0x1c9>;
		reset-names = "combphy-apb", "combphy";
		rockchip,pipe-grf = <0x122>;
		rockchip,pipe-phy-grf = <0x125>;
		status = "okay";
		phandle = <0x28>;
	};
	phy@fe850000 {
		compatible = "rockchip,rk3568-dsi-dphy", "rockchip,rk3568-video-phy";
		reg = <0x0 0xfe850000 0x0 0x10000 0x0 0xfe060000 0x0 0x10000>;
		reg-names = "phy", "host";
		clocks = <0x39 0x17 0x24 0x17a 0x24 0xe8>;
		clock-names = "ref", "pclk", "pclk_host";
		#clock-cells = <0x0>;
		resets = <0x24 0x1bb>;
		reset-names = "apb";
		power-domains = <0x26 0x9>;
		#phy-cells = <0x0>;
		status = "okay";
		phandle = <0x34>;
	};
	phy@fe860000 {
		compatible = "rockchip,rk3568-dsi-dphy", "rockchip,rk3568-video-phy";
		reg = <0x0 0xfe860000 0x0 0x10000 0x0 0xfe070000 0x0 0x10000>;
		reg-names = "phy", "host";
		clocks = <0x39 0x19 0x24 0x17b 0x24 0xe9>;
		clock-names = "ref", "pclk", "pclk_host";
		#clock-cells = <0x0>;
		resets = <0x24 0x1bc>;
		reset-names = "apb";
		power-domains = <0x26 0x9>;
		#phy-cells = <0x0>;
		status = "disabled";
		phandle = <0x36>;
	};
	csi2-dphy-hw@fe870000 {
		compatible = "rockchip,rk3568-csi2-dphy-hw";
		reg = <0x0 0xfe870000 0x0 0x1000>;
		clocks = <0x24 0x179>;
		clock-names = "pclk";
		rockchip,grf = <0x3a>;
		status = "okay";
		phandle = <0x126>;
	};
	csi2-dphy0 {
		compatible = "rockchip,rk3568-csi2-dphy";
		rockchip,hw = <0x126>;
		status = "okay";
		ports {
			#address-cells = <0x1>;
			#size-cells = <0x0>;
			port@0 {
				reg = <0x0>;
				#address-cells = <0x1>;
				#size-cells = <0x0>;
				endpoint@1 {
					reg = <0x1>;
					remote-endpoint = <0x127>;
					data-lanes = <0x1 0x2>;
					phandle = <0xf3>;
				};
				endpoint@2 {
					reg = <0x2>;
					remote-endpoint = <0x128>;
					data-lanes = <0x1 0x2>;
					phandle = <0xf0>;
				};
			};
			port@1 {
				reg = <0x1>;
				#address-cells = <0x1>;
				#size-cells = <0x0>;
				endpoint@0 {
					reg = <0x0>;
					remote-endpoint = <0x129>;
					phandle = <0x85>;
				};
			};
		};
	};
	csi2-dphy1 {
		compatible = "rockchip,rk3568-csi2-dphy";
		rockchip,hw = <0x126>;
		status = "disabled";
	};
	csi2-dphy2 {
		compatible = "rockchip,rk3568-csi2-dphy";
		rockchip,hw = <0x126>;
		status = "disabled";
	};
	usb2-phy@fe8a0000 {
		compatible = "rockchip,rk3568-usb2phy";
		reg = <0x0 0xfe8a0000 0x0 0x10000>;
		interrupts = <0x0 0x87 0x4>;
		clocks = <0x39 0x13>;
		clock-names = "phyclk";
		#clock-cells = <0x0>;
		assigned-clocks = <0x24 0xb>;
		assigned-clock-parents = <0x2a>;
		clock-output-names = "usb480m_phy";
		rockchip,usbgrf = <0x12a>;
		status = "okay";
		phandle = <0x2a>;
		host-port {
			#phy-cells = <0x0>;
			status = "okay";
			phy-supply = <0x12b>;
			phandle = <0x2b>;
		};
		otg-port {
			#phy-cells = <0x0>;
			status = "okay";
			vbus-supply = <0x12c>;
			phandle = <0x29>;
		};
	};
	usb2-phy@fe8b0000 {
		compatible = "rockchip,rk3568-usb2phy";
		reg = <0x0 0xfe8b0000 0x0 0x10000>;
		interrupts = <0x0 0x88 0x4>;
		clocks = <0x39 0x15>;
		clock-names = "phyclk";
		#clock-cells = <0x0>;
		rockchip,usbgrf = <0x12d>;
		status = "okay";
		phandle = <0x2c>;
		host-port {
			#phy-cells = <0x0>;
			status = "okay";
			phy-supply = <0x12b>;
			phandle = <0x2e>;
		};
		otg-port {
			#phy-cells = <0x0>;
			status = "okay";
			phy-supply = <0x12b>;
			phandle = <0x2d>;
		};
	};
	phy@fe8c0000 {
		compatible = "rockchip,rk3568-pcie3-phy";
		reg = <0x0 0xfe8c0000 0x0 0x20000>;
		#phy-cells = <0x0>;
		clocks = <0x39 0x26 0x39 0x27 0x24 0x177>;
		clock-names = "refclk_m", "refclk_n", "pclk";
		resets = <0x24 0x1be>;
		reset-names = "phy";
		rockchip,phy-grf = <0x12e>;
		status = "okay";
		phandle = <0xbd>;
	};
	pinctrl {
		compatible = "rockchip,rk3568-pinctrl";
		rockchip,grf = <0x3a>;
		rockchip,pmu = <0x3b>;
		#address-cells = <0x2>;
		#size-cells = <0x2>;
		ranges;
		gpio0@fdd60000 {
			compatible = "rockchip,gpio-bank";
			reg = <0x0 0xfdd60000 0x0 0x100>;
			interrupts = <0x0 0x21 0x4>;
			clocks = <0x39 0x2e 0x39 0xc>;
			gpio-controller;
			#gpio-cells = <0x2>;
			interrupt-controller;
			#interrupt-cells = <0x2>;
			phandle = <0x3e>;
		};
		gpio1@fe740000 {
			compatible = "rockchip,gpio-bank";
			reg = <0x0 0xfe740000 0x0 0x100>;
			interrupts = <0x0 0x22 0x4>;
			clocks = <0x24 0x163 0x24 0x164>;
			gpio-controller;
			#gpio-cells = <0x2>;
			interrupt-controller;
			#interrupt-cells = <0x2>;
			phandle = <0xf2>;
		};
		gpio2@fe750000 {
			compatible = "rockchip,gpio-bank";
			reg = <0x0 0xfe750000 0x0 0x100>;
			interrupts = <0x0 0x23 0x4>;
			clocks = <0x24 0x165 0x24 0x166>;
			gpio-controller;
			#gpio-cells = <0x2>;
			interrupt-controller;
			#interrupt-cells = <0x2>;
			phandle = <0xbf>;
		};
		gpio3@fe760000 {
			compatible = "rockchip,gpio-bank";
			reg = <0x0 0xfe760000 0x0 0x100>;
			interrupts = <0x0 0x24 0x4>;
			clocks = <0x24 0x167 0x24 0x168>;
			gpio-controller;
			#gpio-cells = <0x2>;
			interrupt-controller;
			#interrupt-cells = <0x2>;
			phandle = <0x8a>;
		};
		gpio4@fe770000 {
			compatible = "rockchip,gpio-bank";
			reg = <0x0 0xfe770000 0x0 0x100>;
			interrupts = <0x0 0x25 0x4>;
			clocks = <0x24 0x169 0x24 0x16a>;
			gpio-controller;
			#gpio-cells = <0x2>;
			interrupt-controller;
			#interrupt-cells = <0x2>;
			phandle = <0x13d>;
		};
		pcfg-pull-up {
			bias-pull-up;
			phandle = <0x131>;
		};
		pcfg-pull-down {
			bias-pull-down;
			phandle = <0x138>;
		};
		pcfg-pull-none {
			bias-disable;
			phandle = <0x12f>;
		};
		pcfg-pull-none-drv-level-1 {
			bias-disable;
			drive-strength = <0x1>;
			phandle = <0x133>;
		};
		pcfg-pull-none-drv-level-2 {
			bias-disable;
			drive-strength = <0x2>;
			phandle = <0x132>;
		};
		pcfg-pull-none-drv-level-3 {
			bias-disable;
			drive-strength = <0x3>;
			phandle = <0x137>;
		};
		pcfg-pull-up-drv-level-1 {
			bias-pull-up;
			drive-strength = <0x1>;
			phandle = <0x136>;
		};
		pcfg-pull-up-drv-level-2 {
			bias-pull-up;
			drive-strength = <0x2>;
			phandle = <0x130>;
		};
		pcfg-pull-none-smt {
			bias-disable;
			input-schmitt-enable;
			phandle = <0x134>;
		};
		pcfg-output-low {
			output-low;
			phandle = <0x135>;
		};
		acodec {
			acodec-pins {
				rockchip,pins = <0x1 0x9 0x5 0x12f 0x1 0x1 0x5 0x12f 0x1 0x0 0x5 0x12f 0x1 0x7 0x5 0x12f 0x1 0x8 0x5 0x12f 0x1 0x3 0x5 0x12f 0x1 0x5 0x5 0x12f>;
				phandle = <0xe5>;
			};
		};
		audiopwm {
		};
		bt656 {
		};
		bt1120 {
		};
		cam {
			camera-pwr {
				rockchip,pins = <0x1 0x1b 0x0 0x12f>;
			};
		};
		can0 {
			can0m1-pins {
				rockchip,pins = <0x2 0x2 0x4 0x12f 0x2 0x1 0x4 0x12f>;
				phandle = <0xe7>;
			};
		};
		can1 {
			can1m1-pins {
				rockchip,pins = <0x4 0x12 0x3 0x12f 0x4 0x13 0x3 0x12f>;
				phandle = <0xe8>;
			};
		};
		can2 {
			can2m1-pins {
				rockchip,pins = <0x2 0x9 0x4 0x12f 0x2 0xa 0x4 0x12f>;
				phandle = <0xe9>;
			};
		};
		cif {
			cif-clk {
				rockchip,pins = <0x4 0x10 0x1 0x12f>;
				phandle = <0xf1>;
			};
		};
		clk32k {
			clk32k-out0 {
				rockchip,pins = <0x0 0x8 0x2 0x12f>;
				phandle = <0x23>;
			};
		};
		cpu {
		};
		ebc {
			ebc-pins {
				rockchip,pins = <0x4 0x10 0x2 0x12f 0x4 0xb 0x2 0x12f 0x4 0xc 0x2 0x12f 0x4 0x6 0x2 0x12f 0x4 0x11 0x2 0x12f 0x3 0x16 0x2 0x12f 0x3 0x17 0x2 0x12f 0x3 0x18 0x2 0x12f 0x3 0x19 0x2 0x12f 0x3 0x1a 0x2 0x12f 0x3 0x1b 0x2 0x12f 0x3 0x1c 0x2 0x12f 0x3 0x1d 0x2 0x12f 0x3 0x1e 0x2 0x12f 0x3 0x1f 0x2 0x12f 0x4 0x0 0x2 0x12f 0x4 0x1 0x2 0x12f 0x4 0x2 0x2 0x12f 0x4 0x3 0x2 0x12f 0x4 0x4 0x2 0x12f 0x4 0x5 0x2 0x12f 0x4 0xe 0x2 0x12f 0x4 0xf 0x2 0x12f>;
				phandle = <0x75>;
			};
		};
		edpdp {
		};
		emmc {
		};
		eth0 {
		};
		eth1 {
		};
		flash {
		};
		fspi {
		};
		gmac0 {
			gmac0-miim {
				rockchip,pins = <0x2 0x13 0x2 0x12f 0x2 0x14 0x2 0x12f>;
				phandle = <0xc5>;
			};
			gmac0-rx-bus2 {
				rockchip,pins = <0x2 0xe 0x1 0x12f 0x2 0xf 0x2 0x12f 0x2 0x10 0x2 0x12f>;
				phandle = <0xc7>;
			};
			gmac0-tx-bus2 {
				rockchip,pins = <0x2 0xb 0x1 0x132 0x2 0xc 0x1 0x132 0x2 0xd 0x1 0x12f>;
				phandle = <0xc6>;
			};
			gmac0-rgmii-clk {
				rockchip,pins = <0x2 0x5 0x2 0x12f 0x2 0x8 0x2 0x133>;
				phandle = <0xc8>;
			};
			gmac0-rgmii-bus {
				rockchip,pins = <0x2 0x3 0x2 0x12f 0x2 0x4 0x2 0x12f 0x2 0x6 0x2 0x132 0x2 0x7 0x2 0x132>;
				phandle = <0xc9>;
			};
		};
		gmac1 {
			gmac1m1-miim {
				rockchip,pins = <0x4 0xe 0x3 0x12f 0x4 0xf 0x3 0x12f>;
				phandle = <0x8b>;
			};
			gmac1m1-rx-bus2 {
				rockchip,pins = <0x4 0x7 0x3 0x12f 0x4 0x8 0x3 0x12f 0x4 0x9 0x3 0x12f>;
				phandle = <0x8d>;
			};
			gmac1m1-tx-bus2 {
				rockchip,pins = <0x4 0x4 0x3 0x132 0x4 0x5 0x3 0x132 0x4 0x6 0x3 0x12f>;
				phandle = <0x8c>;
			};
			gmac1m1-rgmii-clk {
				rockchip,pins = <0x4 0x3 0x3 0x12f 0x4 0x0 0x3 0x133>;
				phandle = <0x8e>;
			};
			gmac1m1-rgmii-bus {
				rockchip,pins = <0x4 0x1 0x3 0x12f 0x4 0x2 0x3 0x12f 0x3 0x1e 0x3 0x132 0x3 0x1f 0x3 0x132>;
				phandle = <0x8f>;
			};
		};
		gpu {
		};
		hdmitx {
			hdmitxm0-cec {
				rockchip,pins = <0x4 0x19 0x1 0x12f>;
				phandle = <0xa8>;
			};
			hdmitx-scl {
				rockchip,pins = <0x4 0x17 0x1 0x12f>;
				phandle = <0xa6>;
			};
			hdmitx-sda {
				rockchip,pins = <0x4 0x18 0x1 0x12f>;
				phandle = <0xa7>;
			};
		};
		i2c0 {
			i2c0-xfer {
				rockchip,pins = <0x0 0x9 0x1 0x134 0x0 0xa 0x1 0x134>;
				phandle = <0x3c>;
			};
		};
		i2c1 {
			i2c1-xfer {
				rockchip,pins = <0x0 0xb 0x1 0x134 0x0 0xc 0x1 0x134>;
				phandle = <0xea>;
			};
		};
		i2c2 {
			i2c2m1-xfer {
				rockchip,pins = <0x4 0xd 0x1 0x134 0x4 0xc 0x1 0x134>;
				phandle = <0xec>;
			};
		};
		i2c3 {
			i2c3m0-xfer {
				rockchip,pins = <0x1 0x1 0x1 0x134 0x1 0x0 0x1 0x134>;
				phandle = <0xed>;
			};
		};
		i2c4 {
			i2c4m0-xfer {
				rockchip,pins = <0x4 0xb 0x1 0x134 0x4 0xa 0x1 0x134>;
				phandle = <0xee>;
			};
		};
		i2c5 {
			i2c5m0-xfer {
				rockchip,pins = <0x3 0xb 0x4 0x134 0x3 0xc 0x4 0x134>;
				phandle = <0xf4>;
			};
		};
		i2s1 {
			i2s1m0-lrcktx {
				rockchip,pins = <0x1 0x5 0x1 0x134>;
				phandle = <0xd2>;
			};
			i2s1m0-mclk {
				rockchip,pins = <0x1 0x2 0x1 0x134>;
				phandle = <0x46>;
			};
			i2s1m0-sclktx {
				rockchip,pins = <0x1 0x3 0x1 0x134>;
				phandle = <0xd1>;
			};
			i2s1m0-sdi0 {
				rockchip,pins = <0x1 0xb 0x1 0x12f>;
				phandle = <0xd3>;
			};
			i2s1m0-sdo0 {
				rockchip,pins = <0x1 0x7 0x1 0x12f>;
				phandle = <0xd4>;
			};
		};
		i2s2 {
			i2s2m0-lrcktx {
				rockchip,pins = <0x2 0x13 0x1 0x134>;
				phandle = <0xd6>;
			};
			i2s2m0-sclktx {
				rockchip,pins = <0x2 0x12 0x1 0x134>;
				phandle = <0xd5>;
			};
			i2s2m0-sdi {
				rockchip,pins = <0x2 0x15 0x1 0x12f>;
				phandle = <0xd7>;
			};
			i2s2m0-sdo {
				rockchip,pins = <0x2 0x14 0x1 0x12f>;
				phandle = <0xd8>;
			};
		};
		i2s3 {
			i2s3m0-lrck {
				rockchip,pins = <0x3 0x4 0x4 0x134>;
				phandle = <0xda>;
			};
			i2s3m0-sclk {
				rockchip,pins = <0x3 0x3 0x4 0x134>;
				phandle = <0xd9>;
			};
			i2s3m0-sdi {
				rockchip,pins = <0x3 0x6 0x4 0x12f>;
				phandle = <0xdb>;
			};
			i2s3m0-sdo {
				rockchip,pins = <0x3 0x5 0x4 0x12f>;
				phandle = <0xdc>;
			};
		};
		isp {
		};
		jtag {
		};
		lcdc {
			lcdc-ctl {
				rockchip,pins = <0x3 0x0 0x1 0x12f 0x2 0x18 0x1 0x12f 0x2 0x19 0x1 0x12f 0x2 0x1a 0x1 0x12f 0x2 0x1b 0x1 0x12f 0x2 0x1c 0x1 0x12f 0x2 0x1d 0x1 0x12f 0x2 0x1e 0x1 0x12f 0x2 0x1f 0x1 0x12f 0x3 0x1 0x1 0x12f 0x3 0x2 0x1 0x12f 0x3 0x3 0x1 0x12f 0x3 0x4 0x1 0x12f 0x3 0x5 0x1 0x12f 0x3 0x6 0x1 0x12f 0x3 0x7 0x1 0x12f 0x3 0x8 0x1 0x12f 0x3 0x9 0x1 0x12f 0x3 0xa 0x1 0x12f 0x3 0xb 0x1 0x12f 0x3 0xc 0x1 0x12f 0x3 0xd 0x1 0x12f 0x3 0xe 0x1 0x12f 0x3 0xf 0x1 0x12f 0x3 0x10 0x1 0x12f 0x3 0x13 0x1 0x12f 0x3 0x11 0x1 0x12f 0x3 0x12 0x1 0x12f>;
				phandle = <0x38>;
			};
		};
		mcu {
		};
		npu {
		};
		pcie20 {
		};
		pcie30x1 {
		};
		pcie30x2 {
		};
		pdm {
			pdmm0-clk {
				rockchip,pins = <0x1 0x6 0x3 0x12f>;
				phandle = <0xdd>;
			};
			pdmm0-clk1 {
				rockchip,pins = <0x1 0x4 0x3 0x12f>;
				phandle = <0xde>;
			};
			pdmm0-sdi0 {
				rockchip,pins = <0x1 0xb 0x2 0x12f>;
				phandle = <0xdf>;
			};
			pdmm0-sdi1 {
				rockchip,pins = <0x1 0xa 0x3 0x12f>;
				phandle = <0xe0>;
			};
			pdmm0-sdi2 {
				rockchip,pins = <0x1 0x9 0x3 0x12f>;
				phandle = <0xe1>;
			};
			pdmm0-sdi3 {
				rockchip,pins = <0x1 0x8 0x3 0x12f>;
				phandle = <0xe2>;
			};
		};
		pmic {
			pmic_int {
				rockchip,pins = <0x0 0x3 0x0 0x131>;
				phandle = <0x3f>;
			};
			soc_slppin_gpio {
				rockchip,pins = <0x0 0x2 0x0 0x135>;
				phandle = <0x42>;
			};
			soc_slppin_slp {
				rockchip,pins = <0x0 0x2 0x1 0x12f>;
				phandle = <0x40>;
			};
			soc_slppin_rst {
				rockchip,pins = <0x0 0x2 0x2 0x12f>;
			};
		};
		pmu {
		};
		pwm0 {
			pwm0m0-pins {
				rockchip,pins = <0x0 0xf 0x1 0x12f>;
				phandle = <0x49>;
			};
		};
		pwm1 {
			pwm1m0-pins {
				rockchip,pins = <0x0 0x10 0x1 0x12f>;
				phandle = <0x4a>;
			};
		};
		pwm2 {
			pwm2m0-pins {
				rockchip,pins = <0x0 0x11 0x1 0x12f>;
				phandle = <0x4b>;
			};
		};
		pwm3 {
			pwm3-pins {
				rockchip,pins = <0x0 0x12 0x1 0x12f>;
				phandle = <0x4c>;
			};
		};
		pwm4 {
			pwm4-pins {
				rockchip,pins = <0x0 0x13 0x1 0x12f>;
				phandle = <0x10d>;
			};
		};
		pwm5 {
			pwm5-pins {
				rockchip,pins = <0x0 0x14 0x1 0x12f>;
				phandle = <0x10e>;
			};
		};
		pwm6 {
			pwm6-pins {
				rockchip,pins = <0x0 0x15 0x1 0x12f>;
				phandle = <0x10f>;
			};
		};
		pwm7 {
			pwm7-pins {
				rockchip,pins = <0x0 0x16 0x1 0x12f>;
				phandle = <0x110>;
			};
		};
		pwm8 {
			pwm8m0-pins {
				rockchip,pins = <0x3 0x9 0x5 0x12f>;
				phandle = <0x111>;
			};
		};
		pwm9 {
			pwm9m0-pins {
				rockchip,pins = <0x3 0xa 0x5 0x12f>;
				phandle = <0x112>;
			};
		};
		pwm10 {
			pwm10m0-pins {
				rockchip,pins = <0x3 0xd 0x5 0x12f>;
				phandle = <0x113>;
			};
		};
		pwm11 {
			pwm11m0-pins {
				rockchip,pins = <0x3 0xe 0x5 0x12f>;
				phandle = <0x114>;
			};
		};
		pwm12 {
			pwm12m0-pins {
				rockchip,pins = <0x3 0xf 0x2 0x12f>;
				phandle = <0x115>;
			};
		};
		pwm13 {
			pwm13m0-pins {
				rockchip,pins = <0x3 0x10 0x2 0x12f>;
				phandle = <0x116>;
			};
		};
		pwm14 {
			pwm14m0-pins {
				rockchip,pins = <0x3 0x14 0x1 0x12f>;
				phandle = <0x117>;
			};
		};
		pwm15 {
			pwm15m0-pins {
				rockchip,pins = <0x3 0x15 0x1 0x12f>;
				phandle = <0x118>;
			};
		};
		refclk {
		};
		sata {
		};
		sata0 {
		};
		sata1 {
		};
		sata2 {
		};
		scr {
			scr-pins {
				rockchip,pins = <0x1 0x2 0x3 0x12f 0x1 0x7 0x3 0x131 0x1 0x3 0x3 0x131 0x1 0x5 0x3 0x12f>;
				phandle = <0xe6>;
			};
		};
		sdmmc0 {
			sdmmc0-bus4 {
				rockchip,pins = <0x1 0x1d 0x1 0x130 0x1 0x1e 0x1 0x130 0x1 0x1f 0x1 0x130 0x2 0x0 0x1 0x130>;
				phandle = <0xcc>;
			};
			sdmmc0-clk {
				rockchip,pins = <0x2 0x2 0x1 0x130>;
				phandle = <0xcd>;
			};
			sdmmc0-cmd {
				rockchip,pins = <0x2 0x1 0x1 0x130>;
				phandle = <0xce>;
			};
			sdmmc0-det {
				rockchip,pins = <0x0 0x4 0x1 0x131>;
				phandle = <0xcf>;
			};
		};
		sdmmc1 {
		};
		sdmmc2 {
			sdmmc2m0-bus4 {
				rockchip,pins = <0x3 0x16 0x3 0x130 0x3 0x17 0x3 0x130 0x3 0x18 0x3 0x130 0x3 0x19 0x3 0x130>;
				phandle = <0xad>;
			};
			sdmmc2m0-clk {
				rockchip,pins = <0x3 0x1b 0x3 0x130>;
				phandle = <0xaf>;
			};
			sdmmc2m0-cmd {
				rockchip,pins = <0x3 0x1a 0x3 0x130>;
				phandle = <0xae>;
			};
		};
		spdif {
			spdifm0-tx {
				rockchip,pins = <0x1 0x4 0x4 0x12f>;
				phandle = <0xe4>;
			};
		};
		spi0 {
			spi0m0-pins {
				rockchip,pins = <0x0 0xd 0x2 0x12f 0x0 0x15 0x2 0x12f 0x0 0xe 0x2 0x12f>;
				phandle = <0xf7>;
			};
			spi0m0-cs0 {
				rockchip,pins = <0x0 0x16 0x2 0x12f>;
				phandle = <0xf5>;
			};
			spi0m0-cs1 {
				rockchip,pins = <0x0 0x14 0x2 0x12f>;
				phandle = <0xf6>;
			};
		};
		spi1 {
			spi1m0-pins {
				rockchip,pins = <0x2 0xd 0x3 0x12f 0x2 0xe 0x3 0x12f 0x2 0xf 0x4 0x12f>;
				phandle = <0xfb>;
			};
			spi1m0-cs0 {
				rockchip,pins = <0x2 0x10 0x4 0x12f>;
				phandle = <0xf9>;
			};
			spi1m0-cs1 {
				rockchip,pins = <0x2 0x16 0x3 0x12f>;
				phandle = <0xfa>;
			};
		};
		spi2 {
			spi2m0-pins {
				rockchip,pins = <0x2 0x11 0x4 0x12f 0x2 0x12 0x4 0x12f 0x2 0x13 0x4 0x12f>;
				phandle = <0xff>;
			};
			spi2m0-cs0 {
				rockchip,pins = <0x2 0x14 0x4 0x12f>;
				phandle = <0xfd>;
			};
			spi2m0-cs1 {
				rockchip,pins = <0x2 0x15 0x4 0x12f>;
				phandle = <0xfe>;
			};
		};
		spi3 {
			spi3m1-pins {
				rockchip,pins = <0x4 0x12 0x2 0x12f 0x4 0x15 0x2 0x12f 0x4 0x13 0x2 0x12f>;
				phandle = <0x101>;
			};
		};
		tsadc {
			tsadc-shutorg {
				rockchip,pins = <0x0 0x1 0x2 0x12f>;
				phandle = <0x11c>;
			};
		};
		uart0 {
			uart0-xfer {
				rockchip,pins = <0x0 0x10 0x3 0x131 0x0 0x11 0x3 0x131>;
				phandle = <0x48>;
			};
		};
		uart1 {
			uart1m0-xfer {
				rockchip,pins = <0x2 0xb 0x2 0x131 0x2 0xc 0x2 0x131>;
				phandle = <0x103>;
			};
		};
		uart2 {
			uart2m0-xfer {
				rockchip,pins = <0x0 0x18 0x1 0x131 0x0 0x19 0x1 0x131>;
				phandle = <0x104>;
			};
		};
		uart3 {
			uart3m1-xfer {
				rockchip,pins = <0x3 0x10 0x4 0x131 0x3 0xf 0x4 0x131>;
				phandle = <0x105>;
			};
		};
		uart4 {
			uart4m1-xfer {
				rockchip,pins = <0x3 0x9 0x4 0x131 0x3 0xa 0x4 0x131>;
				phandle = <0x106>;
			};
		};
		uart5 {
			uart5m0-xfer {
				rockchip,pins = <0x2 0x1 0x3 0x131 0x2 0x2 0x3 0x131>;
				phandle = <0x107>;
			};
		};
		uart6 {
			uart6m0-xfer {
				rockchip,pins = <0x2 0x3 0x3 0x131 0x2 0x4 0x3 0x131>;
				phandle = <0x108>;
			};
		};
		uart7 {
			uart7m1-xfer {
				rockchip,pins = <0x3 0x15 0x4 0x131 0x3 0x14 0x4 0x131>;
				phandle = <0x109>;
			};
		};
		uart8 {
			uart8m0-xfer {
				rockchip,pins = <0x2 0x16 0x2 0x131 0x2 0x15 0x3 0x131>;
				phandle = <0x10a>;
			};
			uart8m0-ctsn {
				rockchip,pins = <0x2 0xa 0x3 0x12f>;
				phandle = <0x10b>;
			};
			uart8m0-rtsn {
				rockchip,pins = <0x2 0x9 0x3 0x12f>;
				phandle = <0x149>;
			};
		};
		uart9 {
			uart9m0-xfer {
				rockchip,pins = <0x2 0x7 0x3 0x131 0x2 0x8 0x3 0x131>;
				phandle = <0x10c>;
			};
		};
		vop {
		};
		spi0-hs {
			spi0m0-pins {
				rockchip,pins = <0x0 0xd 0x2 0x136 0x0 0x15 0x2 0x136 0x0 0xe 0x2 0x136>;
				phandle = <0xf8>;
			};
		};
		spi1-hs {
			spi1m0-pins {
				rockchip,pins = <0x2 0xd 0x3 0x136 0x2 0xe 0x3 0x136 0x2 0xf 0x4 0x136>;
				phandle = <0xfc>;
			};
		};
		spi2-hs {
			spi2m0-pins {
				rockchip,pins = <0x2 0x11 0x4 0x136 0x2 0x12 0x4 0x136 0x2 0x13 0x4 0x136>;
				phandle = <0x100>;
			};
		};
		spi3-hs {
			spi3m1-pins {
				rockchip,pins = <0x4 0x12 0x2 0x136 0x4 0x15 0x2 0x136 0x4 0x13 0x2 0x136>;
				phandle = <0x102>;
			};
		};
		gmac-txd-level3 {
		};
		gmac-txc-level2 {
		};
		gpio-func {
			tsadc-gpio-func {
				rockchip,pins = <0x0 0x1 0x0 0x12f>;
				phandle = <0x11b>;
			};
		};
		wireless-bluetooth {
			uart8-gpios {
				rockchip,pins = <0x2 0x9 0x0 0x12f>;
				phandle = <0x14a>;
			};
		};
		sdio-pwrseq {
			wifi-enable-h {
				rockchip,pins = <0x3 0x1d 0x0 0x131>;
				phandle = <0x147>;
			};
		};
		wireless-wlan {
			wifi-host-wake-irq {
				rockchip,pins = <0x3 0x1c 0x0 0x138>;
				phandle = <0x148>;
			};
		};
		usb {
			vcc5v0-host-en {
				rockchip,pins = <0x0 0x6 0x0 0x12f>;
				phandle = <0x14c>;
			};
			vcc5v0-otg-en {
				rockchip,pins = <0x0 0x5 0x0 0x12f>;
				phandle = <0x14d>;
			};
		};
		pcie3 {
			pcie3-power-en {
				rockchip,pins = <0x0 0x1c 0x0 0x12f>;
				phandle = <0x14e>;
			};
		};
		minipcie {
			minipcie-power-en {
				rockchip,pins = <0x3 0x13 0x0 0x12f>;
				phandle = <0x14f>;
			};
		};
		headphone {
			hp-det {
				rockchip,pins = <0x1 0x1b 0x0 0x131>;
				phandle = <0x141>;
			};
		};
		touch1 {
			touch-gpio {
				rockchip,pins = <0x3 0x3 0x0 0x131 0x0 0xe 0x0 0x12f>;
				phandle = <0xeb>;
			};
		};
	};
	adc-keys {
		compatible = "adc-keys";
		io-channels = <0x139 0x0>;
		io-channel-names = "buttons";
		keyup-threshold-microvolt = <0x1b7740>;
		poll-interval = <0x64>;
		vol-up-key {
			label = "volume up";
			linux,code = <0x73>;
			press-threshold-microvolt = <0x6d6>;
		};
	};
	audiopwmout-diff {
		status = "disabled";
		compatible = "simple-audio-card";
		simple-audio-card,format = "i2s";
		simple-audio-card,name = "rockchip,audiopwmout-diff";
		simple-audio-card,mclk-fs = <0x100>;
		simple-audio-card,bitclock-master = <0x13a>;
		simple-audio-card,frame-master = <0x13a>;
		simple-audio-card,cpu {
			sound-dai = <0x13b>;
		};
		simple-audio-card,codec {
			sound-dai = <0x13c>;
			phandle = <0x13a>;
		};
	};
	dc-12v {
		compatible = "regulator-fixed";
		regulator-name = "dc_12v";
		regulator-always-on;
		regulator-boot-on;
		regulator-min-microvolt = <0xb71b00>;
		regulator-max-microvolt = <0xb71b00>;
		phandle = <0x143>;
	};
	leds {
		compatible = "gpio-leds";
		work-led {
			gpios = <0x3e 0x1d 0x0>;
			linux,default-trigger = "heartbeat";
		};
		gpio1a4 {
			gpios = <0xf2 0x4 0x0>;
			default-state = "off";
		};
		gpio1b0 {
			gpios = <0xf2 0x8 0x0>;
			default-state = "off";
		};
		gpio1b1 {
			gpios = <0xf2 0x9 0x0>;
			default-state = "off";
		};
		gpio1b2 {
			gpios = <0xf2 0xa 0x0>;
			default-state = "off";
		};
		gpio4c4 {
			gpios = <0x13d 0x14 0x0>;
			default-state = "off";
		};
		gpio4c6 {
			gpios = <0x13d 0x16 0x0>;
			default-state = "off";
		};
		gpio3b6 {
			gpios = <0x8a 0xe 0x0>;
			default-state = "off";
		};
		gpio1d0 {
			gpios = <0xf2 0x18 0x0>;
			default-state = "off";
		};
		gpio1d4 {
			gpios = <0xf2 0x1c 0x0>;
			default-state = "off";
		};
		gpio3b5 {
			gpios = <0x8a 0xd 0x0>;
			default-state = "off";
		};
		fan {
			gpios = <0x3e 0x1e 0x0>;
			default-state = "on";
		};
	};
	dummy-codec {
		status = "disabled";
		compatible = "rockchip,dummy-codec";
		#sound-dai-cells = <0x0>;
		phandle = <0x13f>;
	};
	pdm-mic-array {
		status = "disabled";
		compatible = "simple-audio-card";
		simple-audio-card,name = "rockchip,pdm-mic-array";
		simple-audio-card,cpu {
			sound-dai = <0x13e>;
		};
		simple-audio-card,codec {
			sound-dai = <0x13f>;
		};
	};
	rk809-sound {
		status = "okay";
		compatible = "rockchip,multicodecs-card";
		rockchip,card-name = "rockchip-rk809";
		rockchip,format = "i2s";
		rockchip,mclk-fs = <0x100>;
		rockchip,cpu = <0xe3>;
		rockchip,codec = <0x140>;
		spk-det-gpio = <0x13d 0x16 0x1>;
		hp-det-gpio = <0xf2 0x1b 0x0>;
		pinctrl-names = "default";
		pinctrl-0 = <0x141>;
		hp-volume = <0x14>;
		spk-volume = <0x1e>;
	};
	vad-sound {
		status = "disabled";
		compatible = "rockchip,multicodecs-card";
		rockchip,card-name = "rockchip,rk3568-vad";
		rockchip,cpu = <0xe3>;
		rockchip,codec = <0x140 0x142>;
	};
	vcc3v3-sys {
		compatible = "regulator-fixed";
		regulator-name = "vcc3v3_sys";
		regulator-always-on;
		regulator-boot-on;
		regulator-min-microvolt = <0x325aa0>;
		regulator-max-microvolt = <0x325aa0>;
		vin-supply = <0x143>;
		phandle = <0x45>;
	};
	vcc5v0-sys {
		compatible = "regulator-fixed";
		regulator-name = "vcc5v0_sys";
		regulator-always-on;
		regulator-boot-on;
		regulator-min-microvolt = <0x4c4b40>;
		regulator-max-microvolt = <0x4c4b40>;
		vin-supply = <0x143>;
		phandle = <0x3d>;
	};
	vcc5v0-usb {
		compatible = "regulator-fixed";
		regulator-name = "vcc5v0_usb";
		regulator-always-on;
		regulator-boot-on;
		regulator-min-microvolt = <0x4c4b40>;
		regulator-max-microvolt = <0x4c4b40>;
		vin-supply = <0x143>;
		phandle = <0x14b>;
	};
	hdmi-sound {
		compatible = "simple-audio-card";
		simple-audio-card,format = "i2s";
		simple-audio-card,mclk-fs = <0x80>;
		simple-audio-card,name = "rockchip,hdmi";
		status = "okay";
		simple-audio-card,cpu {
			sound-dai = <0x144>;
		};
		simple-audio-card,codec {
			sound-dai = <0x145>;
		};
	};
	sdio-pwrseq {
		compatible = "mmc-pwrseq-simple";
		clocks = <0x146 0x1>;
		clock-names = "ext_clock";
		pinctrl-names = "default";
		pinctrl-0 = <0x147>;
		post-power-on-delay-ms = <0xc8>;
		phandle = <0xac>;
	};
	wireless-wlan {
		compatible = "wlan-platdata";
		rockchip,grf = <0x3a>;
		wifi_chip_type = "rtl8822cs";
		WIFI,poweren_gpio = <0x8a 0x1d 0x0>;
		pinctrl-names = "default";
		pinctrl-0 = <0x148>;
		WIFI,host_wake_irq = <0x8a 0x1c 0x0>;
		status = "okay";
	};
	wireless-bluetooth {
		compatible = "bluetooth-platdata";
		clocks = <0x146 0x1>;
		clock-names = "ext_clock";
		uart_rts_gpios = <0xbf 0x9 0x1>;
		pinctrl-names = "default", "rts_gpio";
		pinctrl-0 = <0x149>;
		pinctrl-1 = <0x14a>;
		BT,power_gpio = <0x8a 0x0 0x0>;
		BT,wake_gpio = <0x8a 0x1 0x0>;
		BT,wake_host_irq = <0x8a 0x2 0x0>;
		status = "okay";
	};
	external-camera-25m-clock {
		compatible = "fixed-clock";
		clock-frequency = <0x17d7840>;
		clock-output-names = "ext_cam_25m_clk";
		#clock-cells = <0x0>;
		phandle = <0xef>;
	};
	vcc3v3-mipi-con {
		compatible = "regulator-fixed";
		regulator-name = "vcc3v3_mipi_con";
		regulator-boot-on;
		regulator-always-on;
		gpio = <0x13d 0x1a 0x0>;
		enable-active-high;
		regulator-min-microvolt = <0x325aa0>;
		regulator-max-microvolt = <0x325aa0>;
		vin-supply = <0x33>;
	};
	vcc1v8-cam {
		compatible = "regulator-fixed";
		regulator-name = "vcc1v8_cam";
		regulator-boot-on;
		regulator-always-on;
		gpio = <0x13d 0x10 0x0>;
		enable-active-high;
		regulator-min-microvolt = <0x1b7740>;
		regulator-max-microvolt = <0x1b7740>;
	};
	vcc5v0-host-regulator {
		compatible = "regulator-fixed";
		regulator-name = "vcc5v0_host";
		regulator-boot-on;
		regulator-always-on;
		regulator-min-microvolt = <0x4c4b40>;
		regulator-max-microvolt = <0x4c4b40>;
		enable-active-high;
		gpio = <0x3e 0x6 0x0>;
		vin-supply = <0x14b>;
		pinctrl-names = "default";
		pinctrl-0 = <0x14c>;
		phandle = <0x12b>;
	};
	vcc5v0-otg-regulator {
		compatible = "regulator-fixed";
		regulator-name = "vcc5v0_otg";
		regulator-min-microvolt = <0x4c4b40>;
		regulator-max-microvolt = <0x4c4b40>;
		enable-active-high;
		gpio = <0x3e 0x5 0x0>;
		vin-supply = <0x14b>;
		pinctrl-names = "default";
		pinctrl-0 = <0x14d>;
		phandle = <0x12c>;
	};
	pcie30-avdd0v9 {
		compatible = "regulator-fixed";
		regulator-name = "pcie30_avdd0v9";
		regulator-always-on;
		regulator-boot-on;
		regulator-min-microvolt = <0xdbba0>;
		regulator-max-microvolt = <0xdbba0>;
		vin-supply = <0x45>;
	};
	pcie30-avdd1v8 {
		compatible = "regulator-fixed";
		regulator-name = "pcie30_avdd1v8";
		regulator-always-on;
		regulator-boot-on;
		regulator-min-microvolt = <0x1b7740>;
		regulator-max-microvolt = <0x1b7740>;
		vin-supply = <0x45>;
	};
	gpio-regulator {
		compatible = "regulator-fixed";
		regulator-name = "vcc3v3_pcie";
		regulator-min-microvolt = <0x325aa0>;
		regulator-max-microvolt = <0x325aa0>;
		enable-active-high;
		gpio = <0x3e 0x1c 0x0>;
		startup-delay-us = <0x1388>;
		vin-supply = <0x143>;
		phandle = <0xc0>;
	};
	pcie3-regulator {
		compatible = "regulator-fixed";
		regulator-name = "pcie3_power";
		regulator-boot-on;
		regulator-always-on;
		regulator-min-microvolt = <0x325aa0>;
		regulator-max-microvolt = <0x325aa0>;
		enable-active-high;
		gpio = <0x3e 0x1c 0x0>;
		pinctrl-names = "default";
		pinctrl-0 = <0x14e>;
	};
	minipcie-regulator {
		compatible = "regulator-fixed";
		regulator-name = "minipcie_power";
		regulator-boot-on;
		regulator-always-on;
		regulator-min-microvolt = <0x325aa0>;
		regulator-max-microvolt = <0x325aa0>;
		enable-active-high;
		gpio = <0x8a 0x13 0x0>;
		pinctrl-names = "default";
		pinctrl-0 = <0x14f>;
		phandle = <0xbb>;
	};
	vcc2v5-ddr {
		compatible = "regulator-fixed";
		regulator-name = "vcc2v5-sys";
		regulator-always-on;
		regulator-boot-on;
		regulator-min-microvolt = <0x2625a0>;
		regulator-max-microvolt = <0x2625a0>;
		vin-supply = <0x45>;
	};
	vcc3v3-bu {
		compatible = "regulator-fixed";
		regulator-name = "vcc3v3_bu";
		regulator-always-on;
		regulator-boot-on;
		regulator-min-microvolt = <0x325aa0>;
		regulator-max-microvolt = <0x325aa0>;
		vin-supply = <0x3d>;
	};
	backlight-dsi0 {
		compatible = "pwm-backlight";
		pwms = <0x150 0x0 0x61a8 0x0>;
		brightness-levels = <0x0 0x14 0x14 0x15 0x15 0x16 0x16 0x17 0x17 0x18 0x18 0x19 0x19 0x1a 0x1a 0x1b 0x1b 0x1c 0x1c 0x1d 0x1d 0x1e 0x1e 0x1f 0x1f 0x20 0x20 0x21 0x21 0x22 0x22 0x23 0x23 0x24 0x24 0x25 0x25 0x26 0x26 0x27 0x28 0x29 0x2a 0x2b 0x2c 0x2d 0x2e 0x2f 0x30 0x31 0x32 0x33 0x34 0x35 0x36 0x37 0x38 0x39 0x3a 0x3b 0x3c 0x3d 0x3e 0x3f 0x40 0x41 0x42 0x43 0x44 0x45 0x46 0x47 0x48 0x49 0x4a 0x4b 0x4c 0x4d 0x4e 0x4f 0x50 0x51 0x52 0x53 0x54 0x55 0x56 0x57 0x58 0x59 0x5a 0x5b 0x5c 0x5d 0x5e 0x5f 0x60 0x61 0x62 0x63 0x64 0x65 0x66 0x67 0x68 0x69 0x6a 0x6b 0x6c 0x6d 0x6e 0x6f 0x70 0x71 0x72 0x73 0x74 0x75 0x76 0x77 0x78 0x79 0x7a 0x7b 0x7c 0x7d 0x7e 0x7f 0x80 0x81 0x82 0x83 0x84 0x85 0x86 0x87 0x88 0x89 0x8a 0x8b 0x8c 0x8d 0x8e 0x8f 0x90 0x91 0x92 0x93 0x94 0x95 0x96 0x97 0x98 0x99 0x9a 0x9b 0x9c 0x9d 0x9e 0x9f 0xa0 0xa1 0xa2 0xa3 0xa4 0xa5 0xa6 0xa7 0xa8 0xa9 0xaa 0xab 0xac 0xad 0xae 0xaf 0xb0 0xb1 0xb2 0xb3 0xb4 0xb5 0xb6 0xb7 0xb8 0xb9 0xba 0xbb 0xbc 0xbd 0xbe 0xbf 0xc0 0xc1 0xc2 0xc3 0xc4 0xc5 0xc6 0xc7 0xc8 0xc9 0xca 0xcb 0xcc 0xcd 0xce 0xcf 0xd0 0xd1 0xd2 0xd3 0xd4 0xd5 0xd6 0xd7 0xd8 0xd9 0xda 0xdb 0xdc 0xdd 0xde 0xdf 0xe0 0xe1 0xe2 0xe3 0xe4 0xe5 0xe6 0xe7 0xe8 0xe9 0xea 0xeb 0xec 0xed 0xee 0xef 0xf0 0xf1 0xf2 0xf3 0xf4 0xf5 0xf6 0xf7 0xf8 0xf9 0xfa 0xfb 0xfc 0xfd 0xfe 0xff>;
		default-brightness-level = <0xc8>;
		phandle = <0xa1>;
	};
	vcc3v3-lcd0-n {
		compatible = "regulator-fixed";
		regulator-name = "vcc3v3_lcd0_n";
		regulator-boot-on;
		gpio = <0x3e 0x17 0x0>;
		enable-active-high;
		phandle = <0xa2>;
		regulator-state-mem {
			regulator-off-in-suspend;
		};
	};
	chosen {
		bootargs = "storagemedia=emmc androidboot.storagemedia=emmc androidboot.mode=normal  androidboot.verifiedbootstate=orange rw rootwait earlycon=uart8250,mmio32,0xfe660000 console=ttyFIQ0 root=PARTUUID=614e0000-0000";
	};
	fiq-debugger {
		compatible = "rockchip,fiq-debugger";
		rockchip,serial-id = <0x2>;
		rockchip,wake-irq = <0x0>;
		rockchip,irq-mode-enable = <0x1>;
		rockchip,baudrate = <0x16e360>;
		interrupts = <0x0 0xfc 0x8>;
		pinctrl-names = "default";
		pinctrl-0 = <0x104>;
		status = "okay";
	};
	debug@fd904000 {
		compatible = "rockchip,debug";
		reg = <0x0 0xfd904000 0x0 0x1000 0x0 0xfd905000 0x0 0x1000 0x0 0xfd906000 0x0 0x1000 0x0 0xfd907000 0x0 0x1000>;
	};
	cspmu@fd90c000 {
		compatible = "rockchip,cspmu";
		reg = <0x0 0xfd90c000 0x0 0x1000 0x0 0xfd90d000 0x0 0x1000 0x0 0xfd90e000 0x0 0x1000 0x0 0xfd90f000 0x0 0x1000>;
	};
};
